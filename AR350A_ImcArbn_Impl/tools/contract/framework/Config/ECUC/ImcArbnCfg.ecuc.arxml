AUTOSAR XML (schema 4-0-3)
package /ActiveEcuC
  ecuc value collection ActiveEcuC: ecuc-values=[Rte, DiagcMgr, Os, Dem, Dem, ImcArbn]
  module config Rte: implementation-config-variant=VARIANT-PRE-COMPILE, module-description=Rte_Impl
    RteBswGeneral: RteSchMVersionInfoApi=false, RteUseComShadowSignalApi=false
    RteGeneration:
      RteCalibrationSupport = NONE
      RteCodeVendorId = 30
      RteDevErrorDetect = false
      RteDevErrorDetectUninit = false
      RteGenerationMode = COMPATIBILITY_MODE
      RteIocInteractionReturnValue = RTE_IOC
      RteMeasurementSupport = false
      RteOptimizationMode = MEMORY
      RteValueRangeCheckEnabled = false
      RteVfbTraceEnabled = false
      RteEnforceIoc = false
      RteXcpEventSupport = false
    RteInitializationBehavior: RteInitializationStrategy=RTE_INITIALIZATION_STRATEGY_AT_RTE_START_AND_PARTITION_RESTART, RteSectionInitializationPolicy=
    RteOsInteraction
    Rte (RteBswModuleInstance): RteBswImplementationRef=Rte_Impl, RteBswModuleConfigurationRef=Rte
  module config ImcArbn: implementation-config-variant=VARIANT-PRE-COMPILE
    TestSigGroup1 (ImcArbnSignalGroup)
      ImcTestSig1 (ImcArbnSigRef): StartBit=0, ImcArbnSigNameRef=ImcArbn/ImcTestSig1
      ImcArbnSGAttributes: ImcArbnGroupTxRate=IMCARBN_2MS_GROUP, PrimarySrcOnlySignalGroup=true
    6 x ImcArbnSignalUserGroups:
      Fdd1_OptionalSigName1: FddName=Fdd1, ReceiverSideSignalName=OptionalSigName1, DataType=float32
      Fdd2_OptionalSigName1: FddName=Fdd2, ReceiverSideSignalName=OptionalSigName1, DataType=float32
      Fdd1_OptionalSigName2: FddName=Fdd1, ReceiverSideSignalName=OptionalSigName2, DataType=uint32
      Fdd2_OptionalSigName2: FddName=Fdd2, ReceiverSideSignalName=OptionalSigName2, DataType=uint32
      Fdd1_OptionalSigName3: FddName=Fdd1, ReceiverSideSignalName=OptionalSigName3, DataType=sint32
      Fdd2_OptionalSigName3: FddName=Fdd2, ReceiverSideSignalName=OptionalSigName3, DataType=sint32
    TestSigGroup2 (ImcArbnSignalGroup)
      ImcTestSig2 (ImcArbnSigRef): StartBit=0, ImcArbnSigNameRef=ImcArbn/ImcTestSig2
      ImcArbnSGAttributes: ImcArbnGroupTxRate=IMCARBN_10MS_GROUP, PrimarySrcOnlySignalGroup=false
    Fdd1_OptionalSigName4 (ImcArbnSignalUserGroups): FddName=Fdd1, ReceiverSideSignalName=OptionalSigName4, DataType=uint16
    Fdd2_OptionalSigName4 (ImcArbnSignalUserGroups): FddName=Fdd2, ReceiverSideSignalName=OptionalSigName4, DataType=uint16
    TestSigGroup3 (ImcArbnSignalGroup)
      ImcTestSig3 (ImcArbnSigRef): StartBit=0, ImcArbnSigNameRef=ImcArbn/ImcTestSig3
      ImcArbnSGAttributes: ImcArbnGroupTxRate=IMCARBN_100MS_GROUP, PrimarySrcOnlySignalGroup=false
    TestSigGroup4 (ImcArbnSignalGroup)
      ImcTestSig4 (ImcArbnSigRef): StartBit=0, ImcArbnSigNameRef=ImcArbn/ImcTestSig4
      ImcArbnSGAttributes: ImcArbnGroupTxRate=IMCARBN_2MS_GROUP, PrimarySrcOnlySignalGroup=true
      ImcTestSig5 (ImcArbnSigRef): StartBit=16, ImcArbnSigNameRef=ImcArbn/ImcTestSig5
    8 x ImcArbnSignalUserGroups:
      Fdd1_OptionalSigName5: FddName=Fdd1, ReceiverSideSignalName=OptionalSigName5, DataType=sint16
      Fdd2_OptionalSigName5: FddName=Fdd2, ReceiverSideSignalName=OptionalSigName5, DataType=sint16
      Fdd1_OptionalSigName6: FddName=Fdd1, ReceiverSideSignalName=OptionalSigName6, DataType=uint8
      Fdd2_OptionalSigName6: FddName=Fdd2, ReceiverSideSignalName=OptionalSigName6, DataType=uint8
      Fdd1_OptionalSigName7: FddName=Fdd1, ReceiverSideSignalName=OptionalSigName7, DataType=sint8
      Fdd1_OptionalSigName8: FddName=Fdd1, ReceiverSideSignalName=OptionalSigName8, DataType=boolean
      Fdd2_OptionalSigName7: FddName=Fdd2, ReceiverSideSignalName=OptionalSigName7, DataType=sint8
      Fdd2_OptionalSigName8: FddName=Fdd2, ReceiverSideSignalName=OptionalSigName8, DataType=boolean
    TestSigGroup5 (ImcArbnSignalGroup)
      ImcTestSig6 (ImcArbnSigRef): StartBit=0, ImcArbnSigNameRef=ImcArbn/ImcTestSig6
      ImcArbnSGAttributes: ImcArbnGroupTxRate=IMCARBN_2MS_GROUP, PrimarySrcOnlySignalGroup=true
      ImcTestSig8 (ImcArbnSigRef): StartBit=17, ImcArbnSigNameRef=ImcArbn/ImcTestSig8
      ImcTestSig7 (ImcArbnSigRef): StartBit=8, ImcArbnSigNameRef=ImcArbn/ImcTestSig7
    8 x ImcArbnSignal:
      ImcTestSig1: SignalName=ImcTestSig1, DestSize=32, DataType=float32, ImcArbnSigUsersRef=Fdd1_OptionalSigName1, ImcArbnSigUsersRef=Fdd2_OptionalSigName1
      ImcTestSig2: SignalName=ImcTestSig2, DestSize=32, DataType=uint32, ImcArbnSigUsersRef=Fdd1_OptionalSigName2, ImcArbnSigUsersRef=Fdd2_OptionalSigName2
      ImcTestSig3: SignalName=ImcTestSig3, DestSize=32, DataType=sint32, ImcArbnSigUsersRef=Fdd1_OptionalSigName3, ImcArbnSigUsersRef=Fdd2_OptionalSigName3
      ImcTestSig4: SignalName=ImcTestSig4, DestSize=16, DataType=uint16, ImcArbnSigUsersRef=Fdd1_OptionalSigName4, ImcArbnSigUsersRef=Fdd2_OptionalSigName4
      ImcTestSig5: SignalName=ImcTestSig5, DestSize=16, DataType=sint16, ImcArbnSigUsersRef=Fdd1_OptionalSigName5, ImcArbnSigUsersRef=Fdd2_OptionalSigName5
      ImcTestSig6: SignalName=ImcTestSig6, DestSize=8, DataType=uint8, ImcArbnSigUsersRef=Fdd1_OptionalSigName6, ImcArbnSigUsersRef=Fdd2_OptionalSigName6
      ImcTestSig7: SignalName=ImcTestSig7, DestSize=8, DataType=sint8, ImcArbnSigUsersRef=Fdd1_OptionalSigName7, ImcArbnSigUsersRef=Fdd2_OptionalSigName7
      ImcTestSig8: SignalName=ImcTestSig8, DestSize=1, DataType=boolean, ImcArbnSigUsersRef=Fdd2_OptionalSigName8, ImcArbnSigUsersRef=Fdd1_OptionalSigName8
