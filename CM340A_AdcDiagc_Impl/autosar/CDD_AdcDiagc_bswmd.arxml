AUTOSAR XML (schema 4-0-3)
package /Nexteer
  module definition AdcDiagc [0..1]: variants pre-compile  # Adc Diagnostics.
    container AdcDiagcGeneral  # This container contains the configuration (parameters) of the AdcDiagc.
      integer DYNDIAGFAILSTEP: 0..65535, set at pre-compile, origin=Nexteer  # .
      integer DYNDIAGPASSSTEP: 0..65535, set at pre-compile, origin=Nexteer  # .
