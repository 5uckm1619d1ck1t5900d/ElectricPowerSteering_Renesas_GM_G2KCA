AUTOSAR XML (schema 4-0-3)
package /Nexteer/Calibrations
  parameter interface u0p16_CalPortIf1
    parameter data prototype Val: sw-calibration-access=READ-WRITE, type=u0p16
package /Nexteer/NvMProxy_swc/Interfaces
  client server interface NvMService_AC3_SRBS: is-service=true
    6 x operation, all with possible-error=NvMService_AC3_SRBS/E_NOT_OK:
      EraseBlock
      GetErrorStatus
        arg ErrorStatus: type=NvM_RequestResultType, direction=OUT
      InvalidateNvBlock
      ReadBlock
        arg DstPtr: type=dtRef_VOID, direction=IN
      SetRamBlockStatus
        arg RamBlockStatus: type=Boolean, direction=IN
      WriteBlock
        arg SrcPtr: type=dtRef_const_VOID, direction=IN
    error E_NOT_OK: error-code=1
package /Nexteer/PortInterfaces
  10 x client server interface:
    GetMotAgMecl_PortIf1
      operation Oper
        arg MotAgMecl_Arg: type=u0p16, direction=OUT
    GetNtcQlfrSts_PortIf1
      operation Oper: possible-error=GetNtcQlfrSts_PortIf1/E_NOT_OK
        arg NtcNr_Arg: type=NtcNr1, direction=IN
        arg NtcQlfr_Arg: type=SigQlfr1, direction=OUT
      error E_NOT_OK: error-code=1
    GetRefTmr1MicroSec32bit_PortIf1
      operation Oper
        arg RefTmr_Arg: type=uint32, direction=OUT
    GetTiSpan1MicroSec32bit_PortIf1
      operation Oper
        arg RefTmr_Arg: type=uint32, direction=IN
        arg TiSpan_Arg: type=uint32, direction=OUT
    MotAgMeasMotAgCoeffTblRead_PortIf1
      operation Oper
        arg MotAgCoeffTbl_Arg: type=Ary1D_f32_26, direction=OUT
    MotAgMeasMotAgCoeffTblWr_PortIf1
      operation Oper
        arg MotAgCoeffTbl_Arg: type=Ary1D_f32_26, direction=IN
    SetFctGpio_PortIf1
      operation Oper: possible-error=SetFctGpio_PortIf1/E_NOT_OK
      error E_NOT_OK: error-code=1
    SetFctPeriph_PortIf1
      operation Oper: possible-error=SetFctPeriph_PortIf1/E_NOT_OK
      error E_NOT_OK: error-code=1
    SetGpio_PortIf1
      operation Oper: possible-error=SetGpio_PortIf1/E_NOT_OK
        arg PinSt_Arg: type=boolean, direction=IN
      error E_NOT_OK: error-code=1
    SetNtcSts_PortIf1
      operation Oper: possible-error=SetNtcSts_PortIf1/E_NOT_OK
        4 x arg, all with direction=IN:
          NtcNr_Arg: type=NtcNr1
          NtcStInfo_Arg: type=uint8
          NtcSts_Arg: type=NtcSts1
          DebStep_Arg: type=uint16
      error E_NOT_OK: error-code=1
  5 x sender receiver interface:
    SigQlfr_PortIf1: invalidation-policy{data-element=SigQlfr_PortIf1/Val, handle-invalid=DONT-INVALIDATE}
      data Val: sw-calibration-access=READ-ONLY, type=SigQlfr1
    sint32_PortIf1: invalidation-policy{data-element=sint32_PortIf1/Val, handle-invalid=DONT-INVALIDATE}
      data Val: sw-calibration-access=READ-ONLY, type=sint32
    sint8_PortIf1: invalidation-policy{data-element=sint8_PortIf1/Val, handle-invalid=DONT-INVALIDATE}
      data Val: sw-calibration-access=READ-ONLY, type=sint8
    u0p16_PortIf1: invalidation-policy{data-element=u0p16_PortIf1/Val, handle-invalid=DONT-INVALIDATE}
      data Val: sw-calibration-access=READ-ONLY, type=u0p16
    uint8_PortIf1: invalidation-policy{data-element=uint8_PortIf1/Val, handle-invalid=DONT-INVALIDATE}
      data Val: sw-calibration-access=READ-ONLY, type=uint8
