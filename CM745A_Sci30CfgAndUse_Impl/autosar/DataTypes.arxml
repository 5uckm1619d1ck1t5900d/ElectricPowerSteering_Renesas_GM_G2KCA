AUTOSAR XML (schema 4-0-3)
standard types defined: float32_DataConstr, float64_DataConstr, sint16_DataConstr, sint32_DataConstr, sint8_DataConstr, uint16_DataConstr, uint32_DataConstr, uint8_DataConstr, boolean, float32, float64, sint16, sint32, sint8, uint16, uint32, uint8
package /Nexteer/DataTypes
  7 x impl type:
    Ary1D_u8_8: category=ARRAY, sw-calibration-access=READ-ONLY, type-emitter=RTE
      element Element: array-size=8, array-size-semantics=FIXED-SIZE, implementation-data-type=uint8
    Ary1D_u8_Sci30CfgAndUseA: category=ARRAY, sw-calibration-access=READ-ONLY, type-emitter=ImcArbn
      element Element: array-size=8, array-size-semantics=FIXED-SIZE, implementation-data-type=uint8
    Ary2D_u8_Sci30CfgAndUseA: category=ARRAY, sw-calibration-access=READ-ONLY, type-emitter=Sci30CfgAndUse
      element Element: array-size=65535, array-size-semantics=VARIABLE-SIZE, implementation-data-type=Ary1D_u8_Sci30CfgAndUseA
    Ary2D_u8_Sci30CfgAndUseB: category=ARRAY, sw-calibration-access=READ-ONLY, type-emitter=Sci30CfgAndUse
      element Element: array-size=65535, array-size-semantics=VARIABLE-SIZE, implementation-data-type=Ary1D_u8_Sci30CfgAndUseA
    Ary2D_u8_Sci30CfgAndUseC: category=ARRAY, sw-calibration-access=READ-ONLY, type-emitter=Sci30CfgAndUse
      element Element: array-size=65535, array-size-semantics=VARIABLE-SIZE, implementation-data-type=Ary1D_u8_Sci30CfgAndUseA
    ImcArbnRxDataSrc1: implementation-data-type=ImcArbnRxDataSrc2, type-emitter=RTE
    ImcArbnRxDataSrc2: implementation-data-type=uint8, type-emitter=ImcArbn
