AUTOSAR XML (schema 4-0-3)
# COPYRIGHT
# Copyright(c) 2013 - 2015 Renesas Electronics Corporation
package /Renesas/EcucDefs_Dio
  bsw implementation Dio_Impl: programming-language=C, sw-version=1.0.9, vendor-id=59, ar-release-version=4.0.3, behavior=BswInternalBehavior_0, vendor-api-infix=Renesas, vendor-specific-module-def=Dio
  bsw module description Dio: module-id=120
    bsw internal behavior BswInternalBehavior_0
      exclusive area REGISTER_PROTECTION
