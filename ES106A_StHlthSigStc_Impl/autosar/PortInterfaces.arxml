AUTOSAR XML (schema 4-0-3)
package /Nexteer/NvMProxy_swc/Interfaces
  client server interface NvMService_AC3_SRBS: is-service=true
    6 x operation, all with possible-error=NvMService_AC3_SRBS/E_NOT_OK:
      EraseBlock
      GetErrorStatus
        arg ErrorStatus: type=NvM_RequestResultType, direction=OUT
      InvalidateNvBlock
      ReadBlock
        arg DstPtr: type=dtRef_VOID, direction=IN
      SetRamBlockStatus
        arg RamBlockStatus: type=Boolean, direction=IN
      WriteBlock
        arg SrcPtr: type=dtRef_const_VOID, direction=IN
    error E_NOT_OK: error-code=1
package /Nexteer/PortInterfaces
  client server interface GetSigStcHlthData_PortIf3
    operation Oper: possible-error=GetSigStcHlthData_PortIf3/E_NOT_OK
      arg SigId_Arg: type=StHlthMonSig3, direction=IN
      arg BufPtr_Arg: type=uint32, direction=OUT
    error E_NOT_OK: error-code=1
  sender receiver interface uint8_PortIf1: invalidation-policy{data-element=Val, handle-invalid=DONT-INVALIDATE}
    data Val: sw-calibration-access=READ-ONLY, type=uint8
package /PortInterfaces
  client server interface ClrSigStcHlthData_PortIf1
    operation Oper
      arg ClrTar_Arg: type=boolean, direction=IN
  client server interface StHlthStcPwrDwn_PortIf1
    operation Oper
  client server interface UpdStHlthStcData_PortIf1
    operation Oper
      arg TaskId_Arg: type=uint8, direction=IN
