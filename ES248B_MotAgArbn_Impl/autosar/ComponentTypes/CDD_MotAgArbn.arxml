AUTOSAR XML (schema 4-0-3)
package /ComponentTypes
  complex device driver sw component type CDD_MotAgArbn
    behavior CDD_MotAgArbn_InternalBehavior
      ar-typed-per-instance-memorys:
        data MotAgARollgCntPrev: sw-calibration-access=READ-ONLY, type=uint8
        data MotAgAStallCntPrev: sw-calibration-access=READ-ONLY, type=uint8
        data MotAgMeclPrev: sw-calibration-access=READ-ONLY, type=uint16
      timing event CDD_MotAgArbn_InitEvent: start-on-event=CDD_MotAgArbn_Init1, period=0
      runnable CDD_MotAgArbn_Init1
  swc implementation CDD_MotAgArbn_Implementation: behavior=CDD_MotAgArbn_InternalBehavior
    code-descriptors:
      code Default: artifact-descriptors=autosar-engineering-object={short-label=Default, category=SWSRC}
