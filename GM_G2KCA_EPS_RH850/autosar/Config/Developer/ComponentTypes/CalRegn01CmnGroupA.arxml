AUTOSAR XML (schema 4-0-3)
package /ComponentTypes
  parameter sw component type CalRegn01CmnGroupA
    provide port ElecPwrCnsPrstcPwrLoss: parameter-provide-com-spec{init-value=10, parameter=Val}, provided-interface=float32_CalPortIf1
