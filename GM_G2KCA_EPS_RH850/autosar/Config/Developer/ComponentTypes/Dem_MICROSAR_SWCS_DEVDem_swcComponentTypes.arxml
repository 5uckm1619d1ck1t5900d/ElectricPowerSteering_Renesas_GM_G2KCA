[part 2 of 2: package /MICROSAR_SWCS_DEV/Dem_swc/ComponentTypes]
AUTOSAR XML (schema 4-0-3)
package /MICROSAR_SWCS_DEV/Dem_swc/ComponentTypes  (continued)
  service sw component type Dem  (continued)
    behavior DemInternalBehavior: included-data-type-set=data-type=[Dem_DebounceResetStatusType, Dem_DebouncingStateType, Dem_DTCFormatType, Dem_DTCGroupType, Dem_DTCKindType, Dem_DTCStatusMaskType, Dem_EventIdType, Dem_EventStatusExtendedType, Dem_EventStatusType, Dem_IndicatorStatusType, Dem_InitMonitorReasonType, Dem_IumprDenomCondIdType, Dem_IumprDenomCondStatusType, Dem_MaxDataValueType, Dem_OperationCycleStateType, Dem_RatioIdType]
      6 x operation invoked event:
        OpEventClearDTC_ClearDTC_Cdd: start-on-event=ClearDTC, operation=Cdd.ClearDTC
        OpEventDcmClearDTC_DcmClearDTC_Dcm: start-on-event=DcmClearDTC, operation=Dcm.DcmClearDTC
        OpEventDcmEnableDTCSetting_DcmEnableDTCSetting_Dcm: start-on-event=DcmEnableDTCSetting, operation=Dcm.DcmEnableDTCSetting
        OpEventDcmGetExtendedDataRecordByDTC_DcmGetExtendedDataRecordByDTC_Dcm: start-on-event=DcmGetExtendedDataRecordByDTC, operation=Dcm.DcmGetExtendedDataRecordByDTC
        OpEventDcmGetFreezeFrameDataByDTC_DcmGetFreezeFrameDataByDTC_Dcm: start-on-event=DcmGetFreezeFrameDataByDTC, operation=Dcm.DcmGetFreezeFrameDataByDTC
        OpEventDcmGetNextFilteredDTCAndFDC_DcmGetNextFilteredDTCAndFDC_Dcm: start-on-event=DcmGetNextFilteredDTCAndFDC, operation=Dcm.DcmGetNextFilteredDTCAndFDC
      timing event Timer_Dem_MainFunction: start-on-event=Dem_MainFunction, period=0.01
      861 x operation invoked event:
        OpEventGetDebouncingOfEvent_GetDebouncingOfEvent_EvtInfo_CtrlrComChassisExpBusOff: start-on-event=GetDebouncingOfEvent, operation=EvtInfo_CtrlrComChassisExpBusOff.GetDebouncingOfEvent
        OpEventGetDebouncingOfEvent_GetDebouncingOfEvent_EvtInfo_CtrlrComHiSpdBusOff: start-on-event=GetDebouncingOfEvent, operation=EvtInfo_CtrlrComHiSpdBusOff.GetDebouncingOfEvent
        OpEventGetDebouncingOfEvent_GetDebouncingOfEvent_EvtInfo_DevPwrVltgOverMaxThd: start-on-event=GetDebouncingOfEvent, operation=EvtInfo_DevPwrVltgOverMaxThd.GetDebouncingOfEvent
        OpEventGetDebouncingOfEvent_GetDebouncingOfEvent_EvtInfo_DevPwrVltgUnderMinThd: start-on-event=GetDebouncingOfEvent, operation=EvtInfo_DevPwrVltgUnderMinThd.GetDebouncingOfEvent
        OpEventGetDebouncingOfEvent_GetDebouncingOfEvent_EvtInfo_DevPwrVltgUnderThd: start-on-event=GetDebouncingOfEvent, operation=EvtInfo_DevPwrVltgUnderThd.GetDebouncingOfEvent
        OpEventGetDebouncingOfEvent_GetDebouncingOfEvent_EvtInfo_EcuHwPrfmc: start-on-event=GetDebouncingOfEvent, operation=EvtInfo_EcuHwPrfmc.GetDebouncingOfEvent
        OpEventGetDebouncingOfEvent_GetDebouncingOfEvent_EvtInfo_EcuSwPrfmcCalDataSetNotProgd: start-on-event=GetDebouncingOfEvent, operation=EvtInfo_EcuSwPrfmcCalDataSetNotProgd.GetDebouncingOfEvent
        OpEventGetDebouncingOfEvent_GetDebouncingOfEvent_EvtInfo_ElecSteerMotCirc: start-on-event=GetDebouncingOfEvent, operation=EvtInfo_ElecSteerMotCirc.GetDebouncingOfEvent
        OpEventGetDebouncingOfEvent_GetDebouncingOfEvent_EvtInfo_ElecSteerMotPosSnsrCir: start-on-event=GetDebouncingOfEvent, operation=EvtInfo_ElecSteerMotPosSnsrCir.GetDebouncingOfEvent
        OpEventGetDebouncingOfEvent_GetDebouncingOfEvent_EvtInfo_FLS_E_COMPARE_FAILED: start-on-event=GetDebouncingOfEvent, operation=EvtInfo_FLS_E_COMPARE_FAILED.GetDebouncingOfEvent
        OpEventGetDebouncingOfEvent_GetDebouncingOfEvent_EvtInfo_FLS_E_ERASE_FAILED: start-on-event=GetDebouncingOfEvent, operation=EvtInfo_FLS_E_ERASE_FAILED.GetDebouncingOfEvent
        OpEventGetDebouncingOfEvent_GetDebouncingOfEvent_EvtInfo_FLS_E_READ_FAILED: start-on-event=GetDebouncingOfEvent, operation=EvtInfo_FLS_E_READ_FAILED.GetDebouncingOfEvent
        OpEventGetDebouncingOfEvent_GetDebouncingOfEvent_EvtInfo_FLS_E_READ_FAILED_DED: start-on-event=GetDebouncingOfEvent, operation=EvtInfo_FLS_E_READ_FAILED_DED.GetDebouncingOfEvent
        OpEventGetDebouncingOfEvent_GetDebouncingOfEvent_EvtInfo_FLS_E_WRITE_FAILED: start-on-event=GetDebouncingOfEvent, operation=EvtInfo_FLS_E_WRITE_FAILED.GetDebouncingOfEvent
        OpEventGetDebouncingOfEvent_GetDebouncingOfEvent_EvtInfo_InvldDataRxdFromBodtCtrlMod: start-on-event=GetDebouncingOfEvent, operation=EvtInfo_InvldDataRxdFromBodtCtrlMod.GetDebouncingOfEvent
        OpEventGetDebouncingOfEvent_GetDebouncingOfEvent_EvtInfo_InvldDataRxdFromElecBrkCtrlMod: start-on-event=GetDebouncingOfEvent, operation=EvtInfo_InvldDataRxdFromElecBrkCtrlMod.GetDebouncingOfEvent
        OpEventGetDebouncingOfEvent_GetDebouncingOfEvent_EvtInfo_InvldDataRxdFromElecBrkCtrlModChassisExp: start-on-event=GetDebouncingOfEvent, operation=EvtInfo_InvldDataRxdFromElecBrkCtrlModChassisExp.GetDebouncingOfEvent
        OpEventGetDebouncingOfEvent_GetDebouncingOfEvent_EvtInfo_InvldDataRxdFromEngCtrlMod: start-on-event=GetDebouncingOfEvent, operation=EvtInfo_InvldDataRxdFromEngCtrlMod.GetDebouncingOfEvent
        OpEventGetDebouncingOfEvent_GetDebouncingOfEvent_EvtInfo_InvldDataRxdFromFrntCameraMod: start-on-event=GetDebouncingOfEvent, operation=EvtInfo_InvldDataRxdFromFrntCameraMod.GetDebouncingOfEvent
        OpEventGetDebouncingOfEvent_GetDebouncingOfEvent_EvtInfo_InvldDataRxdFromParkAssiCtrlMod: start-on-event=GetDebouncingOfEvent, operation=EvtInfo_InvldDataRxdFromParkAssiCtrlMod.GetDebouncingOfEvent
        OpEventGetDebouncingOfEvent_GetDebouncingOfEvent_EvtInfo_InvldDataRxdFromTrsmCtrlMod: start-on-event=GetDebouncingOfEvent, operation=EvtInfo_InvldDataRxdFromTrsmCtrlMod.GetDebouncingOfEvent
        OpEventGetDebouncingOfEvent_GetDebouncingOfEvent_EvtInfo_LostComWithBodyCtrlMod: start-on-event=GetDebouncingOfEvent, operation=EvtInfo_LostComWithBodyCtrlMod.GetDebouncingOfEvent
        OpEventGetDebouncingOfEvent_GetDebouncingOfEvent_EvtInfo_LostComWithElecBrkCtrlMod: start-on-event=GetDebouncingOfEvent, operation=EvtInfo_LostComWithElecBrkCtrlMod.GetDebouncingOfEvent
        OpEventGetDebouncingOfEvent_GetDebouncingOfEvent_EvtInfo_LostComWithElecBrkCtrlModChassisExp: start-on-event=GetDebouncingOfEvent, operation=EvtInfo_LostComWithElecBrkCtrlModChassisExp.GetDebouncingOfEvent
        OpEventGetDebouncingOfEvent_GetDebouncingOfEvent_EvtInfo_LostComWithEngCtrlMod: start-on-event=GetDebouncingOfEvent, operation=EvtInfo_LostComWithEngCtrlMod.GetDebouncingOfEvent
        OpEventGetDebouncingOfEvent_GetDebouncingOfEvent_EvtInfo_LostComWithFrntCameraCtrlMod: start-on-event=GetDebouncingOfEvent, operation=EvtInfo_LostComWithFrntCameraCtrlMod.GetDebouncingOfEvent
        OpEventGetDebouncingOfEvent_GetDebouncingOfEvent_EvtInfo_LostComWithParkAssiCtrlMod: start-on-event=GetDebouncingOfEvent, operation=EvtInfo_LostComWithParkAssiCtrlMod.GetDebouncingOfEvent
        OpEventGetDebouncingOfEvent_GetDebouncingOfEvent_EvtInfo_LostComWithTrsmCtrlMod: start-on-event=GetDebouncingOfEvent, operation=EvtInfo_LostComWithTrsmCtrlMod.GetDebouncingOfEvent
        OpEventGetDebouncingOfEvent_GetDebouncingOfEvent_EvtInfo_MCU_E_CLM_SELFDIAG_FAILURE: start-on-event=GetDebouncingOfEvent, operation=EvtInfo_MCU_E_CLM_SELFDIAG_FAILURE.GetDebouncingOfEvent
        OpEventGetDebouncingOfEvent_GetDebouncingOfEvent_EvtInfo_MCU_E_CLOCK_FAILURE: start-on-event=GetDebouncingOfEvent, operation=EvtInfo_MCU_E_CLOCK_FAILURE.GetDebouncingOfEvent
        OpEventGetDebouncingOfEvent_GetDebouncingOfEvent_EvtInfo_MCU_E_CVM_SELFDIAG_FAILURE: start-on-event=GetDebouncingOfEvent, operation=EvtInfo_MCU_E_CVM_SELFDIAG_FAILURE.GetDebouncingOfEvent
        OpEventGetDebouncingOfEvent_GetDebouncingOfEvent_EvtInfo_MCU_E_ECM_SELFDIAG_FAILURE: start-on-event=GetDebouncingOfEvent, operation=EvtInfo_MCU_E_ECM_SELFDIAG_FAILURE.GetDebouncingOfEvent
        OpEventGetDebouncingOfEvent_GetDebouncingOfEvent_EvtInfo_MCU_E_LOCKSTEP_SELFDIAG_FAILURE: start-on-event=GetDebouncingOfEvent, operation=EvtInfo_MCU_E_LOCKSTEP_SELFDIAG_FAILURE.GetDebouncingOfEvent
        OpEventGetDebouncingOfEvent_GetDebouncingOfEvent_EvtInfo_MCU_E_WRITE_TIMEOUT_FAILURE: start-on-event=GetDebouncingOfEvent, operation=EvtInfo_MCU_E_WRITE_TIMEOUT_FAILURE.GetDebouncingOfEvent
        OpEventGetDebouncingOfEvent_GetDebouncingOfEvent_EvtInfo_NVM_E_INTEGRITY_FAILED: start-on-event=GetDebouncingOfEvent, operation=EvtInfo_NVM_E_INTEGRITY_FAILED.GetDebouncingOfEvent
        OpEventGetDebouncingOfEvent_GetDebouncingOfEvent_EvtInfo_NVM_E_LOSS_OF_REDUNDANCY: start-on-event=GetDebouncingOfEvent, operation=EvtInfo_NVM_E_LOSS_OF_REDUNDANCY.GetDebouncingOfEvent
        OpEventGetDebouncingOfEvent_GetDebouncingOfEvent_EvtInfo_NVM_E_QUEUE_OVERFLOW: start-on-event=GetDebouncingOfEvent, operation=EvtInfo_NVM_E_QUEUE_OVERFLOW.GetDebouncingOfEvent
        OpEventGetDebouncingOfEvent_GetDebouncingOfEvent_EvtInfo_NVM_E_REQ_FAILED: start-on-event=GetDebouncingOfEvent, operation=EvtInfo_NVM_E_REQ_FAILED.GetDebouncingOfEvent
        OpEventGetDebouncingOfEvent_GetDebouncingOfEvent_EvtInfo_NVM_E_VERIFY_FAILED: start-on-event=GetDebouncingOfEvent, operation=EvtInfo_NVM_E_VERIFY_FAILED.GetDebouncingOfEvent
        OpEventGetDebouncingOfEvent_GetDebouncingOfEvent_EvtInfo_NVM_E_WRITE_PROTECTED: start-on-event=GetDebouncingOfEvent, operation=EvtInfo_NVM_E_WRITE_PROTECTED.GetDebouncingOfEvent
        OpEventGetDebouncingOfEvent_GetDebouncingOfEvent_EvtInfo_NVM_E_WRONG_BLOCK_ID: start-on-event=GetDebouncingOfEvent, operation=EvtInfo_NVM_E_WRONG_BLOCK_ID.GetDebouncingOfEvent
        OpEventGetDebouncingOfEvent_GetDebouncingOfEvent_EvtInfo_PORT_E_WRITE_TIMEOUT_FAILURE: start-on-event=GetDebouncingOfEvent, operation=EvtInfo_PORT_E_WRITE_TIMEOUT_FAILURE.GetDebouncingOfEvent
        OpEventGetDebouncingOfEvent_GetDebouncingOfEvent_EvtInfo_SPI_E_DATA_TX_TIMEOUT_FAILURE: start-on-event=GetDebouncingOfEvent, operation=EvtInfo_SPI_E_DATA_TX_TIMEOUT_FAILURE.GetDebouncingOfEvent
        OpEventGetDebouncingOfEvent_GetDebouncingOfEvent_EvtInfo_SPI_E_HARDWARE_ERROR: start-on-event=GetDebouncingOfEvent, operation=EvtInfo_SPI_E_HARDWARE_ERROR.GetDebouncingOfEvent
        OpEventGetDebouncingOfEvent_GetDebouncingOfEvent_EvtInfo_SteerFailrMtgtnLvl1LimpHomeMod: start-on-event=GetDebouncingOfEvent, operation=EvtInfo_SteerFailrMtgtnLvl1LimpHomeMod.GetDebouncingOfEvent
        OpEventGetDebouncingOfEvent_GetDebouncingOfEvent_EvtInfo_SteerFailrMtgtnLvl2LimpOver: start-on-event=GetDebouncingOfEvent, operation=EvtInfo_SteerFailrMtgtnLvl2LimpOver.GetDebouncingOfEvent
        OpEventGetDebouncingOfEvent_GetDebouncingOfEvent_EvtInfo_SteerFailrMtgtnLvl3FadeOut: start-on-event=GetDebouncingOfEvent, operation=EvtInfo_SteerFailrMtgtnLvl3FadeOut.GetDebouncingOfEvent
        OpEventGetDebouncingOfEvent_GetDebouncingOfEvent_EvtInfo_SteerWheelAgSnsrCalNorPrfmd: start-on-event=GetDebouncingOfEvent, operation=EvtInfo_SteerWheelAgSnsrCalNorPrfmd.GetDebouncingOfEvent
        OpEventGetDebouncingOfEvent_GetDebouncingOfEvent_EvtInfo_SteerWheelAgSnsrHwFlt: start-on-event=GetDebouncingOfEvent, operation=EvtInfo_SteerWheelAgSnsrHwFlt.GetDebouncingOfEvent
        OpEventGetDebouncingOfEvent_GetDebouncingOfEvent_EvtInfo_SteerWheelAgSnsrPlausly: start-on-event=GetDebouncingOfEvent, operation=EvtInfo_SteerWheelAgSnsrPlausly.GetDebouncingOfEvent
        OpEventGetDebouncingOfEvent_GetDebouncingOfEvent_EvtInfo_SteerWhlTqInpSnsr: start-on-event=GetDebouncingOfEvent, operation=EvtInfo_SteerWhlTqInpSnsr.GetDebouncingOfEvent
        OpEventGetDebouncingOfEvent_GetDebouncingOfEvent_EvtInfo_SteerWhlTqInpSnsrCalNoLrnd: start-on-event=GetDebouncingOfEvent, operation=EvtInfo_SteerWhlTqInpSnsrCalNoLrnd.GetDebouncingOfEvent
        OpEventGetDebouncingOfEvent_GetDebouncingOfEvent_EvtInfo_SysThermErrTHi: start-on-event=GetDebouncingOfEvent, operation=EvtInfo_SysThermErrTHi.GetDebouncingOfEvent
        OpEventGetDebouncingOfEvent_GetDebouncingOfEvent_EvtInfo_WDG_E_DISABLE_REJECTED: start-on-event=GetDebouncingOfEvent, operation=EvtInfo_WDG_E_DISABLE_REJECTED.GetDebouncingOfEvent
        OpEventGetDebouncingOfEvent_GetDebouncingOfEvent_EvtInfo_WDG_E_MODE_FAILED: start-on-event=GetDebouncingOfEvent, operation=EvtInfo_WDG_E_MODE_FAILED.GetDebouncingOfEvent
        OpEventGetDebouncingOfEvent_GetDebouncingOfEvent_EvtInfo_WDG_E_READBACK_FAILURE: start-on-event=GetDebouncingOfEvent, operation=EvtInfo_WDG_E_READBACK_FAILURE.GetDebouncingOfEvent
        OpEventGetDebouncingOfEvent_GetDebouncingOfEvent_EvtInfo_WDG_E_TRIGGER_TIMEOUT: start-on-event=GetDebouncingOfEvent, operation=EvtInfo_WDG_E_TRIGGER_TIMEOUT.GetDebouncingOfEvent
        OpEventGetDebouncingOfEvent_GetDebouncingOfEvent_GeneralEventInfo: start-on-event=GetDebouncingOfEvent, operation=GeneralEventInfo.GetDebouncingOfEvent
        OpEventGetDTCOfEvent_GetDTCOfEvent_Event_CtrlrComChassisExpBusOff: start-on-event=GetDTCOfEvent, operation=Event_CtrlrComChassisExpBusOff.GetDTCOfEvent
        OpEventGetDTCOfEvent_GetDTCOfEvent_Event_CtrlrComHiSpdBusOff: start-on-event=GetDTCOfEvent, operation=Event_CtrlrComHiSpdBusOff.GetDTCOfEvent
        OpEventGetDTCOfEvent_GetDTCOfEvent_Event_DevPwrVltgOverMaxThd: start-on-event=GetDTCOfEvent, operation=Event_DevPwrVltgOverMaxThd.GetDTCOfEvent
        OpEventGetDTCOfEvent_GetDTCOfEvent_Event_DevPwrVltgUnderMinThd: start-on-event=GetDTCOfEvent, operation=Event_DevPwrVltgUnderMinThd.GetDTCOfEvent
        OpEventGetDTCOfEvent_GetDTCOfEvent_Event_DevPwrVltgUnderThd: start-on-event=GetDTCOfEvent, operation=Event_DevPwrVltgUnderThd.GetDTCOfEvent
        OpEventGetDTCOfEvent_GetDTCOfEvent_Event_EcuHwPrfmc: start-on-event=GetDTCOfEvent, operation=Event_EcuHwPrfmc.GetDTCOfEvent
        OpEventGetDTCOfEvent_GetDTCOfEvent_Event_EcuSwPrfmcCalDataSetNotProgd: start-on-event=GetDTCOfEvent, operation=Event_EcuSwPrfmcCalDataSetNotProgd.GetDTCOfEvent
        OpEventGetDTCOfEvent_GetDTCOfEvent_Event_ElecSteerMotCirc: start-on-event=GetDTCOfEvent, operation=Event_ElecSteerMotCirc.GetDTCOfEvent
        OpEventGetDTCOfEvent_GetDTCOfEvent_Event_ElecSteerMotPosSnsrCir: start-on-event=GetDTCOfEvent, operation=Event_ElecSteerMotPosSnsrCir.GetDTCOfEvent
        OpEventGetDTCOfEvent_GetDTCOfEvent_Event_InvldDataRxdFromBodtCtrlMod: start-on-event=GetDTCOfEvent, operation=Event_InvldDataRxdFromBodtCtrlMod.GetDTCOfEvent
        OpEventGetDTCOfEvent_GetDTCOfEvent_Event_InvldDataRxdFromElecBrkCtrlMod: start-on-event=GetDTCOfEvent, operation=Event_InvldDataRxdFromElecBrkCtrlMod.GetDTCOfEvent
        OpEventGetDTCOfEvent_GetDTCOfEvent_Event_InvldDataRxdFromElecBrkCtrlModChassisExp: start-on-event=GetDTCOfEvent, operation=Event_InvldDataRxdFromElecBrkCtrlModChassisExp.GetDTCOfEvent
        OpEventGetDTCOfEvent_GetDTCOfEvent_Event_InvldDataRxdFromEngCtrlMod: start-on-event=GetDTCOfEvent, operation=Event_InvldDataRxdFromEngCtrlMod.GetDTCOfEvent
        OpEventGetDTCOfEvent_GetDTCOfEvent_Event_InvldDataRxdFromFrntCameraMod: start-on-event=GetDTCOfEvent, operation=Event_InvldDataRxdFromFrntCameraMod.GetDTCOfEvent
        OpEventGetDTCOfEvent_GetDTCOfEvent_Event_InvldDataRxdFromParkAssiCtrlMod: start-on-event=GetDTCOfEvent, operation=Event_InvldDataRxdFromParkAssiCtrlMod.GetDTCOfEvent
        OpEventGetDTCOfEvent_GetDTCOfEvent_Event_InvldDataRxdFromTrsmCtrlMod: start-on-event=GetDTCOfEvent, operation=Event_InvldDataRxdFromTrsmCtrlMod.GetDTCOfEvent
        OpEventGetDTCOfEvent_GetDTCOfEvent_Event_LostComWithBodyCtrlMod: start-on-event=GetDTCOfEvent, operation=Event_LostComWithBodyCtrlMod.GetDTCOfEvent
        OpEventGetDTCOfEvent_GetDTCOfEvent_Event_LostComWithElecBrkCtrlMod: start-on-event=GetDTCOfEvent, operation=Event_LostComWithElecBrkCtrlMod.GetDTCOfEvent
        OpEventGetDTCOfEvent_GetDTCOfEvent_Event_LostComWithElecBrkCtrlModChassisExp: start-on-event=GetDTCOfEvent, operation=Event_LostComWithElecBrkCtrlModChassisExp.GetDTCOfEvent
        OpEventGetDTCOfEvent_GetDTCOfEvent_Event_LostComWithEngCtrlMod: start-on-event=GetDTCOfEvent, operation=Event_LostComWithEngCtrlMod.GetDTCOfEvent
        OpEventGetDTCOfEvent_GetDTCOfEvent_Event_LostComWithFrntCameraCtrlMod: start-on-event=GetDTCOfEvent, operation=Event_LostComWithFrntCameraCtrlMod.GetDTCOfEvent
        OpEventGetDTCOfEvent_GetDTCOfEvent_Event_LostComWithParkAssiCtrlMod: start-on-event=GetDTCOfEvent, operation=Event_LostComWithParkAssiCtrlMod.GetDTCOfEvent
        OpEventGetDTCOfEvent_GetDTCOfEvent_Event_LostComWithTrsmCtrlMod: start-on-event=GetDTCOfEvent, operation=Event_LostComWithTrsmCtrlMod.GetDTCOfEvent
        OpEventGetDTCOfEvent_GetDTCOfEvent_Event_SteerFailrMtgtnLvl1LimpHomeMod: start-on-event=GetDTCOfEvent, operation=Event_SteerFailrMtgtnLvl1LimpHomeMod.GetDTCOfEvent
        OpEventGetDTCOfEvent_GetDTCOfEvent_Event_SteerFailrMtgtnLvl2LimpOver: start-on-event=GetDTCOfEvent, operation=Event_SteerFailrMtgtnLvl2LimpOver.GetDTCOfEvent
        OpEventGetDTCOfEvent_GetDTCOfEvent_Event_SteerFailrMtgtnLvl3FadeOut: start-on-event=GetDTCOfEvent, operation=Event_SteerFailrMtgtnLvl3FadeOut.GetDTCOfEvent
        OpEventGetDTCOfEvent_GetDTCOfEvent_Event_SteerWheelAgSnsrCalNorPrfmd: start-on-event=GetDTCOfEvent, operation=Event_SteerWheelAgSnsrCalNorPrfmd.GetDTCOfEvent
        OpEventGetDTCOfEvent_GetDTCOfEvent_Event_SteerWheelAgSnsrHwFlt: start-on-event=GetDTCOfEvent, operation=Event_SteerWheelAgSnsrHwFlt.GetDTCOfEvent
        OpEventGetDTCOfEvent_GetDTCOfEvent_Event_SteerWheelAgSnsrPlausly: start-on-event=GetDTCOfEvent, operation=Event_SteerWheelAgSnsrPlausly.GetDTCOfEvent
        OpEventGetDTCOfEvent_GetDTCOfEvent_Event_SteerWhlTqInpSnsr: start-on-event=GetDTCOfEvent, operation=Event_SteerWhlTqInpSnsr.GetDTCOfEvent
        OpEventGetDTCOfEvent_GetDTCOfEvent_Event_SteerWhlTqInpSnsrCalNoLrnd: start-on-event=GetDTCOfEvent, operation=Event_SteerWhlTqInpSnsrCalNoLrnd.GetDTCOfEvent
        OpEventGetDTCOfEvent_GetDTCOfEvent_Event_SysThermErrTHi: start-on-event=GetDTCOfEvent, operation=Event_SysThermErrTHi.GetDTCOfEvent
        OpEventGetDTCOfEvent_GetDTCOfEvent_EvtInfo_CtrlrComChassisExpBusOff: start-on-event=GetDTCOfEvent, operation=EvtInfo_CtrlrComChassisExpBusOff.GetDTCOfEvent
        OpEventGetDTCOfEvent_GetDTCOfEvent_EvtInfo_CtrlrComHiSpdBusOff: start-on-event=GetDTCOfEvent, operation=EvtInfo_CtrlrComHiSpdBusOff.GetDTCOfEvent
        OpEventGetDTCOfEvent_GetDTCOfEvent_EvtInfo_DevPwrVltgOverMaxThd: start-on-event=GetDTCOfEvent, operation=EvtInfo_DevPwrVltgOverMaxThd.GetDTCOfEvent
        OpEventGetDTCOfEvent_GetDTCOfEvent_EvtInfo_DevPwrVltgUnderMinThd: start-on-event=GetDTCOfEvent, operation=EvtInfo_DevPwrVltgUnderMinThd.GetDTCOfEvent
        OpEventGetDTCOfEvent_GetDTCOfEvent_EvtInfo_DevPwrVltgUnderThd: start-on-event=GetDTCOfEvent, operation=EvtInfo_DevPwrVltgUnderThd.GetDTCOfEvent
        OpEventGetDTCOfEvent_GetDTCOfEvent_EvtInfo_EcuHwPrfmc: start-on-event=GetDTCOfEvent, operation=EvtInfo_EcuHwPrfmc.GetDTCOfEvent
        OpEventGetDTCOfEvent_GetDTCOfEvent_EvtInfo_EcuSwPrfmcCalDataSetNotProgd: start-on-event=GetDTCOfEvent, operation=EvtInfo_EcuSwPrfmcCalDataSetNotProgd.GetDTCOfEvent
        OpEventGetDTCOfEvent_GetDTCOfEvent_EvtInfo_ElecSteerMotCirc: start-on-event=GetDTCOfEvent, operation=EvtInfo_ElecSteerMotCirc.GetDTCOfEvent
        OpEventGetDTCOfEvent_GetDTCOfEvent_EvtInfo_ElecSteerMotPosSnsrCir: start-on-event=GetDTCOfEvent, operation=EvtInfo_ElecSteerMotPosSnsrCir.GetDTCOfEvent
        OpEventGetDTCOfEvent_GetDTCOfEvent_EvtInfo_FLS_E_COMPARE_FAILED: start-on-event=GetDTCOfEvent, operation=EvtInfo_FLS_E_COMPARE_FAILED.GetDTCOfEvent
        OpEventGetDTCOfEvent_GetDTCOfEvent_EvtInfo_FLS_E_ERASE_FAILED: start-on-event=GetDTCOfEvent, operation=EvtInfo_FLS_E_ERASE_FAILED.GetDTCOfEvent
        OpEventGetDTCOfEvent_GetDTCOfEvent_EvtInfo_FLS_E_READ_FAILED: start-on-event=GetDTCOfEvent, operation=EvtInfo_FLS_E_READ_FAILED.GetDTCOfEvent
        OpEventGetDTCOfEvent_GetDTCOfEvent_EvtInfo_FLS_E_READ_FAILED_DED: start-on-event=GetDTCOfEvent, operation=EvtInfo_FLS_E_READ_FAILED_DED.GetDTCOfEvent
        OpEventGetDTCOfEvent_GetDTCOfEvent_EvtInfo_FLS_E_WRITE_FAILED: start-on-event=GetDTCOfEvent, operation=EvtInfo_FLS_E_WRITE_FAILED.GetDTCOfEvent
        OpEventGetDTCOfEvent_GetDTCOfEvent_EvtInfo_InvldDataRxdFromBodtCtrlMod: start-on-event=GetDTCOfEvent, operation=EvtInfo_InvldDataRxdFromBodtCtrlMod.GetDTCOfEvent
        OpEventGetDTCOfEvent_GetDTCOfEvent_EvtInfo_InvldDataRxdFromElecBrkCtrlMod: start-on-event=GetDTCOfEvent, operation=EvtInfo_InvldDataRxdFromElecBrkCtrlMod.GetDTCOfEvent
        OpEventGetDTCOfEvent_GetDTCOfEvent_EvtInfo_InvldDataRxdFromElecBrkCtrlModChassisExp: start-on-event=GetDTCOfEvent, operation=EvtInfo_InvldDataRxdFromElecBrkCtrlModChassisExp.GetDTCOfEvent
        OpEventGetDTCOfEvent_GetDTCOfEvent_EvtInfo_InvldDataRxdFromEngCtrlMod: start-on-event=GetDTCOfEvent, operation=EvtInfo_InvldDataRxdFromEngCtrlMod.GetDTCOfEvent
        OpEventGetDTCOfEvent_GetDTCOfEvent_EvtInfo_InvldDataRxdFromFrntCameraMod: start-on-event=GetDTCOfEvent, operation=EvtInfo_InvldDataRxdFromFrntCameraMod.GetDTCOfEvent
        OpEventGetDTCOfEvent_GetDTCOfEvent_EvtInfo_InvldDataRxdFromParkAssiCtrlMod: start-on-event=GetDTCOfEvent, operation=EvtInfo_InvldDataRxdFromParkAssiCtrlMod.GetDTCOfEvent
        OpEventGetDTCOfEvent_GetDTCOfEvent_EvtInfo_InvldDataRxdFromTrsmCtrlMod: start-on-event=GetDTCOfEvent, operation=EvtInfo_InvldDataRxdFromTrsmCtrlMod.GetDTCOfEvent
        OpEventGetDTCOfEvent_GetDTCOfEvent_EvtInfo_LostComWithBodyCtrlMod: start-on-event=GetDTCOfEvent, operation=EvtInfo_LostComWithBodyCtrlMod.GetDTCOfEvent
        OpEventGetDTCOfEvent_GetDTCOfEvent_EvtInfo_LostComWithElecBrkCtrlMod: start-on-event=GetDTCOfEvent, operation=EvtInfo_LostComWithElecBrkCtrlMod.GetDTCOfEvent
        OpEventGetDTCOfEvent_GetDTCOfEvent_EvtInfo_LostComWithElecBrkCtrlModChassisExp: start-on-event=GetDTCOfEvent, operation=EvtInfo_LostComWithElecBrkCtrlModChassisExp.GetDTCOfEvent
        OpEventGetDTCOfEvent_GetDTCOfEvent_EvtInfo_LostComWithEngCtrlMod: start-on-event=GetDTCOfEvent, operation=EvtInfo_LostComWithEngCtrlMod.GetDTCOfEvent
        OpEventGetDTCOfEvent_GetDTCOfEvent_EvtInfo_LostComWithFrntCameraCtrlMod: start-on-event=GetDTCOfEvent, operation=EvtInfo_LostComWithFrntCameraCtrlMod.GetDTCOfEvent
        OpEventGetDTCOfEvent_GetDTCOfEvent_EvtInfo_LostComWithParkAssiCtrlMod: start-on-event=GetDTCOfEvent, operation=EvtInfo_LostComWithParkAssiCtrlMod.GetDTCOfEvent
        OpEventGetDTCOfEvent_GetDTCOfEvent_EvtInfo_LostComWithTrsmCtrlMod: start-on-event=GetDTCOfEvent, operation=EvtInfo_LostComWithTrsmCtrlMod.GetDTCOfEvent
        OpEventGetDTCOfEvent_GetDTCOfEvent_EvtInfo_MCU_E_CLM_SELFDIAG_FAILURE: start-on-event=GetDTCOfEvent, operation=EvtInfo_MCU_E_CLM_SELFDIAG_FAILURE.GetDTCOfEvent
        OpEventGetDTCOfEvent_GetDTCOfEvent_EvtInfo_MCU_E_CLOCK_FAILURE: start-on-event=GetDTCOfEvent, operation=EvtInfo_MCU_E_CLOCK_FAILURE.GetDTCOfEvent
        OpEventGetDTCOfEvent_GetDTCOfEvent_EvtInfo_MCU_E_CVM_SELFDIAG_FAILURE: start-on-event=GetDTCOfEvent, operation=EvtInfo_MCU_E_CVM_SELFDIAG_FAILURE.GetDTCOfEvent
        OpEventGetDTCOfEvent_GetDTCOfEvent_EvtInfo_MCU_E_ECM_SELFDIAG_FAILURE: start-on-event=GetDTCOfEvent, operation=EvtInfo_MCU_E_ECM_SELFDIAG_FAILURE.GetDTCOfEvent
        OpEventGetDTCOfEvent_GetDTCOfEvent_EvtInfo_MCU_E_LOCKSTEP_SELFDIAG_FAILURE: start-on-event=GetDTCOfEvent, operation=EvtInfo_MCU_E_LOCKSTEP_SELFDIAG_FAILURE.GetDTCOfEvent
        OpEventGetDTCOfEvent_GetDTCOfEvent_EvtInfo_MCU_E_WRITE_TIMEOUT_FAILURE: start-on-event=GetDTCOfEvent, operation=EvtInfo_MCU_E_WRITE_TIMEOUT_FAILURE.GetDTCOfEvent
        OpEventGetDTCOfEvent_GetDTCOfEvent_EvtInfo_NVM_E_INTEGRITY_FAILED: start-on-event=GetDTCOfEvent, operation=EvtInfo_NVM_E_INTEGRITY_FAILED.GetDTCOfEvent
        OpEventGetDTCOfEvent_GetDTCOfEvent_EvtInfo_NVM_E_LOSS_OF_REDUNDANCY: start-on-event=GetDTCOfEvent, operation=EvtInfo_NVM_E_LOSS_OF_REDUNDANCY.GetDTCOfEvent
        OpEventGetDTCOfEvent_GetDTCOfEvent_EvtInfo_NVM_E_QUEUE_OVERFLOW: start-on-event=GetDTCOfEvent, operation=EvtInfo_NVM_E_QUEUE_OVERFLOW.GetDTCOfEvent
        OpEventGetDTCOfEvent_GetDTCOfEvent_EvtInfo_NVM_E_REQ_FAILED: start-on-event=GetDTCOfEvent, operation=EvtInfo_NVM_E_REQ_FAILED.GetDTCOfEvent
        OpEventGetDTCOfEvent_GetDTCOfEvent_EvtInfo_NVM_E_VERIFY_FAILED: start-on-event=GetDTCOfEvent, operation=EvtInfo_NVM_E_VERIFY_FAILED.GetDTCOfEvent
        OpEventGetDTCOfEvent_GetDTCOfEvent_EvtInfo_NVM_E_WRITE_PROTECTED: start-on-event=GetDTCOfEvent, operation=EvtInfo_NVM_E_WRITE_PROTECTED.GetDTCOfEvent
        OpEventGetDTCOfEvent_GetDTCOfEvent_EvtInfo_NVM_E_WRONG_BLOCK_ID: start-on-event=GetDTCOfEvent, operation=EvtInfo_NVM_E_WRONG_BLOCK_ID.GetDTCOfEvent
        OpEventGetDTCOfEvent_GetDTCOfEvent_EvtInfo_PORT_E_WRITE_TIMEOUT_FAILURE: start-on-event=GetDTCOfEvent, operation=EvtInfo_PORT_E_WRITE_TIMEOUT_FAILURE.GetDTCOfEvent
        OpEventGetDTCOfEvent_GetDTCOfEvent_EvtInfo_SPI_E_DATA_TX_TIMEOUT_FAILURE: start-on-event=GetDTCOfEvent, operation=EvtInfo_SPI_E_DATA_TX_TIMEOUT_FAILURE.GetDTCOfEvent
        OpEventGetDTCOfEvent_GetDTCOfEvent_EvtInfo_SPI_E_HARDWARE_ERROR: start-on-event=GetDTCOfEvent, operation=EvtInfo_SPI_E_HARDWARE_ERROR.GetDTCOfEvent
        OpEventGetDTCOfEvent_GetDTCOfEvent_EvtInfo_SteerFailrMtgtnLvl1LimpHomeMod: start-on-event=GetDTCOfEvent, operation=EvtInfo_SteerFailrMtgtnLvl1LimpHomeMod.GetDTCOfEvent
        OpEventGetDTCOfEvent_GetDTCOfEvent_EvtInfo_SteerFailrMtgtnLvl2LimpOver: start-on-event=GetDTCOfEvent, operation=EvtInfo_SteerFailrMtgtnLvl2LimpOver.GetDTCOfEvent
        OpEventGetDTCOfEvent_GetDTCOfEvent_EvtInfo_SteerFailrMtgtnLvl3FadeOut: start-on-event=GetDTCOfEvent, operation=EvtInfo_SteerFailrMtgtnLvl3FadeOut.GetDTCOfEvent
        OpEventGetDTCOfEvent_GetDTCOfEvent_EvtInfo_SteerWheelAgSnsrCalNorPrfmd: start-on-event=GetDTCOfEvent, operation=EvtInfo_SteerWheelAgSnsrCalNorPrfmd.GetDTCOfEvent
        OpEventGetDTCOfEvent_GetDTCOfEvent_EvtInfo_SteerWheelAgSnsrHwFlt: start-on-event=GetDTCOfEvent, operation=EvtInfo_SteerWheelAgSnsrHwFlt.GetDTCOfEvent
        OpEventGetDTCOfEvent_GetDTCOfEvent_EvtInfo_SteerWheelAgSnsrPlausly: start-on-event=GetDTCOfEvent, operation=EvtInfo_SteerWheelAgSnsrPlausly.GetDTCOfEvent
        OpEventGetDTCOfEvent_GetDTCOfEvent_EvtInfo_SteerWhlTqInpSnsr: start-on-event=GetDTCOfEvent, operation=EvtInfo_SteerWhlTqInpSnsr.GetDTCOfEvent
        OpEventGetDTCOfEvent_GetDTCOfEvent_EvtInfo_SteerWhlTqInpSnsrCalNoLrnd: start-on-event=GetDTCOfEvent, operation=EvtInfo_SteerWhlTqInpSnsrCalNoLrnd.GetDTCOfEvent
        OpEventGetDTCOfEvent_GetDTCOfEvent_EvtInfo_SysThermErrTHi: start-on-event=GetDTCOfEvent, operation=EvtInfo_SysThermErrTHi.GetDTCOfEvent
        OpEventGetDTCOfEvent_GetDTCOfEvent_EvtInfo_WDG_E_DISABLE_REJECTED: start-on-event=GetDTCOfEvent, operation=EvtInfo_WDG_E_DISABLE_REJECTED.GetDTCOfEvent
        OpEventGetDTCOfEvent_GetDTCOfEvent_EvtInfo_WDG_E_MODE_FAILED: start-on-event=GetDTCOfEvent, operation=EvtInfo_WDG_E_MODE_FAILED.GetDTCOfEvent
        OpEventGetDTCOfEvent_GetDTCOfEvent_EvtInfo_WDG_E_READBACK_FAILURE: start-on-event=GetDTCOfEvent, operation=EvtInfo_WDG_E_READBACK_FAILURE.GetDTCOfEvent
        OpEventGetDTCOfEvent_GetDTCOfEvent_EvtInfo_WDG_E_TRIGGER_TIMEOUT: start-on-event=GetDTCOfEvent, operation=EvtInfo_WDG_E_TRIGGER_TIMEOUT.GetDTCOfEvent
        OpEventGetDTCOfEvent_GetDTCOfEvent_GeneralEventInfo: start-on-event=GetDTCOfEvent, operation=GeneralEventInfo.GetDTCOfEvent
        OpEventGetDTCStatusAvailabilityMask_GetDTCStatusAvailabilityMask_DemServices: start-on-event=GetDTCStatusAvailabilityMask, operation=DemServices.GetDTCStatusAvailabilityMask
        OpEventGetEventEnableCondition_GetEventEnableCondition_EvtInfo_CtrlrComChassisExpBusOff: start-on-event=GetEventEnableCondition, operation=EvtInfo_CtrlrComChassisExpBusOff.GetEventEnableCondition
        OpEventGetEventEnableCondition_GetEventEnableCondition_EvtInfo_CtrlrComHiSpdBusOff: start-on-event=GetEventEnableCondition, operation=EvtInfo_CtrlrComHiSpdBusOff.GetEventEnableCondition
        OpEventGetEventEnableCondition_GetEventEnableCondition_EvtInfo_DevPwrVltgOverMaxThd: start-on-event=GetEventEnableCondition, operation=EvtInfo_DevPwrVltgOverMaxThd.GetEventEnableCondition
        OpEventGetEventEnableCondition_GetEventEnableCondition_EvtInfo_DevPwrVltgUnderMinThd: start-on-event=GetEventEnableCondition, operation=EvtInfo_DevPwrVltgUnderMinThd.GetEventEnableCondition
        OpEventGetEventEnableCondition_GetEventEnableCondition_EvtInfo_DevPwrVltgUnderThd: start-on-event=GetEventEnableCondition, operation=EvtInfo_DevPwrVltgUnderThd.GetEventEnableCondition
        OpEventGetEventEnableCondition_GetEventEnableCondition_EvtInfo_EcuHwPrfmc: start-on-event=GetEventEnableCondition, operation=EvtInfo_EcuHwPrfmc.GetEventEnableCondition
        OpEventGetEventEnableCondition_GetEventEnableCondition_EvtInfo_EcuSwPrfmcCalDataSetNotProgd: start-on-event=GetEventEnableCondition, operation=EvtInfo_EcuSwPrfmcCalDataSetNotProgd.GetEventEnableCondition
        OpEventGetEventEnableCondition_GetEventEnableCondition_EvtInfo_ElecSteerMotCirc: start-on-event=GetEventEnableCondition, operation=EvtInfo_ElecSteerMotCirc.GetEventEnableCondition
        OpEventGetEventEnableCondition_GetEventEnableCondition_EvtInfo_ElecSteerMotPosSnsrCir: start-on-event=GetEventEnableCondition, operation=EvtInfo_ElecSteerMotPosSnsrCir.GetEventEnableCondition
        OpEventGetEventEnableCondition_GetEventEnableCondition_EvtInfo_FLS_E_COMPARE_FAILED: start-on-event=GetEventEnableCondition, operation=EvtInfo_FLS_E_COMPARE_FAILED.GetEventEnableCondition
        OpEventGetEventEnableCondition_GetEventEnableCondition_EvtInfo_FLS_E_ERASE_FAILED: start-on-event=GetEventEnableCondition, operation=EvtInfo_FLS_E_ERASE_FAILED.GetEventEnableCondition
        OpEventGetEventEnableCondition_GetEventEnableCondition_EvtInfo_FLS_E_READ_FAILED: start-on-event=GetEventEnableCondition, operation=EvtInfo_FLS_E_READ_FAILED.GetEventEnableCondition
        OpEventGetEventEnableCondition_GetEventEnableCondition_EvtInfo_FLS_E_READ_FAILED_DED: start-on-event=GetEventEnableCondition, operation=EvtInfo_FLS_E_READ_FAILED_DED.GetEventEnableCondition
        OpEventGetEventEnableCondition_GetEventEnableCondition_EvtInfo_FLS_E_WRITE_FAILED: start-on-event=GetEventEnableCondition, operation=EvtInfo_FLS_E_WRITE_FAILED.GetEventEnableCondition
        OpEventGetEventEnableCondition_GetEventEnableCondition_EvtInfo_InvldDataRxdFromBodtCtrlMod: start-on-event=GetEventEnableCondition, operation=EvtInfo_InvldDataRxdFromBodtCtrlMod.GetEventEnableCondition
        OpEventGetEventEnableCondition_GetEventEnableCondition_EvtInfo_InvldDataRxdFromElecBrkCtrlMod: start-on-event=GetEventEnableCondition, operation=EvtInfo_InvldDataRxdFromElecBrkCtrlMod.GetEventEnableCondition
        OpEventGetEventEnableCondition_GetEventEnableCondition_EvtInfo_InvldDataRxdFromElecBrkCtrlModChassisExp: start-on-event=GetEventEnableCondition, operation=EvtInfo_InvldDataRxdFromElecBrkCtrlModChassisExp.GetEventEnableCondition
        OpEventGetEventEnableCondition_GetEventEnableCondition_EvtInfo_InvldDataRxdFromEngCtrlMod: start-on-event=GetEventEnableCondition, operation=EvtInfo_InvldDataRxdFromEngCtrlMod.GetEventEnableCondition
        OpEventGetEventEnableCondition_GetEventEnableCondition_EvtInfo_InvldDataRxdFromFrntCameraMod: start-on-event=GetEventEnableCondition, operation=EvtInfo_InvldDataRxdFromFrntCameraMod.GetEventEnableCondition
        OpEventGetEventEnableCondition_GetEventEnableCondition_EvtInfo_InvldDataRxdFromParkAssiCtrlMod: start-on-event=GetEventEnableCondition, operation=EvtInfo_InvldDataRxdFromParkAssiCtrlMod.GetEventEnableCondition
        OpEventGetEventEnableCondition_GetEventEnableCondition_EvtInfo_InvldDataRxdFromTrsmCtrlMod: start-on-event=GetEventEnableCondition, operation=EvtInfo_InvldDataRxdFromTrsmCtrlMod.GetEventEnableCondition
        OpEventGetEventEnableCondition_GetEventEnableCondition_EvtInfo_LostComWithBodyCtrlMod: start-on-event=GetEventEnableCondition, operation=EvtInfo_LostComWithBodyCtrlMod.GetEventEnableCondition
        OpEventGetEventEnableCondition_GetEventEnableCondition_EvtInfo_LostComWithElecBrkCtrlMod: start-on-event=GetEventEnableCondition, operation=EvtInfo_LostComWithElecBrkCtrlMod.GetEventEnableCondition
        OpEventGetEventEnableCondition_GetEventEnableCondition_EvtInfo_LostComWithElecBrkCtrlModChassisExp: start-on-event=GetEventEnableCondition, operation=EvtInfo_LostComWithElecBrkCtrlModChassisExp.GetEventEnableCondition
        OpEventGetEventEnableCondition_GetEventEnableCondition_EvtInfo_LostComWithEngCtrlMod: start-on-event=GetEventEnableCondition, operation=EvtInfo_LostComWithEngCtrlMod.GetEventEnableCondition
        OpEventGetEventEnableCondition_GetEventEnableCondition_EvtInfo_LostComWithFrntCameraCtrlMod: start-on-event=GetEventEnableCondition, operation=EvtInfo_LostComWithFrntCameraCtrlMod.GetEventEnableCondition
        OpEventGetEventEnableCondition_GetEventEnableCondition_EvtInfo_LostComWithParkAssiCtrlMod: start-on-event=GetEventEnableCondition, operation=EvtInfo_LostComWithParkAssiCtrlMod.GetEventEnableCondition
        OpEventGetEventEnableCondition_GetEventEnableCondition_EvtInfo_LostComWithTrsmCtrlMod: start-on-event=GetEventEnableCondition, operation=EvtInfo_LostComWithTrsmCtrlMod.GetEventEnableCondition
        OpEventGetEventEnableCondition_GetEventEnableCondition_EvtInfo_MCU_E_CLM_SELFDIAG_FAILURE: start-on-event=GetEventEnableCondition, operation=EvtInfo_MCU_E_CLM_SELFDIAG_FAILURE.GetEventEnableCondition
        OpEventGetEventEnableCondition_GetEventEnableCondition_EvtInfo_MCU_E_CLOCK_FAILURE: start-on-event=GetEventEnableCondition, operation=EvtInfo_MCU_E_CLOCK_FAILURE.GetEventEnableCondition
        OpEventGetEventEnableCondition_GetEventEnableCondition_EvtInfo_MCU_E_CVM_SELFDIAG_FAILURE: start-on-event=GetEventEnableCondition, operation=EvtInfo_MCU_E_CVM_SELFDIAG_FAILURE.GetEventEnableCondition
        OpEventGetEventEnableCondition_GetEventEnableCondition_EvtInfo_MCU_E_ECM_SELFDIAG_FAILURE: start-on-event=GetEventEnableCondition, operation=EvtInfo_MCU_E_ECM_SELFDIAG_FAILURE.GetEventEnableCondition
        OpEventGetEventEnableCondition_GetEventEnableCondition_EvtInfo_MCU_E_LOCKSTEP_SELFDIAG_FAILURE: start-on-event=GetEventEnableCondition, operation=EvtInfo_MCU_E_LOCKSTEP_SELFDIAG_FAILURE.GetEventEnableCondition
        OpEventGetEventEnableCondition_GetEventEnableCondition_EvtInfo_MCU_E_WRITE_TIMEOUT_FAILURE: start-on-event=GetEventEnableCondition, operation=EvtInfo_MCU_E_WRITE_TIMEOUT_FAILURE.GetEventEnableCondition
        OpEventGetEventEnableCondition_GetEventEnableCondition_EvtInfo_NVM_E_INTEGRITY_FAILED: start-on-event=GetEventEnableCondition, operation=EvtInfo_NVM_E_INTEGRITY_FAILED.GetEventEnableCondition
        OpEventGetEventEnableCondition_GetEventEnableCondition_EvtInfo_NVM_E_LOSS_OF_REDUNDANCY: start-on-event=GetEventEnableCondition, operation=EvtInfo_NVM_E_LOSS_OF_REDUNDANCY.GetEventEnableCondition
        OpEventGetEventEnableCondition_GetEventEnableCondition_EvtInfo_NVM_E_QUEUE_OVERFLOW: start-on-event=GetEventEnableCondition, operation=EvtInfo_NVM_E_QUEUE_OVERFLOW.GetEventEnableCondition
        OpEventGetEventEnableCondition_GetEventEnableCondition_EvtInfo_NVM_E_REQ_FAILED: start-on-event=GetEventEnableCondition, operation=EvtInfo_NVM_E_REQ_FAILED.GetEventEnableCondition
        OpEventGetEventEnableCondition_GetEventEnableCondition_EvtInfo_NVM_E_VERIFY_FAILED: start-on-event=GetEventEnableCondition, operation=EvtInfo_NVM_E_VERIFY_FAILED.GetEventEnableCondition
        OpEventGetEventEnableCondition_GetEventEnableCondition_EvtInfo_NVM_E_WRITE_PROTECTED: start-on-event=GetEventEnableCondition, operation=EvtInfo_NVM_E_WRITE_PROTECTED.GetEventEnableCondition
        OpEventGetEventEnableCondition_GetEventEnableCondition_EvtInfo_NVM_E_WRONG_BLOCK_ID: start-on-event=GetEventEnableCondition, operation=EvtInfo_NVM_E_WRONG_BLOCK_ID.GetEventEnableCondition
        OpEventGetEventEnableCondition_GetEventEnableCondition_EvtInfo_PORT_E_WRITE_TIMEOUT_FAILURE: start-on-event=GetEventEnableCondition, operation=EvtInfo_PORT_E_WRITE_TIMEOUT_FAILURE.GetEventEnableCondition
        OpEventGetEventEnableCondition_GetEventEnableCondition_EvtInfo_SPI_E_DATA_TX_TIMEOUT_FAILURE: start-on-event=GetEventEnableCondition, operation=EvtInfo_SPI_E_DATA_TX_TIMEOUT_FAILURE.GetEventEnableCondition
        OpEventGetEventEnableCondition_GetEventEnableCondition_EvtInfo_SPI_E_HARDWARE_ERROR: start-on-event=GetEventEnableCondition, operation=EvtInfo_SPI_E_HARDWARE_ERROR.GetEventEnableCondition
        OpEventGetEventEnableCondition_GetEventEnableCondition_EvtInfo_SteerFailrMtgtnLvl1LimpHomeMod: start-on-event=GetEventEnableCondition, operation=EvtInfo_SteerFailrMtgtnLvl1LimpHomeMod.GetEventEnableCondition
        OpEventGetEventEnableCondition_GetEventEnableCondition_EvtInfo_SteerFailrMtgtnLvl2LimpOver: start-on-event=GetEventEnableCondition, operation=EvtInfo_SteerFailrMtgtnLvl2LimpOver.GetEventEnableCondition
        OpEventGetEventEnableCondition_GetEventEnableCondition_EvtInfo_SteerFailrMtgtnLvl3FadeOut: start-on-event=GetEventEnableCondition, operation=EvtInfo_SteerFailrMtgtnLvl3FadeOut.GetEventEnableCondition
        OpEventGetEventEnableCondition_GetEventEnableCondition_EvtInfo_SteerWheelAgSnsrCalNorPrfmd: start-on-event=GetEventEnableCondition, operation=EvtInfo_SteerWheelAgSnsrCalNorPrfmd.GetEventEnableCondition
        OpEventGetEventEnableCondition_GetEventEnableCondition_EvtInfo_SteerWheelAgSnsrHwFlt: start-on-event=GetEventEnableCondition, operation=EvtInfo_SteerWheelAgSnsrHwFlt.GetEventEnableCondition
        OpEventGetEventEnableCondition_GetEventEnableCondition_EvtInfo_SteerWheelAgSnsrPlausly: start-on-event=GetEventEnableCondition, operation=EvtInfo_SteerWheelAgSnsrPlausly.GetEventEnableCondition
        OpEventGetEventEnableCondition_GetEventEnableCondition_EvtInfo_SteerWhlTqInpSnsr: start-on-event=GetEventEnableCondition, operation=EvtInfo_SteerWhlTqInpSnsr.GetEventEnableCondition
        OpEventGetEventEnableCondition_GetEventEnableCondition_EvtInfo_SteerWhlTqInpSnsrCalNoLrnd: start-on-event=GetEventEnableCondition, operation=EvtInfo_SteerWhlTqInpSnsrCalNoLrnd.GetEventEnableCondition
        OpEventGetEventEnableCondition_GetEventEnableCondition_EvtInfo_SysThermErrTHi: start-on-event=GetEventEnableCondition, operation=EvtInfo_SysThermErrTHi.GetEventEnableCondition
        OpEventGetEventEnableCondition_GetEventEnableCondition_EvtInfo_WDG_E_DISABLE_REJECTED: start-on-event=GetEventEnableCondition, operation=EvtInfo_WDG_E_DISABLE_REJECTED.GetEventEnableCondition
        OpEventGetEventEnableCondition_GetEventEnableCondition_EvtInfo_WDG_E_MODE_FAILED: start-on-event=GetEventEnableCondition, operation=EvtInfo_WDG_E_MODE_FAILED.GetEventEnableCondition
        OpEventGetEventEnableCondition_GetEventEnableCondition_EvtInfo_WDG_E_READBACK_FAILURE: start-on-event=GetEventEnableCondition, operation=EvtInfo_WDG_E_READBACK_FAILURE.GetEventEnableCondition
        OpEventGetEventEnableCondition_GetEventEnableCondition_EvtInfo_WDG_E_TRIGGER_TIMEOUT: start-on-event=GetEventEnableCondition, operation=EvtInfo_WDG_E_TRIGGER_TIMEOUT.GetEventEnableCondition
        OpEventGetEventEnableCondition_GetEventEnableCondition_GeneralEventInfo: start-on-event=GetEventEnableCondition, operation=GeneralEventInfo.GetEventEnableCondition
        OpEventGetEventExtendedDataRecord_GetEventExtendedDataRecord_Event_CtrlrComChassisExpBusOff: start-on-event=GetEventExtendedDataRecord, operation=Event_CtrlrComChassisExpBusOff.GetEventExtendedDataRecord
        OpEventGetEventExtendedDataRecord_GetEventExtendedDataRecord_Event_CtrlrComHiSpdBusOff: start-on-event=GetEventExtendedDataRecord, operation=Event_CtrlrComHiSpdBusOff.GetEventExtendedDataRecord
        OpEventGetEventExtendedDataRecord_GetEventExtendedDataRecord_Event_DevPwrVltgOverMaxThd: start-on-event=GetEventExtendedDataRecord, operation=Event_DevPwrVltgOverMaxThd.GetEventExtendedDataRecord
        OpEventGetEventExtendedDataRecord_GetEventExtendedDataRecord_Event_DevPwrVltgUnderMinThd: start-on-event=GetEventExtendedDataRecord, operation=Event_DevPwrVltgUnderMinThd.GetEventExtendedDataRecord
        OpEventGetEventExtendedDataRecord_GetEventExtendedDataRecord_Event_DevPwrVltgUnderThd: start-on-event=GetEventExtendedDataRecord, operation=Event_DevPwrVltgUnderThd.GetEventExtendedDataRecord
        OpEventGetEventExtendedDataRecord_GetEventExtendedDataRecord_Event_EcuHwPrfmc: start-on-event=GetEventExtendedDataRecord, operation=Event_EcuHwPrfmc.GetEventExtendedDataRecord
        OpEventGetEventExtendedDataRecord_GetEventExtendedDataRecord_Event_EcuSwPrfmcCalDataSetNotProgd: start-on-event=GetEventExtendedDataRecord, operation=Event_EcuSwPrfmcCalDataSetNotProgd.GetEventExtendedDataRecord
        OpEventGetEventExtendedDataRecord_GetEventExtendedDataRecord_Event_ElecSteerMotCirc: start-on-event=GetEventExtendedDataRecord, operation=Event_ElecSteerMotCirc.GetEventExtendedDataRecord
        OpEventGetEventExtendedDataRecord_GetEventExtendedDataRecord_Event_ElecSteerMotPosSnsrCir: start-on-event=GetEventExtendedDataRecord, operation=Event_ElecSteerMotPosSnsrCir.GetEventExtendedDataRecord
        OpEventGetEventExtendedDataRecord_GetEventExtendedDataRecord_Event_InvldDataRxdFromBodtCtrlMod: start-on-event=GetEventExtendedDataRecord, operation=Event_InvldDataRxdFromBodtCtrlMod.GetEventExtendedDataRecord
        OpEventGetEventExtendedDataRecord_GetEventExtendedDataRecord_Event_InvldDataRxdFromElecBrkCtrlMod: start-on-event=GetEventExtendedDataRecord, operation=Event_InvldDataRxdFromElecBrkCtrlMod.GetEventExtendedDataRecord
        OpEventGetEventExtendedDataRecord_GetEventExtendedDataRecord_Event_InvldDataRxdFromElecBrkCtrlModChassisExp: start-on-event=GetEventExtendedDataRecord, operation=Event_InvldDataRxdFromElecBrkCtrlModChassisExp.GetEventExtendedDataRecord
        OpEventGetEventExtendedDataRecord_GetEventExtendedDataRecord_Event_InvldDataRxdFromEngCtrlMod: start-on-event=GetEventExtendedDataRecord, operation=Event_InvldDataRxdFromEngCtrlMod.GetEventExtendedDataRecord
        OpEventGetEventExtendedDataRecord_GetEventExtendedDataRecord_Event_InvldDataRxdFromFrntCameraMod: start-on-event=GetEventExtendedDataRecord, operation=Event_InvldDataRxdFromFrntCameraMod.GetEventExtendedDataRecord
        OpEventGetEventExtendedDataRecord_GetEventExtendedDataRecord_Event_InvldDataRxdFromParkAssiCtrlMod: start-on-event=GetEventExtendedDataRecord, operation=Event_InvldDataRxdFromParkAssiCtrlMod.GetEventExtendedDataRecord
        OpEventGetEventExtendedDataRecord_GetEventExtendedDataRecord_Event_InvldDataRxdFromTrsmCtrlMod: start-on-event=GetEventExtendedDataRecord, operation=Event_InvldDataRxdFromTrsmCtrlMod.GetEventExtendedDataRecord
        OpEventGetEventExtendedDataRecord_GetEventExtendedDataRecord_Event_LostComWithBodyCtrlMod: start-on-event=GetEventExtendedDataRecord, operation=Event_LostComWithBodyCtrlMod.GetEventExtendedDataRecord
        OpEventGetEventExtendedDataRecord_GetEventExtendedDataRecord_Event_LostComWithElecBrkCtrlMod: start-on-event=GetEventExtendedDataRecord, operation=Event_LostComWithElecBrkCtrlMod.GetEventExtendedDataRecord
        OpEventGetEventExtendedDataRecord_GetEventExtendedDataRecord_Event_LostComWithElecBrkCtrlModChassisExp: start-on-event=GetEventExtendedDataRecord, operation=Event_LostComWithElecBrkCtrlModChassisExp.GetEventExtendedDataRecord
        OpEventGetEventExtendedDataRecord_GetEventExtendedDataRecord_Event_LostComWithEngCtrlMod: start-on-event=GetEventExtendedDataRecord, operation=Event_LostComWithEngCtrlMod.GetEventExtendedDataRecord
        OpEventGetEventExtendedDataRecord_GetEventExtendedDataRecord_Event_LostComWithFrntCameraCtrlMod: start-on-event=GetEventExtendedDataRecord, operation=Event_LostComWithFrntCameraCtrlMod.GetEventExtendedDataRecord
        OpEventGetEventExtendedDataRecord_GetEventExtendedDataRecord_Event_LostComWithParkAssiCtrlMod: start-on-event=GetEventExtendedDataRecord, operation=Event_LostComWithParkAssiCtrlMod.GetEventExtendedDataRecord
        OpEventGetEventExtendedDataRecord_GetEventExtendedDataRecord_Event_LostComWithTrsmCtrlMod: start-on-event=GetEventExtendedDataRecord, operation=Event_LostComWithTrsmCtrlMod.GetEventExtendedDataRecord
        OpEventGetEventExtendedDataRecord_GetEventExtendedDataRecord_Event_SteerFailrMtgtnLvl1LimpHomeMod: start-on-event=GetEventExtendedDataRecord, operation=Event_SteerFailrMtgtnLvl1LimpHomeMod.GetEventExtendedDataRecord
        OpEventGetEventExtendedDataRecord_GetEventExtendedDataRecord_Event_SteerFailrMtgtnLvl2LimpOver: start-on-event=GetEventExtendedDataRecord, operation=Event_SteerFailrMtgtnLvl2LimpOver.GetEventExtendedDataRecord
        OpEventGetEventExtendedDataRecord_GetEventExtendedDataRecord_Event_SteerFailrMtgtnLvl3FadeOut: start-on-event=GetEventExtendedDataRecord, operation=Event_SteerFailrMtgtnLvl3FadeOut.GetEventExtendedDataRecord
        OpEventGetEventExtendedDataRecord_GetEventExtendedDataRecord_Event_SteerWheelAgSnsrCalNorPrfmd: start-on-event=GetEventExtendedDataRecord, operation=Event_SteerWheelAgSnsrCalNorPrfmd.GetEventExtendedDataRecord
        OpEventGetEventExtendedDataRecord_GetEventExtendedDataRecord_Event_SteerWheelAgSnsrHwFlt: start-on-event=GetEventExtendedDataRecord, operation=Event_SteerWheelAgSnsrHwFlt.GetEventExtendedDataRecord
        OpEventGetEventExtendedDataRecord_GetEventExtendedDataRecord_Event_SteerWheelAgSnsrPlausly: start-on-event=GetEventExtendedDataRecord, operation=Event_SteerWheelAgSnsrPlausly.GetEventExtendedDataRecord
        OpEventGetEventExtendedDataRecord_GetEventExtendedDataRecord_Event_SteerWhlTqInpSnsr: start-on-event=GetEventExtendedDataRecord, operation=Event_SteerWhlTqInpSnsr.GetEventExtendedDataRecord
        OpEventGetEventExtendedDataRecord_GetEventExtendedDataRecord_Event_SteerWhlTqInpSnsrCalNoLrnd: start-on-event=GetEventExtendedDataRecord, operation=Event_SteerWhlTqInpSnsrCalNoLrnd.GetEventExtendedDataRecord
        OpEventGetEventExtendedDataRecord_GetEventExtendedDataRecord_Event_SysThermErrTHi: start-on-event=GetEventExtendedDataRecord, operation=Event_SysThermErrTHi.GetEventExtendedDataRecord
        OpEventGetEventExtendedDataRecord_GetEventExtendedDataRecord_EvtInfo_CtrlrComChassisExpBusOff: start-on-event=GetEventExtendedDataRecord, operation=EvtInfo_CtrlrComChassisExpBusOff.GetEventExtendedDataRecord
        OpEventGetEventExtendedDataRecord_GetEventExtendedDataRecord_EvtInfo_CtrlrComHiSpdBusOff: start-on-event=GetEventExtendedDataRecord, operation=EvtInfo_CtrlrComHiSpdBusOff.GetEventExtendedDataRecord
        OpEventGetEventExtendedDataRecord_GetEventExtendedDataRecord_EvtInfo_DevPwrVltgOverMaxThd: start-on-event=GetEventExtendedDataRecord, operation=EvtInfo_DevPwrVltgOverMaxThd.GetEventExtendedDataRecord
        OpEventGetEventExtendedDataRecord_GetEventExtendedDataRecord_EvtInfo_DevPwrVltgUnderMinThd: start-on-event=GetEventExtendedDataRecord, operation=EvtInfo_DevPwrVltgUnderMinThd.GetEventExtendedDataRecord
        OpEventGetEventExtendedDataRecord_GetEventExtendedDataRecord_EvtInfo_DevPwrVltgUnderThd: start-on-event=GetEventExtendedDataRecord, operation=EvtInfo_DevPwrVltgUnderThd.GetEventExtendedDataRecord
        OpEventGetEventExtendedDataRecord_GetEventExtendedDataRecord_EvtInfo_EcuHwPrfmc: start-on-event=GetEventExtendedDataRecord, operation=EvtInfo_EcuHwPrfmc.GetEventExtendedDataRecord
        OpEventGetEventExtendedDataRecord_GetEventExtendedDataRecord_EvtInfo_EcuSwPrfmcCalDataSetNotProgd: start-on-event=GetEventExtendedDataRecord, operation=EvtInfo_EcuSwPrfmcCalDataSetNotProgd.GetEventExtendedDataRecord
        OpEventGetEventExtendedDataRecord_GetEventExtendedDataRecord_EvtInfo_ElecSteerMotCirc: start-on-event=GetEventExtendedDataRecord, operation=EvtInfo_ElecSteerMotCirc.GetEventExtendedDataRecord
        OpEventGetEventExtendedDataRecord_GetEventExtendedDataRecord_EvtInfo_ElecSteerMotPosSnsrCir: start-on-event=GetEventExtendedDataRecord, operation=EvtInfo_ElecSteerMotPosSnsrCir.GetEventExtendedDataRecord
        OpEventGetEventExtendedDataRecord_GetEventExtendedDataRecord_EvtInfo_FLS_E_COMPARE_FAILED: start-on-event=GetEventExtendedDataRecord, operation=EvtInfo_FLS_E_COMPARE_FAILED.GetEventExtendedDataRecord
        OpEventGetEventExtendedDataRecord_GetEventExtendedDataRecord_EvtInfo_FLS_E_ERASE_FAILED: start-on-event=GetEventExtendedDataRecord, operation=EvtInfo_FLS_E_ERASE_FAILED.GetEventExtendedDataRecord
        OpEventGetEventExtendedDataRecord_GetEventExtendedDataRecord_EvtInfo_FLS_E_READ_FAILED: start-on-event=GetEventExtendedDataRecord, operation=EvtInfo_FLS_E_READ_FAILED.GetEventExtendedDataRecord
        OpEventGetEventExtendedDataRecord_GetEventExtendedDataRecord_EvtInfo_FLS_E_READ_FAILED_DED: start-on-event=GetEventExtendedDataRecord, operation=EvtInfo_FLS_E_READ_FAILED_DED.GetEventExtendedDataRecord
        OpEventGetEventExtendedDataRecord_GetEventExtendedDataRecord_EvtInfo_FLS_E_WRITE_FAILED: start-on-event=GetEventExtendedDataRecord, operation=EvtInfo_FLS_E_WRITE_FAILED.GetEventExtendedDataRecord
        OpEventGetEventExtendedDataRecord_GetEventExtendedDataRecord_EvtInfo_InvldDataRxdFromBodtCtrlMod: start-on-event=GetEventExtendedDataRecord, operation=EvtInfo_InvldDataRxdFromBodtCtrlMod.GetEventExtendedDataRecord
        OpEventGetEventExtendedDataRecord_GetEventExtendedDataRecord_EvtInfo_InvldDataRxdFromElecBrkCtrlMod: start-on-event=GetEventExtendedDataRecord, operation=EvtInfo_InvldDataRxdFromElecBrkCtrlMod.GetEventExtendedDataRecord
        OpEventGetEventExtendedDataRecord_GetEventExtendedDataRecord_EvtInfo_InvldDataRxdFromElecBrkCtrlModChassisExp: start-on-event=GetEventExtendedDataRecord, operation=EvtInfo_InvldDataRxdFromElecBrkCtrlModChassisExp.GetEventExtendedDataRecord
        OpEventGetEventExtendedDataRecord_GetEventExtendedDataRecord_EvtInfo_InvldDataRxdFromEngCtrlMod: start-on-event=GetEventExtendedDataRecord, operation=EvtInfo_InvldDataRxdFromEngCtrlMod.GetEventExtendedDataRecord
        OpEventGetEventExtendedDataRecord_GetEventExtendedDataRecord_EvtInfo_InvldDataRxdFromFrntCameraMod: start-on-event=GetEventExtendedDataRecord, operation=EvtInfo_InvldDataRxdFromFrntCameraMod.GetEventExtendedDataRecord
        OpEventGetEventExtendedDataRecord_GetEventExtendedDataRecord_EvtInfo_InvldDataRxdFromParkAssiCtrlMod: start-on-event=GetEventExtendedDataRecord, operation=EvtInfo_InvldDataRxdFromParkAssiCtrlMod.GetEventExtendedDataRecord
        OpEventGetEventExtendedDataRecord_GetEventExtendedDataRecord_EvtInfo_InvldDataRxdFromTrsmCtrlMod: start-on-event=GetEventExtendedDataRecord, operation=EvtInfo_InvldDataRxdFromTrsmCtrlMod.GetEventExtendedDataRecord
        OpEventGetEventExtendedDataRecord_GetEventExtendedDataRecord_EvtInfo_LostComWithBodyCtrlMod: start-on-event=GetEventExtendedDataRecord, operation=EvtInfo_LostComWithBodyCtrlMod.GetEventExtendedDataRecord
        OpEventGetEventExtendedDataRecord_GetEventExtendedDataRecord_EvtInfo_LostComWithElecBrkCtrlMod: start-on-event=GetEventExtendedDataRecord, operation=EvtInfo_LostComWithElecBrkCtrlMod.GetEventExtendedDataRecord
        OpEventGetEventExtendedDataRecord_GetEventExtendedDataRecord_EvtInfo_LostComWithElecBrkCtrlModChassisExp: start-on-event=GetEventExtendedDataRecord, operation=EvtInfo_LostComWithElecBrkCtrlModChassisExp.GetEventExtendedDataRecord
        OpEventGetEventExtendedDataRecord_GetEventExtendedDataRecord_EvtInfo_LostComWithEngCtrlMod: start-on-event=GetEventExtendedDataRecord, operation=EvtInfo_LostComWithEngCtrlMod.GetEventExtendedDataRecord
        OpEventGetEventExtendedDataRecord_GetEventExtendedDataRecord_EvtInfo_LostComWithFrntCameraCtrlMod: start-on-event=GetEventExtendedDataRecord, operation=EvtInfo_LostComWithFrntCameraCtrlMod.GetEventExtendedDataRecord
        OpEventGetEventExtendedDataRecord_GetEventExtendedDataRecord_EvtInfo_LostComWithParkAssiCtrlMod: start-on-event=GetEventExtendedDataRecord, operation=EvtInfo_LostComWithParkAssiCtrlMod.GetEventExtendedDataRecord
        OpEventGetEventExtendedDataRecord_GetEventExtendedDataRecord_EvtInfo_LostComWithTrsmCtrlMod: start-on-event=GetEventExtendedDataRecord, operation=EvtInfo_LostComWithTrsmCtrlMod.GetEventExtendedDataRecord
        OpEventGetEventExtendedDataRecord_GetEventExtendedDataRecord_EvtInfo_MCU_E_CLM_SELFDIAG_FAILURE: start-on-event=GetEventExtendedDataRecord, operation=EvtInfo_MCU_E_CLM_SELFDIAG_FAILURE.GetEventExtendedDataRecord
        OpEventGetEventExtendedDataRecord_GetEventExtendedDataRecord_EvtInfo_MCU_E_CLOCK_FAILURE: start-on-event=GetEventExtendedDataRecord, operation=EvtInfo_MCU_E_CLOCK_FAILURE.GetEventExtendedDataRecord
        OpEventGetEventExtendedDataRecord_GetEventExtendedDataRecord_EvtInfo_MCU_E_CVM_SELFDIAG_FAILURE: start-on-event=GetEventExtendedDataRecord, operation=EvtInfo_MCU_E_CVM_SELFDIAG_FAILURE.GetEventExtendedDataRecord
        OpEventGetEventExtendedDataRecord_GetEventExtendedDataRecord_EvtInfo_MCU_E_ECM_SELFDIAG_FAILURE: start-on-event=GetEventExtendedDataRecord, operation=EvtInfo_MCU_E_ECM_SELFDIAG_FAILURE.GetEventExtendedDataRecord
        OpEventGetEventExtendedDataRecord_GetEventExtendedDataRecord_EvtInfo_MCU_E_LOCKSTEP_SELFDIAG_FAILURE: start-on-event=GetEventExtendedDataRecord, operation=EvtInfo_MCU_E_LOCKSTEP_SELFDIAG_FAILURE.GetEventExtendedDataRecord
        OpEventGetEventExtendedDataRecord_GetEventExtendedDataRecord_EvtInfo_MCU_E_WRITE_TIMEOUT_FAILURE: start-on-event=GetEventExtendedDataRecord, operation=EvtInfo_MCU_E_WRITE_TIMEOUT_FAILURE.GetEventExtendedDataRecord
        OpEventGetEventExtendedDataRecord_GetEventExtendedDataRecord_EvtInfo_NVM_E_INTEGRITY_FAILED: start-on-event=GetEventExtendedDataRecord, operation=EvtInfo_NVM_E_INTEGRITY_FAILED.GetEventExtendedDataRecord
        OpEventGetEventExtendedDataRecord_GetEventExtendedDataRecord_EvtInfo_NVM_E_LOSS_OF_REDUNDANCY: start-on-event=GetEventExtendedDataRecord, operation=EvtInfo_NVM_E_LOSS_OF_REDUNDANCY.GetEventExtendedDataRecord
        OpEventGetEventExtendedDataRecord_GetEventExtendedDataRecord_EvtInfo_NVM_E_QUEUE_OVERFLOW: start-on-event=GetEventExtendedDataRecord, operation=EvtInfo_NVM_E_QUEUE_OVERFLOW.GetEventExtendedDataRecord
        OpEventGetEventExtendedDataRecord_GetEventExtendedDataRecord_EvtInfo_NVM_E_REQ_FAILED: start-on-event=GetEventExtendedDataRecord, operation=EvtInfo_NVM_E_REQ_FAILED.GetEventExtendedDataRecord
        OpEventGetEventExtendedDataRecord_GetEventExtendedDataRecord_EvtInfo_NVM_E_VERIFY_FAILED: start-on-event=GetEventExtendedDataRecord, operation=EvtInfo_NVM_E_VERIFY_FAILED.GetEventExtendedDataRecord
        OpEventGetEventExtendedDataRecord_GetEventExtendedDataRecord_EvtInfo_NVM_E_WRITE_PROTECTED: start-on-event=GetEventExtendedDataRecord, operation=EvtInfo_NVM_E_WRITE_PROTECTED.GetEventExtendedDataRecord
        OpEventGetEventExtendedDataRecord_GetEventExtendedDataRecord_EvtInfo_NVM_E_WRONG_BLOCK_ID: start-on-event=GetEventExtendedDataRecord, operation=EvtInfo_NVM_E_WRONG_BLOCK_ID.GetEventExtendedDataRecord
        OpEventGetEventExtendedDataRecord_GetEventExtendedDataRecord_EvtInfo_PORT_E_WRITE_TIMEOUT_FAILURE: start-on-event=GetEventExtendedDataRecord, operation=EvtInfo_PORT_E_WRITE_TIMEOUT_FAILURE.GetEventExtendedDataRecord
        OpEventGetEventExtendedDataRecord_GetEventExtendedDataRecord_EvtInfo_SPI_E_DATA_TX_TIMEOUT_FAILURE: start-on-event=GetEventExtendedDataRecord, operation=EvtInfo_SPI_E_DATA_TX_TIMEOUT_FAILURE.GetEventExtendedDataRecord
        OpEventGetEventExtendedDataRecord_GetEventExtendedDataRecord_EvtInfo_SPI_E_HARDWARE_ERROR: start-on-event=GetEventExtendedDataRecord, operation=EvtInfo_SPI_E_HARDWARE_ERROR.GetEventExtendedDataRecord
        OpEventGetEventExtendedDataRecord_GetEventExtendedDataRecord_EvtInfo_SteerFailrMtgtnLvl1LimpHomeMod: start-on-event=GetEventExtendedDataRecord, operation=EvtInfo_SteerFailrMtgtnLvl1LimpHomeMod.GetEventExtendedDataRecord
        OpEventGetEventExtendedDataRecord_GetEventExtendedDataRecord_EvtInfo_SteerFailrMtgtnLvl2LimpOver: start-on-event=GetEventExtendedDataRecord, operation=EvtInfo_SteerFailrMtgtnLvl2LimpOver.GetEventExtendedDataRecord
        OpEventGetEventExtendedDataRecord_GetEventExtendedDataRecord_EvtInfo_SteerFailrMtgtnLvl3FadeOut: start-on-event=GetEventExtendedDataRecord, operation=EvtInfo_SteerFailrMtgtnLvl3FadeOut.GetEventExtendedDataRecord
        OpEventGetEventExtendedDataRecord_GetEventExtendedDataRecord_EvtInfo_SteerWheelAgSnsrCalNorPrfmd: start-on-event=GetEventExtendedDataRecord, operation=EvtInfo_SteerWheelAgSnsrCalNorPrfmd.GetEventExtendedDataRecord
        OpEventGetEventExtendedDataRecord_GetEventExtendedDataRecord_EvtInfo_SteerWheelAgSnsrHwFlt: start-on-event=GetEventExtendedDataRecord, operation=EvtInfo_SteerWheelAgSnsrHwFlt.GetEventExtendedDataRecord
        OpEventGetEventExtendedDataRecord_GetEventExtendedDataRecord_EvtInfo_SteerWheelAgSnsrPlausly: start-on-event=GetEventExtendedDataRecord, operation=EvtInfo_SteerWheelAgSnsrPlausly.GetEventExtendedDataRecord
        OpEventGetEventExtendedDataRecord_GetEventExtendedDataRecord_EvtInfo_SteerWhlTqInpSnsr: start-on-event=GetEventExtendedDataRecord, operation=EvtInfo_SteerWhlTqInpSnsr.GetEventExtendedDataRecord
        OpEventGetEventExtendedDataRecord_GetEventExtendedDataRecord_EvtInfo_SteerWhlTqInpSnsrCalNoLrnd: start-on-event=GetEventExtendedDataRecord, operation=EvtInfo_SteerWhlTqInpSnsrCalNoLrnd.GetEventExtendedDataRecord
        OpEventGetEventExtendedDataRecord_GetEventExtendedDataRecord_EvtInfo_SysThermErrTHi: start-on-event=GetEventExtendedDataRecord, operation=EvtInfo_SysThermErrTHi.GetEventExtendedDataRecord
        OpEventGetEventExtendedDataRecord_GetEventExtendedDataRecord_EvtInfo_WDG_E_DISABLE_REJECTED: start-on-event=GetEventExtendedDataRecord, operation=EvtInfo_WDG_E_DISABLE_REJECTED.GetEventExtendedDataRecord
        OpEventGetEventExtendedDataRecord_GetEventExtendedDataRecord_EvtInfo_WDG_E_MODE_FAILED: start-on-event=GetEventExtendedDataRecord, operation=EvtInfo_WDG_E_MODE_FAILED.GetEventExtendedDataRecord
        OpEventGetEventExtendedDataRecord_GetEventExtendedDataRecord_EvtInfo_WDG_E_READBACK_FAILURE: start-on-event=GetEventExtendedDataRecord, operation=EvtInfo_WDG_E_READBACK_FAILURE.GetEventExtendedDataRecord
        OpEventGetEventExtendedDataRecord_GetEventExtendedDataRecord_EvtInfo_WDG_E_TRIGGER_TIMEOUT: start-on-event=GetEventExtendedDataRecord, operation=EvtInfo_WDG_E_TRIGGER_TIMEOUT.GetEventExtendedDataRecord
        OpEventGetEventExtendedDataRecord_GetEventExtendedDataRecord_GeneralEventInfo: start-on-event=GetEventExtendedDataRecord, operation=GeneralEventInfo.GetEventExtendedDataRecord
        OpEventGetEventFailed_GetEventFailed_Event_CtrlrComChassisExpBusOff: start-on-event=GetEventFailed, operation=Event_CtrlrComChassisExpBusOff.GetEventFailed
        OpEventGetEventFailed_GetEventFailed_Event_CtrlrComHiSpdBusOff: start-on-event=GetEventFailed, operation=Event_CtrlrComHiSpdBusOff.GetEventFailed
        OpEventGetEventFailed_GetEventFailed_Event_DevPwrVltgOverMaxThd: start-on-event=GetEventFailed, operation=Event_DevPwrVltgOverMaxThd.GetEventFailed
        OpEventGetEventFailed_GetEventFailed_Event_DevPwrVltgUnderMinThd: start-on-event=GetEventFailed, operation=Event_DevPwrVltgUnderMinThd.GetEventFailed
        OpEventGetEventFailed_GetEventFailed_Event_DevPwrVltgUnderThd: start-on-event=GetEventFailed, operation=Event_DevPwrVltgUnderThd.GetEventFailed
        OpEventGetEventFailed_GetEventFailed_Event_EcuHwPrfmc: start-on-event=GetEventFailed, operation=Event_EcuHwPrfmc.GetEventFailed
        OpEventGetEventFailed_GetEventFailed_Event_EcuSwPrfmcCalDataSetNotProgd: start-on-event=GetEventFailed, operation=Event_EcuSwPrfmcCalDataSetNotProgd.GetEventFailed
        OpEventGetEventFailed_GetEventFailed_Event_ElecSteerMotCirc: start-on-event=GetEventFailed, operation=Event_ElecSteerMotCirc.GetEventFailed
        OpEventGetEventFailed_GetEventFailed_Event_ElecSteerMotPosSnsrCir: start-on-event=GetEventFailed, operation=Event_ElecSteerMotPosSnsrCir.GetEventFailed
        OpEventGetEventFailed_GetEventFailed_Event_InvldDataRxdFromBodtCtrlMod: start-on-event=GetEventFailed, operation=Event_InvldDataRxdFromBodtCtrlMod.GetEventFailed
        OpEventGetEventFailed_GetEventFailed_Event_InvldDataRxdFromElecBrkCtrlMod: start-on-event=GetEventFailed, operation=Event_InvldDataRxdFromElecBrkCtrlMod.GetEventFailed
        OpEventGetEventFailed_GetEventFailed_Event_InvldDataRxdFromElecBrkCtrlModChassisExp: start-on-event=GetEventFailed, operation=Event_InvldDataRxdFromElecBrkCtrlModChassisExp.GetEventFailed
        OpEventGetEventFailed_GetEventFailed_Event_InvldDataRxdFromEngCtrlMod: start-on-event=GetEventFailed, operation=Event_InvldDataRxdFromEngCtrlMod.GetEventFailed
        OpEventGetEventFailed_GetEventFailed_Event_InvldDataRxdFromFrntCameraMod: start-on-event=GetEventFailed, operation=Event_InvldDataRxdFromFrntCameraMod.GetEventFailed
        OpEventGetEventFailed_GetEventFailed_Event_InvldDataRxdFromParkAssiCtrlMod: start-on-event=GetEventFailed, operation=Event_InvldDataRxdFromParkAssiCtrlMod.GetEventFailed
        OpEventGetEventFailed_GetEventFailed_Event_InvldDataRxdFromTrsmCtrlMod: start-on-event=GetEventFailed, operation=Event_InvldDataRxdFromTrsmCtrlMod.GetEventFailed
        OpEventGetEventFailed_GetEventFailed_Event_LostComWithBodyCtrlMod: start-on-event=GetEventFailed, operation=Event_LostComWithBodyCtrlMod.GetEventFailed
        OpEventGetEventFailed_GetEventFailed_Event_LostComWithElecBrkCtrlMod: start-on-event=GetEventFailed, operation=Event_LostComWithElecBrkCtrlMod.GetEventFailed
        OpEventGetEventFailed_GetEventFailed_Event_LostComWithElecBrkCtrlModChassisExp: start-on-event=GetEventFailed, operation=Event_LostComWithElecBrkCtrlModChassisExp.GetEventFailed
        OpEventGetEventFailed_GetEventFailed_Event_LostComWithEngCtrlMod: start-on-event=GetEventFailed, operation=Event_LostComWithEngCtrlMod.GetEventFailed
        OpEventGetEventFailed_GetEventFailed_Event_LostComWithFrntCameraCtrlMod: start-on-event=GetEventFailed, operation=Event_LostComWithFrntCameraCtrlMod.GetEventFailed
        OpEventGetEventFailed_GetEventFailed_Event_LostComWithParkAssiCtrlMod: start-on-event=GetEventFailed, operation=Event_LostComWithParkAssiCtrlMod.GetEventFailed
        OpEventGetEventFailed_GetEventFailed_Event_LostComWithTrsmCtrlMod: start-on-event=GetEventFailed, operation=Event_LostComWithTrsmCtrlMod.GetEventFailed
        OpEventGetEventFailed_GetEventFailed_Event_SteerFailrMtgtnLvl1LimpHomeMod: start-on-event=GetEventFailed, operation=Event_SteerFailrMtgtnLvl1LimpHomeMod.GetEventFailed
        OpEventGetEventFailed_GetEventFailed_Event_SteerFailrMtgtnLvl2LimpOver: start-on-event=GetEventFailed, operation=Event_SteerFailrMtgtnLvl2LimpOver.GetEventFailed
        OpEventGetEventFailed_GetEventFailed_Event_SteerFailrMtgtnLvl3FadeOut: start-on-event=GetEventFailed, operation=Event_SteerFailrMtgtnLvl3FadeOut.GetEventFailed
        OpEventGetEventFailed_GetEventFailed_Event_SteerWheelAgSnsrCalNorPrfmd: start-on-event=GetEventFailed, operation=Event_SteerWheelAgSnsrCalNorPrfmd.GetEventFailed
        OpEventGetEventFailed_GetEventFailed_Event_SteerWheelAgSnsrHwFlt: start-on-event=GetEventFailed, operation=Event_SteerWheelAgSnsrHwFlt.GetEventFailed
        OpEventGetEventFailed_GetEventFailed_Event_SteerWheelAgSnsrPlausly: start-on-event=GetEventFailed, operation=Event_SteerWheelAgSnsrPlausly.GetEventFailed
        OpEventGetEventFailed_GetEventFailed_Event_SteerWhlTqInpSnsr: start-on-event=GetEventFailed, operation=Event_SteerWhlTqInpSnsr.GetEventFailed
        OpEventGetEventFailed_GetEventFailed_Event_SteerWhlTqInpSnsrCalNoLrnd: start-on-event=GetEventFailed, operation=Event_SteerWhlTqInpSnsrCalNoLrnd.GetEventFailed
        OpEventGetEventFailed_GetEventFailed_Event_SysThermErrTHi: start-on-event=GetEventFailed, operation=Event_SysThermErrTHi.GetEventFailed
        OpEventGetEventFailed_GetEventFailed_EvtInfo_CtrlrComChassisExpBusOff: start-on-event=GetEventFailed, operation=EvtInfo_CtrlrComChassisExpBusOff.GetEventFailed
        OpEventGetEventFailed_GetEventFailed_EvtInfo_CtrlrComHiSpdBusOff: start-on-event=GetEventFailed, operation=EvtInfo_CtrlrComHiSpdBusOff.GetEventFailed
        OpEventGetEventFailed_GetEventFailed_EvtInfo_DevPwrVltgOverMaxThd: start-on-event=GetEventFailed, operation=EvtInfo_DevPwrVltgOverMaxThd.GetEventFailed
        OpEventGetEventFailed_GetEventFailed_EvtInfo_DevPwrVltgUnderMinThd: start-on-event=GetEventFailed, operation=EvtInfo_DevPwrVltgUnderMinThd.GetEventFailed
        OpEventGetEventFailed_GetEventFailed_EvtInfo_DevPwrVltgUnderThd: start-on-event=GetEventFailed, operation=EvtInfo_DevPwrVltgUnderThd.GetEventFailed
        OpEventGetEventFailed_GetEventFailed_EvtInfo_EcuHwPrfmc: start-on-event=GetEventFailed, operation=EvtInfo_EcuHwPrfmc.GetEventFailed
        OpEventGetEventFailed_GetEventFailed_EvtInfo_EcuSwPrfmcCalDataSetNotProgd: start-on-event=GetEventFailed, operation=EvtInfo_EcuSwPrfmcCalDataSetNotProgd.GetEventFailed
        OpEventGetEventFailed_GetEventFailed_EvtInfo_ElecSteerMotCirc: start-on-event=GetEventFailed, operation=EvtInfo_ElecSteerMotCirc.GetEventFailed
        OpEventGetEventFailed_GetEventFailed_EvtInfo_ElecSteerMotPosSnsrCir: start-on-event=GetEventFailed, operation=EvtInfo_ElecSteerMotPosSnsrCir.GetEventFailed
        OpEventGetEventFailed_GetEventFailed_EvtInfo_FLS_E_COMPARE_FAILED: start-on-event=GetEventFailed, operation=EvtInfo_FLS_E_COMPARE_FAILED.GetEventFailed
        OpEventGetEventFailed_GetEventFailed_EvtInfo_FLS_E_ERASE_FAILED: start-on-event=GetEventFailed, operation=EvtInfo_FLS_E_ERASE_FAILED.GetEventFailed
        OpEventGetEventFailed_GetEventFailed_EvtInfo_FLS_E_READ_FAILED: start-on-event=GetEventFailed, operation=EvtInfo_FLS_E_READ_FAILED.GetEventFailed
        OpEventGetEventFailed_GetEventFailed_EvtInfo_FLS_E_READ_FAILED_DED: start-on-event=GetEventFailed, operation=EvtInfo_FLS_E_READ_FAILED_DED.GetEventFailed
        OpEventGetEventFailed_GetEventFailed_EvtInfo_FLS_E_WRITE_FAILED: start-on-event=GetEventFailed, operation=EvtInfo_FLS_E_WRITE_FAILED.GetEventFailed
        OpEventGetEventFailed_GetEventFailed_EvtInfo_InvldDataRxdFromBodtCtrlMod: start-on-event=GetEventFailed, operation=EvtInfo_InvldDataRxdFromBodtCtrlMod.GetEventFailed
        OpEventGetEventFailed_GetEventFailed_EvtInfo_InvldDataRxdFromElecBrkCtrlMod: start-on-event=GetEventFailed, operation=EvtInfo_InvldDataRxdFromElecBrkCtrlMod.GetEventFailed
        OpEventGetEventFailed_GetEventFailed_EvtInfo_InvldDataRxdFromElecBrkCtrlModChassisExp: start-on-event=GetEventFailed, operation=EvtInfo_InvldDataRxdFromElecBrkCtrlModChassisExp.GetEventFailed
        OpEventGetEventFailed_GetEventFailed_EvtInfo_InvldDataRxdFromEngCtrlMod: start-on-event=GetEventFailed, operation=EvtInfo_InvldDataRxdFromEngCtrlMod.GetEventFailed
        OpEventGetEventFailed_GetEventFailed_EvtInfo_InvldDataRxdFromFrntCameraMod: start-on-event=GetEventFailed, operation=EvtInfo_InvldDataRxdFromFrntCameraMod.GetEventFailed
        OpEventGetEventFailed_GetEventFailed_EvtInfo_InvldDataRxdFromParkAssiCtrlMod: start-on-event=GetEventFailed, operation=EvtInfo_InvldDataRxdFromParkAssiCtrlMod.GetEventFailed
        OpEventGetEventFailed_GetEventFailed_EvtInfo_InvldDataRxdFromTrsmCtrlMod: start-on-event=GetEventFailed, operation=EvtInfo_InvldDataRxdFromTrsmCtrlMod.GetEventFailed
        OpEventGetEventFailed_GetEventFailed_EvtInfo_LostComWithBodyCtrlMod: start-on-event=GetEventFailed, operation=EvtInfo_LostComWithBodyCtrlMod.GetEventFailed
        OpEventGetEventFailed_GetEventFailed_EvtInfo_LostComWithElecBrkCtrlMod: start-on-event=GetEventFailed, operation=EvtInfo_LostComWithElecBrkCtrlMod.GetEventFailed
        OpEventGetEventFailed_GetEventFailed_EvtInfo_LostComWithElecBrkCtrlModChassisExp: start-on-event=GetEventFailed, operation=EvtInfo_LostComWithElecBrkCtrlModChassisExp.GetEventFailed
        OpEventGetEventFailed_GetEventFailed_EvtInfo_LostComWithEngCtrlMod: start-on-event=GetEventFailed, operation=EvtInfo_LostComWithEngCtrlMod.GetEventFailed
        OpEventGetEventFailed_GetEventFailed_EvtInfo_LostComWithFrntCameraCtrlMod: start-on-event=GetEventFailed, operation=EvtInfo_LostComWithFrntCameraCtrlMod.GetEventFailed
        OpEventGetEventFailed_GetEventFailed_EvtInfo_LostComWithParkAssiCtrlMod: start-on-event=GetEventFailed, operation=EvtInfo_LostComWithParkAssiCtrlMod.GetEventFailed
        OpEventGetEventFailed_GetEventFailed_EvtInfo_LostComWithTrsmCtrlMod: start-on-event=GetEventFailed, operation=EvtInfo_LostComWithTrsmCtrlMod.GetEventFailed
        OpEventGetEventFailed_GetEventFailed_EvtInfo_MCU_E_CLM_SELFDIAG_FAILURE: start-on-event=GetEventFailed, operation=EvtInfo_MCU_E_CLM_SELFDIAG_FAILURE.GetEventFailed
        OpEventGetEventFailed_GetEventFailed_EvtInfo_MCU_E_CLOCK_FAILURE: start-on-event=GetEventFailed, operation=EvtInfo_MCU_E_CLOCK_FAILURE.GetEventFailed
        OpEventGetEventFailed_GetEventFailed_EvtInfo_MCU_E_CVM_SELFDIAG_FAILURE: start-on-event=GetEventFailed, operation=EvtInfo_MCU_E_CVM_SELFDIAG_FAILURE.GetEventFailed
        OpEventGetEventFailed_GetEventFailed_EvtInfo_MCU_E_ECM_SELFDIAG_FAILURE: start-on-event=GetEventFailed, operation=EvtInfo_MCU_E_ECM_SELFDIAG_FAILURE.GetEventFailed
        OpEventGetEventFailed_GetEventFailed_EvtInfo_MCU_E_LOCKSTEP_SELFDIAG_FAILURE: start-on-event=GetEventFailed, operation=EvtInfo_MCU_E_LOCKSTEP_SELFDIAG_FAILURE.GetEventFailed
        OpEventGetEventFailed_GetEventFailed_EvtInfo_MCU_E_WRITE_TIMEOUT_FAILURE: start-on-event=GetEventFailed, operation=EvtInfo_MCU_E_WRITE_TIMEOUT_FAILURE.GetEventFailed
        OpEventGetEventFailed_GetEventFailed_EvtInfo_NVM_E_INTEGRITY_FAILED: start-on-event=GetEventFailed, operation=EvtInfo_NVM_E_INTEGRITY_FAILED.GetEventFailed
        OpEventGetEventFailed_GetEventFailed_EvtInfo_NVM_E_LOSS_OF_REDUNDANCY: start-on-event=GetEventFailed, operation=EvtInfo_NVM_E_LOSS_OF_REDUNDANCY.GetEventFailed
        OpEventGetEventFailed_GetEventFailed_EvtInfo_NVM_E_QUEUE_OVERFLOW: start-on-event=GetEventFailed, operation=EvtInfo_NVM_E_QUEUE_OVERFLOW.GetEventFailed
        OpEventGetEventFailed_GetEventFailed_EvtInfo_NVM_E_REQ_FAILED: start-on-event=GetEventFailed, operation=EvtInfo_NVM_E_REQ_FAILED.GetEventFailed
        OpEventGetEventFailed_GetEventFailed_EvtInfo_NVM_E_VERIFY_FAILED: start-on-event=GetEventFailed, operation=EvtInfo_NVM_E_VERIFY_FAILED.GetEventFailed
        OpEventGetEventFailed_GetEventFailed_EvtInfo_NVM_E_WRITE_PROTECTED: start-on-event=GetEventFailed, operation=EvtInfo_NVM_E_WRITE_PROTECTED.GetEventFailed
        OpEventGetEventFailed_GetEventFailed_EvtInfo_NVM_E_WRONG_BLOCK_ID: start-on-event=GetEventFailed, operation=EvtInfo_NVM_E_WRONG_BLOCK_ID.GetEventFailed
        OpEventGetEventFailed_GetEventFailed_EvtInfo_PORT_E_WRITE_TIMEOUT_FAILURE: start-on-event=GetEventFailed, operation=EvtInfo_PORT_E_WRITE_TIMEOUT_FAILURE.GetEventFailed
        OpEventGetEventFailed_GetEventFailed_EvtInfo_SPI_E_DATA_TX_TIMEOUT_FAILURE: start-on-event=GetEventFailed, operation=EvtInfo_SPI_E_DATA_TX_TIMEOUT_FAILURE.GetEventFailed
        OpEventGetEventFailed_GetEventFailed_EvtInfo_SPI_E_HARDWARE_ERROR: start-on-event=GetEventFailed, operation=EvtInfo_SPI_E_HARDWARE_ERROR.GetEventFailed
        OpEventGetEventFailed_GetEventFailed_EvtInfo_SteerFailrMtgtnLvl1LimpHomeMod: start-on-event=GetEventFailed, operation=EvtInfo_SteerFailrMtgtnLvl1LimpHomeMod.GetEventFailed
        OpEventGetEventFailed_GetEventFailed_EvtInfo_SteerFailrMtgtnLvl2LimpOver: start-on-event=GetEventFailed, operation=EvtInfo_SteerFailrMtgtnLvl2LimpOver.GetEventFailed
        OpEventGetEventFailed_GetEventFailed_EvtInfo_SteerFailrMtgtnLvl3FadeOut: start-on-event=GetEventFailed, operation=EvtInfo_SteerFailrMtgtnLvl3FadeOut.GetEventFailed
        OpEventGetEventFailed_GetEventFailed_EvtInfo_SteerWheelAgSnsrCalNorPrfmd: start-on-event=GetEventFailed, operation=EvtInfo_SteerWheelAgSnsrCalNorPrfmd.GetEventFailed
        OpEventGetEventFailed_GetEventFailed_EvtInfo_SteerWheelAgSnsrHwFlt: start-on-event=GetEventFailed, operation=EvtInfo_SteerWheelAgSnsrHwFlt.GetEventFailed
        OpEventGetEventFailed_GetEventFailed_EvtInfo_SteerWheelAgSnsrPlausly: start-on-event=GetEventFailed, operation=EvtInfo_SteerWheelAgSnsrPlausly.GetEventFailed
        OpEventGetEventFailed_GetEventFailed_EvtInfo_SteerWhlTqInpSnsr: start-on-event=GetEventFailed, operation=EvtInfo_SteerWhlTqInpSnsr.GetEventFailed
        OpEventGetEventFailed_GetEventFailed_EvtInfo_SteerWhlTqInpSnsrCalNoLrnd: start-on-event=GetEventFailed, operation=EvtInfo_SteerWhlTqInpSnsrCalNoLrnd.GetEventFailed
        OpEventGetEventFailed_GetEventFailed_EvtInfo_SysThermErrTHi: start-on-event=GetEventFailed, operation=EvtInfo_SysThermErrTHi.GetEventFailed
        OpEventGetEventFailed_GetEventFailed_EvtInfo_WDG_E_DISABLE_REJECTED: start-on-event=GetEventFailed, operation=EvtInfo_WDG_E_DISABLE_REJECTED.GetEventFailed
        OpEventGetEventFailed_GetEventFailed_EvtInfo_WDG_E_MODE_FAILED: start-on-event=GetEventFailed, operation=EvtInfo_WDG_E_MODE_FAILED.GetEventFailed
        OpEventGetEventFailed_GetEventFailed_EvtInfo_WDG_E_READBACK_FAILURE: start-on-event=GetEventFailed, operation=EvtInfo_WDG_E_READBACK_FAILURE.GetEventFailed
        OpEventGetEventFailed_GetEventFailed_EvtInfo_WDG_E_TRIGGER_TIMEOUT: start-on-event=GetEventFailed, operation=EvtInfo_WDG_E_TRIGGER_TIMEOUT.GetEventFailed
        OpEventGetEventFailed_GetEventFailed_GeneralEventInfo: start-on-event=GetEventFailed, operation=GeneralEventInfo.GetEventFailed
        OpEventGetEventFreezeFrameData_GetEventFreezeFrameData_Event_CtrlrComChassisExpBusOff: start-on-event=GetEventFreezeFrameData, operation=Event_CtrlrComChassisExpBusOff.GetEventFreezeFrameData
        OpEventGetEventFreezeFrameData_GetEventFreezeFrameData_Event_CtrlrComHiSpdBusOff: start-on-event=GetEventFreezeFrameData, operation=Event_CtrlrComHiSpdBusOff.GetEventFreezeFrameData
        OpEventGetEventFreezeFrameData_GetEventFreezeFrameData_Event_DevPwrVltgOverMaxThd: start-on-event=GetEventFreezeFrameData, operation=Event_DevPwrVltgOverMaxThd.GetEventFreezeFrameData
        OpEventGetEventFreezeFrameData_GetEventFreezeFrameData_Event_DevPwrVltgUnderMinThd: start-on-event=GetEventFreezeFrameData, operation=Event_DevPwrVltgUnderMinThd.GetEventFreezeFrameData
        OpEventGetEventFreezeFrameData_GetEventFreezeFrameData_Event_DevPwrVltgUnderThd: start-on-event=GetEventFreezeFrameData, operation=Event_DevPwrVltgUnderThd.GetEventFreezeFrameData
        OpEventGetEventFreezeFrameData_GetEventFreezeFrameData_Event_EcuHwPrfmc: start-on-event=GetEventFreezeFrameData, operation=Event_EcuHwPrfmc.GetEventFreezeFrameData
        OpEventGetEventFreezeFrameData_GetEventFreezeFrameData_Event_EcuSwPrfmcCalDataSetNotProgd: start-on-event=GetEventFreezeFrameData, operation=Event_EcuSwPrfmcCalDataSetNotProgd.GetEventFreezeFrameData
        OpEventGetEventFreezeFrameData_GetEventFreezeFrameData_Event_ElecSteerMotCirc: start-on-event=GetEventFreezeFrameData, operation=Event_ElecSteerMotCirc.GetEventFreezeFrameData
        OpEventGetEventFreezeFrameData_GetEventFreezeFrameData_Event_ElecSteerMotPosSnsrCir: start-on-event=GetEventFreezeFrameData, operation=Event_ElecSteerMotPosSnsrCir.GetEventFreezeFrameData
        OpEventGetEventFreezeFrameData_GetEventFreezeFrameData_Event_InvldDataRxdFromBodtCtrlMod: start-on-event=GetEventFreezeFrameData, operation=Event_InvldDataRxdFromBodtCtrlMod.GetEventFreezeFrameData
        OpEventGetEventFreezeFrameData_GetEventFreezeFrameData_Event_InvldDataRxdFromElecBrkCtrlMod: start-on-event=GetEventFreezeFrameData, operation=Event_InvldDataRxdFromElecBrkCtrlMod.GetEventFreezeFrameData
        OpEventGetEventFreezeFrameData_GetEventFreezeFrameData_Event_InvldDataRxdFromElecBrkCtrlModChassisExp: start-on-event=GetEventFreezeFrameData, operation=Event_InvldDataRxdFromElecBrkCtrlModChassisExp.GetEventFreezeFrameData
        OpEventGetEventFreezeFrameData_GetEventFreezeFrameData_Event_InvldDataRxdFromEngCtrlMod: start-on-event=GetEventFreezeFrameData, operation=Event_InvldDataRxdFromEngCtrlMod.GetEventFreezeFrameData
        OpEventGetEventFreezeFrameData_GetEventFreezeFrameData_Event_InvldDataRxdFromFrntCameraMod: start-on-event=GetEventFreezeFrameData, operation=Event_InvldDataRxdFromFrntCameraMod.GetEventFreezeFrameData
        OpEventGetEventFreezeFrameData_GetEventFreezeFrameData_Event_InvldDataRxdFromParkAssiCtrlMod: start-on-event=GetEventFreezeFrameData, operation=Event_InvldDataRxdFromParkAssiCtrlMod.GetEventFreezeFrameData
        OpEventGetEventFreezeFrameData_GetEventFreezeFrameData_Event_InvldDataRxdFromTrsmCtrlMod: start-on-event=GetEventFreezeFrameData, operation=Event_InvldDataRxdFromTrsmCtrlMod.GetEventFreezeFrameData
        OpEventGetEventFreezeFrameData_GetEventFreezeFrameData_Event_LostComWithBodyCtrlMod: start-on-event=GetEventFreezeFrameData, operation=Event_LostComWithBodyCtrlMod.GetEventFreezeFrameData
        OpEventGetEventFreezeFrameData_GetEventFreezeFrameData_Event_LostComWithElecBrkCtrlMod: start-on-event=GetEventFreezeFrameData, operation=Event_LostComWithElecBrkCtrlMod.GetEventFreezeFrameData
        OpEventGetEventFreezeFrameData_GetEventFreezeFrameData_Event_LostComWithElecBrkCtrlModChassisExp: start-on-event=GetEventFreezeFrameData, operation=Event_LostComWithElecBrkCtrlModChassisExp.GetEventFreezeFrameData
        OpEventGetEventFreezeFrameData_GetEventFreezeFrameData_Event_LostComWithEngCtrlMod: start-on-event=GetEventFreezeFrameData, operation=Event_LostComWithEngCtrlMod.GetEventFreezeFrameData
        OpEventGetEventFreezeFrameData_GetEventFreezeFrameData_Event_LostComWithFrntCameraCtrlMod: start-on-event=GetEventFreezeFrameData, operation=Event_LostComWithFrntCameraCtrlMod.GetEventFreezeFrameData
        OpEventGetEventFreezeFrameData_GetEventFreezeFrameData_Event_LostComWithParkAssiCtrlMod: start-on-event=GetEventFreezeFrameData, operation=Event_LostComWithParkAssiCtrlMod.GetEventFreezeFrameData
        OpEventGetEventFreezeFrameData_GetEventFreezeFrameData_Event_LostComWithTrsmCtrlMod: start-on-event=GetEventFreezeFrameData, operation=Event_LostComWithTrsmCtrlMod.GetEventFreezeFrameData
        OpEventGetEventFreezeFrameData_GetEventFreezeFrameData_Event_SteerFailrMtgtnLvl1LimpHomeMod: start-on-event=GetEventFreezeFrameData, operation=Event_SteerFailrMtgtnLvl1LimpHomeMod.GetEventFreezeFrameData
        OpEventGetEventFreezeFrameData_GetEventFreezeFrameData_Event_SteerFailrMtgtnLvl2LimpOver: start-on-event=GetEventFreezeFrameData, operation=Event_SteerFailrMtgtnLvl2LimpOver.GetEventFreezeFrameData
        OpEventGetEventFreezeFrameData_GetEventFreezeFrameData_Event_SteerFailrMtgtnLvl3FadeOut: start-on-event=GetEventFreezeFrameData, operation=Event_SteerFailrMtgtnLvl3FadeOut.GetEventFreezeFrameData
        OpEventGetEventFreezeFrameData_GetEventFreezeFrameData_Event_SteerWheelAgSnsrCalNorPrfmd: start-on-event=GetEventFreezeFrameData, operation=Event_SteerWheelAgSnsrCalNorPrfmd.GetEventFreezeFrameData
        OpEventGetEventFreezeFrameData_GetEventFreezeFrameData_Event_SteerWheelAgSnsrHwFlt: start-on-event=GetEventFreezeFrameData, operation=Event_SteerWheelAgSnsrHwFlt.GetEventFreezeFrameData
        OpEventGetEventFreezeFrameData_GetEventFreezeFrameData_Event_SteerWheelAgSnsrPlausly: start-on-event=GetEventFreezeFrameData, operation=Event_SteerWheelAgSnsrPlausly.GetEventFreezeFrameData
        OpEventGetEventFreezeFrameData_GetEventFreezeFrameData_Event_SteerWhlTqInpSnsr: start-on-event=GetEventFreezeFrameData, operation=Event_SteerWhlTqInpSnsr.GetEventFreezeFrameData
        OpEventGetEventFreezeFrameData_GetEventFreezeFrameData_Event_SteerWhlTqInpSnsrCalNoLrnd: start-on-event=GetEventFreezeFrameData, operation=Event_SteerWhlTqInpSnsrCalNoLrnd.GetEventFreezeFrameData
        OpEventGetEventFreezeFrameData_GetEventFreezeFrameData_Event_SysThermErrTHi: start-on-event=GetEventFreezeFrameData, operation=Event_SysThermErrTHi.GetEventFreezeFrameData
        OpEventGetEventFreezeFrameData_GetEventFreezeFrameData_EvtInfo_CtrlrComChassisExpBusOff: start-on-event=GetEventFreezeFrameData, operation=EvtInfo_CtrlrComChassisExpBusOff.GetEventFreezeFrameData
        OpEventGetEventFreezeFrameData_GetEventFreezeFrameData_EvtInfo_CtrlrComHiSpdBusOff: start-on-event=GetEventFreezeFrameData, operation=EvtInfo_CtrlrComHiSpdBusOff.GetEventFreezeFrameData
        OpEventGetEventFreezeFrameData_GetEventFreezeFrameData_EvtInfo_DevPwrVltgOverMaxThd: start-on-event=GetEventFreezeFrameData, operation=EvtInfo_DevPwrVltgOverMaxThd.GetEventFreezeFrameData
        OpEventGetEventFreezeFrameData_GetEventFreezeFrameData_EvtInfo_DevPwrVltgUnderMinThd: start-on-event=GetEventFreezeFrameData, operation=EvtInfo_DevPwrVltgUnderMinThd.GetEventFreezeFrameData
        OpEventGetEventFreezeFrameData_GetEventFreezeFrameData_EvtInfo_DevPwrVltgUnderThd: start-on-event=GetEventFreezeFrameData, operation=EvtInfo_DevPwrVltgUnderThd.GetEventFreezeFrameData
        OpEventGetEventFreezeFrameData_GetEventFreezeFrameData_EvtInfo_EcuHwPrfmc: start-on-event=GetEventFreezeFrameData, operation=EvtInfo_EcuHwPrfmc.GetEventFreezeFrameData
        OpEventGetEventFreezeFrameData_GetEventFreezeFrameData_EvtInfo_EcuSwPrfmcCalDataSetNotProgd: start-on-event=GetEventFreezeFrameData, operation=EvtInfo_EcuSwPrfmcCalDataSetNotProgd.GetEventFreezeFrameData
        OpEventGetEventFreezeFrameData_GetEventFreezeFrameData_EvtInfo_ElecSteerMotCirc: start-on-event=GetEventFreezeFrameData, operation=EvtInfo_ElecSteerMotCirc.GetEventFreezeFrameData
        OpEventGetEventFreezeFrameData_GetEventFreezeFrameData_EvtInfo_ElecSteerMotPosSnsrCir: start-on-event=GetEventFreezeFrameData, operation=EvtInfo_ElecSteerMotPosSnsrCir.GetEventFreezeFrameData
        OpEventGetEventFreezeFrameData_GetEventFreezeFrameData_EvtInfo_FLS_E_COMPARE_FAILED: start-on-event=GetEventFreezeFrameData, operation=EvtInfo_FLS_E_COMPARE_FAILED.GetEventFreezeFrameData
        OpEventGetEventFreezeFrameData_GetEventFreezeFrameData_EvtInfo_FLS_E_ERASE_FAILED: start-on-event=GetEventFreezeFrameData, operation=EvtInfo_FLS_E_ERASE_FAILED.GetEventFreezeFrameData
        OpEventGetEventFreezeFrameData_GetEventFreezeFrameData_EvtInfo_FLS_E_READ_FAILED: start-on-event=GetEventFreezeFrameData, operation=EvtInfo_FLS_E_READ_FAILED.GetEventFreezeFrameData
        OpEventGetEventFreezeFrameData_GetEventFreezeFrameData_EvtInfo_FLS_E_READ_FAILED_DED: start-on-event=GetEventFreezeFrameData, operation=EvtInfo_FLS_E_READ_FAILED_DED.GetEventFreezeFrameData
        OpEventGetEventFreezeFrameData_GetEventFreezeFrameData_EvtInfo_FLS_E_WRITE_FAILED: start-on-event=GetEventFreezeFrameData, operation=EvtInfo_FLS_E_WRITE_FAILED.GetEventFreezeFrameData
        OpEventGetEventFreezeFrameData_GetEventFreezeFrameData_EvtInfo_InvldDataRxdFromBodtCtrlMod: start-on-event=GetEventFreezeFrameData, operation=EvtInfo_InvldDataRxdFromBodtCtrlMod.GetEventFreezeFrameData
        OpEventGetEventFreezeFrameData_GetEventFreezeFrameData_EvtInfo_InvldDataRxdFromElecBrkCtrlMod: start-on-event=GetEventFreezeFrameData, operation=EvtInfo_InvldDataRxdFromElecBrkCtrlMod.GetEventFreezeFrameData
        OpEventGetEventFreezeFrameData_GetEventFreezeFrameData_EvtInfo_InvldDataRxdFromElecBrkCtrlModChassisExp: start-on-event=GetEventFreezeFrameData, operation=EvtInfo_InvldDataRxdFromElecBrkCtrlModChassisExp.GetEventFreezeFrameData
        OpEventGetEventFreezeFrameData_GetEventFreezeFrameData_EvtInfo_InvldDataRxdFromEngCtrlMod: start-on-event=GetEventFreezeFrameData, operation=EvtInfo_InvldDataRxdFromEngCtrlMod.GetEventFreezeFrameData
        OpEventGetEventFreezeFrameData_GetEventFreezeFrameData_EvtInfo_InvldDataRxdFromFrntCameraMod: start-on-event=GetEventFreezeFrameData, operation=EvtInfo_InvldDataRxdFromFrntCameraMod.GetEventFreezeFrameData
        OpEventGetEventFreezeFrameData_GetEventFreezeFrameData_EvtInfo_InvldDataRxdFromParkAssiCtrlMod: start-on-event=GetEventFreezeFrameData, operation=EvtInfo_InvldDataRxdFromParkAssiCtrlMod.GetEventFreezeFrameData
        OpEventGetEventFreezeFrameData_GetEventFreezeFrameData_EvtInfo_InvldDataRxdFromTrsmCtrlMod: start-on-event=GetEventFreezeFrameData, operation=EvtInfo_InvldDataRxdFromTrsmCtrlMod.GetEventFreezeFrameData
        OpEventGetEventFreezeFrameData_GetEventFreezeFrameData_EvtInfo_LostComWithBodyCtrlMod: start-on-event=GetEventFreezeFrameData, operation=EvtInfo_LostComWithBodyCtrlMod.GetEventFreezeFrameData
        OpEventGetEventFreezeFrameData_GetEventFreezeFrameData_EvtInfo_LostComWithElecBrkCtrlMod: start-on-event=GetEventFreezeFrameData, operation=EvtInfo_LostComWithElecBrkCtrlMod.GetEventFreezeFrameData
        OpEventGetEventFreezeFrameData_GetEventFreezeFrameData_EvtInfo_LostComWithElecBrkCtrlModChassisExp: start-on-event=GetEventFreezeFrameData, operation=EvtInfo_LostComWithElecBrkCtrlModChassisExp.GetEventFreezeFrameData
        OpEventGetEventFreezeFrameData_GetEventFreezeFrameData_EvtInfo_LostComWithEngCtrlMod: start-on-event=GetEventFreezeFrameData, operation=EvtInfo_LostComWithEngCtrlMod.GetEventFreezeFrameData
        OpEventGetEventFreezeFrameData_GetEventFreezeFrameData_EvtInfo_LostComWithFrntCameraCtrlMod: start-on-event=GetEventFreezeFrameData, operation=EvtInfo_LostComWithFrntCameraCtrlMod.GetEventFreezeFrameData
        OpEventGetEventFreezeFrameData_GetEventFreezeFrameData_EvtInfo_LostComWithParkAssiCtrlMod: start-on-event=GetEventFreezeFrameData, operation=EvtInfo_LostComWithParkAssiCtrlMod.GetEventFreezeFrameData
        OpEventGetEventFreezeFrameData_GetEventFreezeFrameData_EvtInfo_LostComWithTrsmCtrlMod: start-on-event=GetEventFreezeFrameData, operation=EvtInfo_LostComWithTrsmCtrlMod.GetEventFreezeFrameData
        OpEventGetEventFreezeFrameData_GetEventFreezeFrameData_EvtInfo_MCU_E_CLM_SELFDIAG_FAILURE: start-on-event=GetEventFreezeFrameData, operation=EvtInfo_MCU_E_CLM_SELFDIAG_FAILURE.GetEventFreezeFrameData
        OpEventGetEventFreezeFrameData_GetEventFreezeFrameData_EvtInfo_MCU_E_CLOCK_FAILURE: start-on-event=GetEventFreezeFrameData, operation=EvtInfo_MCU_E_CLOCK_FAILURE.GetEventFreezeFrameData
        OpEventGetEventFreezeFrameData_GetEventFreezeFrameData_EvtInfo_MCU_E_CVM_SELFDIAG_FAILURE: start-on-event=GetEventFreezeFrameData, operation=EvtInfo_MCU_E_CVM_SELFDIAG_FAILURE.GetEventFreezeFrameData
        OpEventGetEventFreezeFrameData_GetEventFreezeFrameData_EvtInfo_MCU_E_ECM_SELFDIAG_FAILURE: start-on-event=GetEventFreezeFrameData, operation=EvtInfo_MCU_E_ECM_SELFDIAG_FAILURE.GetEventFreezeFrameData
        OpEventGetEventFreezeFrameData_GetEventFreezeFrameData_EvtInfo_MCU_E_LOCKSTEP_SELFDIAG_FAILURE: start-on-event=GetEventFreezeFrameData, operation=EvtInfo_MCU_E_LOCKSTEP_SELFDIAG_FAILURE.GetEventFreezeFrameData
        OpEventGetEventFreezeFrameData_GetEventFreezeFrameData_EvtInfo_MCU_E_WRITE_TIMEOUT_FAILURE: start-on-event=GetEventFreezeFrameData, operation=EvtInfo_MCU_E_WRITE_TIMEOUT_FAILURE.GetEventFreezeFrameData
        OpEventGetEventFreezeFrameData_GetEventFreezeFrameData_EvtInfo_NVM_E_INTEGRITY_FAILED: start-on-event=GetEventFreezeFrameData, operation=EvtInfo_NVM_E_INTEGRITY_FAILED.GetEventFreezeFrameData
        OpEventGetEventFreezeFrameData_GetEventFreezeFrameData_EvtInfo_NVM_E_LOSS_OF_REDUNDANCY: start-on-event=GetEventFreezeFrameData, operation=EvtInfo_NVM_E_LOSS_OF_REDUNDANCY.GetEventFreezeFrameData
        OpEventGetEventFreezeFrameData_GetEventFreezeFrameData_EvtInfo_NVM_E_QUEUE_OVERFLOW: start-on-event=GetEventFreezeFrameData, operation=EvtInfo_NVM_E_QUEUE_OVERFLOW.GetEventFreezeFrameData
        OpEventGetEventFreezeFrameData_GetEventFreezeFrameData_EvtInfo_NVM_E_REQ_FAILED: start-on-event=GetEventFreezeFrameData, operation=EvtInfo_NVM_E_REQ_FAILED.GetEventFreezeFrameData
        OpEventGetEventFreezeFrameData_GetEventFreezeFrameData_EvtInfo_NVM_E_VERIFY_FAILED: start-on-event=GetEventFreezeFrameData, operation=EvtInfo_NVM_E_VERIFY_FAILED.GetEventFreezeFrameData
        OpEventGetEventFreezeFrameData_GetEventFreezeFrameData_EvtInfo_NVM_E_WRITE_PROTECTED: start-on-event=GetEventFreezeFrameData, operation=EvtInfo_NVM_E_WRITE_PROTECTED.GetEventFreezeFrameData
        OpEventGetEventFreezeFrameData_GetEventFreezeFrameData_EvtInfo_NVM_E_WRONG_BLOCK_ID: start-on-event=GetEventFreezeFrameData, operation=EvtInfo_NVM_E_WRONG_BLOCK_ID.GetEventFreezeFrameData
        OpEventGetEventFreezeFrameData_GetEventFreezeFrameData_EvtInfo_PORT_E_WRITE_TIMEOUT_FAILURE: start-on-event=GetEventFreezeFrameData, operation=EvtInfo_PORT_E_WRITE_TIMEOUT_FAILURE.GetEventFreezeFrameData
        OpEventGetEventFreezeFrameData_GetEventFreezeFrameData_EvtInfo_SPI_E_DATA_TX_TIMEOUT_FAILURE: start-on-event=GetEventFreezeFrameData, operation=EvtInfo_SPI_E_DATA_TX_TIMEOUT_FAILURE.GetEventFreezeFrameData
        OpEventGetEventFreezeFrameData_GetEventFreezeFrameData_EvtInfo_SPI_E_HARDWARE_ERROR: start-on-event=GetEventFreezeFrameData, operation=EvtInfo_SPI_E_HARDWARE_ERROR.GetEventFreezeFrameData
        OpEventGetEventFreezeFrameData_GetEventFreezeFrameData_EvtInfo_SteerFailrMtgtnLvl1LimpHomeMod: start-on-event=GetEventFreezeFrameData, operation=EvtInfo_SteerFailrMtgtnLvl1LimpHomeMod.GetEventFreezeFrameData
        OpEventGetEventFreezeFrameData_GetEventFreezeFrameData_EvtInfo_SteerFailrMtgtnLvl2LimpOver: start-on-event=GetEventFreezeFrameData, operation=EvtInfo_SteerFailrMtgtnLvl2LimpOver.GetEventFreezeFrameData
        OpEventGetEventFreezeFrameData_GetEventFreezeFrameData_EvtInfo_SteerFailrMtgtnLvl3FadeOut: start-on-event=GetEventFreezeFrameData, operation=EvtInfo_SteerFailrMtgtnLvl3FadeOut.GetEventFreezeFrameData
        OpEventGetEventFreezeFrameData_GetEventFreezeFrameData_EvtInfo_SteerWheelAgSnsrCalNorPrfmd: start-on-event=GetEventFreezeFrameData, operation=EvtInfo_SteerWheelAgSnsrCalNorPrfmd.GetEventFreezeFrameData
        OpEventGetEventFreezeFrameData_GetEventFreezeFrameData_EvtInfo_SteerWheelAgSnsrHwFlt: start-on-event=GetEventFreezeFrameData, operation=EvtInfo_SteerWheelAgSnsrHwFlt.GetEventFreezeFrameData
        OpEventGetEventFreezeFrameData_GetEventFreezeFrameData_EvtInfo_SteerWheelAgSnsrPlausly: start-on-event=GetEventFreezeFrameData, operation=EvtInfo_SteerWheelAgSnsrPlausly.GetEventFreezeFrameData
        OpEventGetEventFreezeFrameData_GetEventFreezeFrameData_EvtInfo_SteerWhlTqInpSnsr: start-on-event=GetEventFreezeFrameData, operation=EvtInfo_SteerWhlTqInpSnsr.GetEventFreezeFrameData
        OpEventGetEventFreezeFrameData_GetEventFreezeFrameData_EvtInfo_SteerWhlTqInpSnsrCalNoLrnd: start-on-event=GetEventFreezeFrameData, operation=EvtInfo_SteerWhlTqInpSnsrCalNoLrnd.GetEventFreezeFrameData
        OpEventGetEventFreezeFrameData_GetEventFreezeFrameData_EvtInfo_SysThermErrTHi: start-on-event=GetEventFreezeFrameData, operation=EvtInfo_SysThermErrTHi.GetEventFreezeFrameData
        OpEventGetEventFreezeFrameData_GetEventFreezeFrameData_EvtInfo_WDG_E_DISABLE_REJECTED: start-on-event=GetEventFreezeFrameData, operation=EvtInfo_WDG_E_DISABLE_REJECTED.GetEventFreezeFrameData
        OpEventGetEventFreezeFrameData_GetEventFreezeFrameData_EvtInfo_WDG_E_MODE_FAILED: start-on-event=GetEventFreezeFrameData, operation=EvtInfo_WDG_E_MODE_FAILED.GetEventFreezeFrameData
        OpEventGetEventFreezeFrameData_GetEventFreezeFrameData_EvtInfo_WDG_E_READBACK_FAILURE: start-on-event=GetEventFreezeFrameData, operation=EvtInfo_WDG_E_READBACK_FAILURE.GetEventFreezeFrameData
        OpEventGetEventFreezeFrameData_GetEventFreezeFrameData_EvtInfo_WDG_E_TRIGGER_TIMEOUT: start-on-event=GetEventFreezeFrameData, operation=EvtInfo_WDG_E_TRIGGER_TIMEOUT.GetEventFreezeFrameData
        OpEventGetEventFreezeFrameData_GetEventFreezeFrameData_GeneralEventInfo: start-on-event=GetEventFreezeFrameData, operation=GeneralEventInfo.GetEventFreezeFrameData
        OpEventGetEventMemoryOverflow_GetEventMemoryOverflow_OverflowIndPrimaryMemory: start-on-event=GetEventMemoryOverflow, operation=OverflowIndPrimaryMemory.GetEventMemoryOverflow
        OpEventGetEventStatus_GetEventStatus_Event_CtrlrComChassisExpBusOff: start-on-event=GetEventStatus, operation=Event_CtrlrComChassisExpBusOff.GetEventStatus
        OpEventGetEventStatus_GetEventStatus_Event_CtrlrComHiSpdBusOff: start-on-event=GetEventStatus, operation=Event_CtrlrComHiSpdBusOff.GetEventStatus
        OpEventGetEventStatus_GetEventStatus_Event_DevPwrVltgOverMaxThd: start-on-event=GetEventStatus, operation=Event_DevPwrVltgOverMaxThd.GetEventStatus
        OpEventGetEventStatus_GetEventStatus_Event_DevPwrVltgUnderMinThd: start-on-event=GetEventStatus, operation=Event_DevPwrVltgUnderMinThd.GetEventStatus
        OpEventGetEventStatus_GetEventStatus_Event_DevPwrVltgUnderThd: start-on-event=GetEventStatus, operation=Event_DevPwrVltgUnderThd.GetEventStatus
        OpEventGetEventStatus_GetEventStatus_Event_EcuHwPrfmc: start-on-event=GetEventStatus, operation=Event_EcuHwPrfmc.GetEventStatus
        OpEventGetEventStatus_GetEventStatus_Event_EcuSwPrfmcCalDataSetNotProgd: start-on-event=GetEventStatus, operation=Event_EcuSwPrfmcCalDataSetNotProgd.GetEventStatus
        OpEventGetEventStatus_GetEventStatus_Event_ElecSteerMotCirc: start-on-event=GetEventStatus, operation=Event_ElecSteerMotCirc.GetEventStatus
        OpEventGetEventStatus_GetEventStatus_Event_ElecSteerMotPosSnsrCir: start-on-event=GetEventStatus, operation=Event_ElecSteerMotPosSnsrCir.GetEventStatus
        OpEventGetEventStatus_GetEventStatus_Event_InvldDataRxdFromBodtCtrlMod: start-on-event=GetEventStatus, operation=Event_InvldDataRxdFromBodtCtrlMod.GetEventStatus
        OpEventGetEventStatus_GetEventStatus_Event_InvldDataRxdFromElecBrkCtrlMod: start-on-event=GetEventStatus, operation=Event_InvldDataRxdFromElecBrkCtrlMod.GetEventStatus
        OpEventGetEventStatus_GetEventStatus_Event_InvldDataRxdFromElecBrkCtrlModChassisExp: start-on-event=GetEventStatus, operation=Event_InvldDataRxdFromElecBrkCtrlModChassisExp.GetEventStatus
        OpEventGetEventStatus_GetEventStatus_Event_InvldDataRxdFromEngCtrlMod: start-on-event=GetEventStatus, operation=Event_InvldDataRxdFromEngCtrlMod.GetEventStatus
        OpEventGetEventStatus_GetEventStatus_Event_InvldDataRxdFromFrntCameraMod: start-on-event=GetEventStatus, operation=Event_InvldDataRxdFromFrntCameraMod.GetEventStatus
        OpEventGetEventStatus_GetEventStatus_Event_InvldDataRxdFromParkAssiCtrlMod: start-on-event=GetEventStatus, operation=Event_InvldDataRxdFromParkAssiCtrlMod.GetEventStatus
        OpEventGetEventStatus_GetEventStatus_Event_InvldDataRxdFromTrsmCtrlMod: start-on-event=GetEventStatus, operation=Event_InvldDataRxdFromTrsmCtrlMod.GetEventStatus
        OpEventGetEventStatus_GetEventStatus_Event_LostComWithBodyCtrlMod: start-on-event=GetEventStatus, operation=Event_LostComWithBodyCtrlMod.GetEventStatus
        OpEventGetEventStatus_GetEventStatus_Event_LostComWithElecBrkCtrlMod: start-on-event=GetEventStatus, operation=Event_LostComWithElecBrkCtrlMod.GetEventStatus
        OpEventGetEventStatus_GetEventStatus_Event_LostComWithElecBrkCtrlModChassisExp: start-on-event=GetEventStatus, operation=Event_LostComWithElecBrkCtrlModChassisExp.GetEventStatus
        OpEventGetEventStatus_GetEventStatus_Event_LostComWithEngCtrlMod: start-on-event=GetEventStatus, operation=Event_LostComWithEngCtrlMod.GetEventStatus
        OpEventGetEventStatus_GetEventStatus_Event_LostComWithFrntCameraCtrlMod: start-on-event=GetEventStatus, operation=Event_LostComWithFrntCameraCtrlMod.GetEventStatus
        OpEventGetEventStatus_GetEventStatus_Event_LostComWithParkAssiCtrlMod: start-on-event=GetEventStatus, operation=Event_LostComWithParkAssiCtrlMod.GetEventStatus
        OpEventGetEventStatus_GetEventStatus_Event_LostComWithTrsmCtrlMod: start-on-event=GetEventStatus, operation=Event_LostComWithTrsmCtrlMod.GetEventStatus
        OpEventGetEventStatus_GetEventStatus_Event_SteerFailrMtgtnLvl1LimpHomeMod: start-on-event=GetEventStatus, operation=Event_SteerFailrMtgtnLvl1LimpHomeMod.GetEventStatus
        OpEventGetEventStatus_GetEventStatus_Event_SteerFailrMtgtnLvl2LimpOver: start-on-event=GetEventStatus, operation=Event_SteerFailrMtgtnLvl2LimpOver.GetEventStatus
        OpEventGetEventStatus_GetEventStatus_Event_SteerFailrMtgtnLvl3FadeOut: start-on-event=GetEventStatus, operation=Event_SteerFailrMtgtnLvl3FadeOut.GetEventStatus
        OpEventGetEventStatus_GetEventStatus_Event_SteerWheelAgSnsrCalNorPrfmd: start-on-event=GetEventStatus, operation=Event_SteerWheelAgSnsrCalNorPrfmd.GetEventStatus
        OpEventGetEventStatus_GetEventStatus_Event_SteerWheelAgSnsrHwFlt: start-on-event=GetEventStatus, operation=Event_SteerWheelAgSnsrHwFlt.GetEventStatus
        OpEventGetEventStatus_GetEventStatus_Event_SteerWheelAgSnsrPlausly: start-on-event=GetEventStatus, operation=Event_SteerWheelAgSnsrPlausly.GetEventStatus
        OpEventGetEventStatus_GetEventStatus_Event_SteerWhlTqInpSnsr: start-on-event=GetEventStatus, operation=Event_SteerWhlTqInpSnsr.GetEventStatus
        OpEventGetEventStatus_GetEventStatus_Event_SteerWhlTqInpSnsrCalNoLrnd: start-on-event=GetEventStatus, operation=Event_SteerWhlTqInpSnsrCalNoLrnd.GetEventStatus
        OpEventGetEventStatus_GetEventStatus_Event_SysThermErrTHi: start-on-event=GetEventStatus, operation=Event_SysThermErrTHi.GetEventStatus
        OpEventGetEventStatus_GetEventStatus_EvtInfo_CtrlrComChassisExpBusOff: start-on-event=GetEventStatus, operation=EvtInfo_CtrlrComChassisExpBusOff.GetEventStatus
        OpEventGetEventStatus_GetEventStatus_EvtInfo_CtrlrComHiSpdBusOff: start-on-event=GetEventStatus, operation=EvtInfo_CtrlrComHiSpdBusOff.GetEventStatus
        OpEventGetEventStatus_GetEventStatus_EvtInfo_DevPwrVltgOverMaxThd: start-on-event=GetEventStatus, operation=EvtInfo_DevPwrVltgOverMaxThd.GetEventStatus
        OpEventGetEventStatus_GetEventStatus_EvtInfo_DevPwrVltgUnderMinThd: start-on-event=GetEventStatus, operation=EvtInfo_DevPwrVltgUnderMinThd.GetEventStatus
        OpEventGetEventStatus_GetEventStatus_EvtInfo_DevPwrVltgUnderThd: start-on-event=GetEventStatus, operation=EvtInfo_DevPwrVltgUnderThd.GetEventStatus
        OpEventGetEventStatus_GetEventStatus_EvtInfo_EcuHwPrfmc: start-on-event=GetEventStatus, operation=EvtInfo_EcuHwPrfmc.GetEventStatus
        OpEventGetEventStatus_GetEventStatus_EvtInfo_EcuSwPrfmcCalDataSetNotProgd: start-on-event=GetEventStatus, operation=EvtInfo_EcuSwPrfmcCalDataSetNotProgd.GetEventStatus
        OpEventGetEventStatus_GetEventStatus_EvtInfo_ElecSteerMotCirc: start-on-event=GetEventStatus, operation=EvtInfo_ElecSteerMotCirc.GetEventStatus
        OpEventGetEventStatus_GetEventStatus_EvtInfo_ElecSteerMotPosSnsrCir: start-on-event=GetEventStatus, operation=EvtInfo_ElecSteerMotPosSnsrCir.GetEventStatus
        OpEventGetEventStatus_GetEventStatus_EvtInfo_FLS_E_COMPARE_FAILED: start-on-event=GetEventStatus, operation=EvtInfo_FLS_E_COMPARE_FAILED.GetEventStatus
        OpEventGetEventStatus_GetEventStatus_EvtInfo_FLS_E_ERASE_FAILED: start-on-event=GetEventStatus, operation=EvtInfo_FLS_E_ERASE_FAILED.GetEventStatus
        OpEventGetEventStatus_GetEventStatus_EvtInfo_FLS_E_READ_FAILED: start-on-event=GetEventStatus, operation=EvtInfo_FLS_E_READ_FAILED.GetEventStatus
        OpEventGetEventStatus_GetEventStatus_EvtInfo_FLS_E_READ_FAILED_DED: start-on-event=GetEventStatus, operation=EvtInfo_FLS_E_READ_FAILED_DED.GetEventStatus
        OpEventGetEventStatus_GetEventStatus_EvtInfo_FLS_E_WRITE_FAILED: start-on-event=GetEventStatus, operation=EvtInfo_FLS_E_WRITE_FAILED.GetEventStatus
        OpEventGetEventStatus_GetEventStatus_EvtInfo_InvldDataRxdFromBodtCtrlMod: start-on-event=GetEventStatus, operation=EvtInfo_InvldDataRxdFromBodtCtrlMod.GetEventStatus
        OpEventGetEventStatus_GetEventStatus_EvtInfo_InvldDataRxdFromElecBrkCtrlMod: start-on-event=GetEventStatus, operation=EvtInfo_InvldDataRxdFromElecBrkCtrlMod.GetEventStatus
        OpEventGetEventStatus_GetEventStatus_EvtInfo_InvldDataRxdFromElecBrkCtrlModChassisExp: start-on-event=GetEventStatus, operation=EvtInfo_InvldDataRxdFromElecBrkCtrlModChassisExp.GetEventStatus
        OpEventGetEventStatus_GetEventStatus_EvtInfo_InvldDataRxdFromEngCtrlMod: start-on-event=GetEventStatus, operation=EvtInfo_InvldDataRxdFromEngCtrlMod.GetEventStatus
        OpEventGetEventStatus_GetEventStatus_EvtInfo_InvldDataRxdFromFrntCameraMod: start-on-event=GetEventStatus, operation=EvtInfo_InvldDataRxdFromFrntCameraMod.GetEventStatus
        OpEventGetEventStatus_GetEventStatus_EvtInfo_InvldDataRxdFromParkAssiCtrlMod: start-on-event=GetEventStatus, operation=EvtInfo_InvldDataRxdFromParkAssiCtrlMod.GetEventStatus
        OpEventGetEventStatus_GetEventStatus_EvtInfo_InvldDataRxdFromTrsmCtrlMod: start-on-event=GetEventStatus, operation=EvtInfo_InvldDataRxdFromTrsmCtrlMod.GetEventStatus
        OpEventGetEventStatus_GetEventStatus_EvtInfo_LostComWithBodyCtrlMod: start-on-event=GetEventStatus, operation=EvtInfo_LostComWithBodyCtrlMod.GetEventStatus
        OpEventGetEventStatus_GetEventStatus_EvtInfo_LostComWithElecBrkCtrlMod: start-on-event=GetEventStatus, operation=EvtInfo_LostComWithElecBrkCtrlMod.GetEventStatus
        OpEventGetEventStatus_GetEventStatus_EvtInfo_LostComWithElecBrkCtrlModChassisExp: start-on-event=GetEventStatus, operation=EvtInfo_LostComWithElecBrkCtrlModChassisExp.GetEventStatus
        OpEventGetEventStatus_GetEventStatus_EvtInfo_LostComWithEngCtrlMod: start-on-event=GetEventStatus, operation=EvtInfo_LostComWithEngCtrlMod.GetEventStatus
        OpEventGetEventStatus_GetEventStatus_EvtInfo_LostComWithFrntCameraCtrlMod: start-on-event=GetEventStatus, operation=EvtInfo_LostComWithFrntCameraCtrlMod.GetEventStatus
        OpEventGetEventStatus_GetEventStatus_EvtInfo_LostComWithParkAssiCtrlMod: start-on-event=GetEventStatus, operation=EvtInfo_LostComWithParkAssiCtrlMod.GetEventStatus
        OpEventGetEventStatus_GetEventStatus_EvtInfo_LostComWithTrsmCtrlMod: start-on-event=GetEventStatus, operation=EvtInfo_LostComWithTrsmCtrlMod.GetEventStatus
        OpEventGetEventStatus_GetEventStatus_EvtInfo_MCU_E_CLM_SELFDIAG_FAILURE: start-on-event=GetEventStatus, operation=EvtInfo_MCU_E_CLM_SELFDIAG_FAILURE.GetEventStatus
        OpEventGetEventStatus_GetEventStatus_EvtInfo_MCU_E_CLOCK_FAILURE: start-on-event=GetEventStatus, operation=EvtInfo_MCU_E_CLOCK_FAILURE.GetEventStatus
        OpEventGetEventStatus_GetEventStatus_EvtInfo_MCU_E_CVM_SELFDIAG_FAILURE: start-on-event=GetEventStatus, operation=EvtInfo_MCU_E_CVM_SELFDIAG_FAILURE.GetEventStatus
        OpEventGetEventStatus_GetEventStatus_EvtInfo_MCU_E_ECM_SELFDIAG_FAILURE: start-on-event=GetEventStatus, operation=EvtInfo_MCU_E_ECM_SELFDIAG_FAILURE.GetEventStatus
        OpEventGetEventStatus_GetEventStatus_EvtInfo_MCU_E_LOCKSTEP_SELFDIAG_FAILURE: start-on-event=GetEventStatus, operation=EvtInfo_MCU_E_LOCKSTEP_SELFDIAG_FAILURE.GetEventStatus
        OpEventGetEventStatus_GetEventStatus_EvtInfo_MCU_E_WRITE_TIMEOUT_FAILURE: start-on-event=GetEventStatus, operation=EvtInfo_MCU_E_WRITE_TIMEOUT_FAILURE.GetEventStatus
        OpEventGetEventStatus_GetEventStatus_EvtInfo_NVM_E_INTEGRITY_FAILED: start-on-event=GetEventStatus, operation=EvtInfo_NVM_E_INTEGRITY_FAILED.GetEventStatus
        OpEventGetEventStatus_GetEventStatus_EvtInfo_NVM_E_LOSS_OF_REDUNDANCY: start-on-event=GetEventStatus, operation=EvtInfo_NVM_E_LOSS_OF_REDUNDANCY.GetEventStatus
        OpEventGetEventStatus_GetEventStatus_EvtInfo_NVM_E_QUEUE_OVERFLOW: start-on-event=GetEventStatus, operation=EvtInfo_NVM_E_QUEUE_OVERFLOW.GetEventStatus
        OpEventGetEventStatus_GetEventStatus_EvtInfo_NVM_E_REQ_FAILED: start-on-event=GetEventStatus, operation=EvtInfo_NVM_E_REQ_FAILED.GetEventStatus
        OpEventGetEventStatus_GetEventStatus_EvtInfo_NVM_E_VERIFY_FAILED: start-on-event=GetEventStatus, operation=EvtInfo_NVM_E_VERIFY_FAILED.GetEventStatus
        OpEventGetEventStatus_GetEventStatus_EvtInfo_NVM_E_WRITE_PROTECTED: start-on-event=GetEventStatus, operation=EvtInfo_NVM_E_WRITE_PROTECTED.GetEventStatus
        OpEventGetEventStatus_GetEventStatus_EvtInfo_NVM_E_WRONG_BLOCK_ID: start-on-event=GetEventStatus, operation=EvtInfo_NVM_E_WRONG_BLOCK_ID.GetEventStatus
        OpEventGetEventStatus_GetEventStatus_EvtInfo_PORT_E_WRITE_TIMEOUT_FAILURE: start-on-event=GetEventStatus, operation=EvtInfo_PORT_E_WRITE_TIMEOUT_FAILURE.GetEventStatus
        OpEventGetEventStatus_GetEventStatus_EvtInfo_SPI_E_DATA_TX_TIMEOUT_FAILURE: start-on-event=GetEventStatus, operation=EvtInfo_SPI_E_DATA_TX_TIMEOUT_FAILURE.GetEventStatus
        OpEventGetEventStatus_GetEventStatus_EvtInfo_SPI_E_HARDWARE_ERROR: start-on-event=GetEventStatus, operation=EvtInfo_SPI_E_HARDWARE_ERROR.GetEventStatus
        OpEventGetEventStatus_GetEventStatus_EvtInfo_SteerFailrMtgtnLvl1LimpHomeMod: start-on-event=GetEventStatus, operation=EvtInfo_SteerFailrMtgtnLvl1LimpHomeMod.GetEventStatus
        OpEventGetEventStatus_GetEventStatus_EvtInfo_SteerFailrMtgtnLvl2LimpOver: start-on-event=GetEventStatus, operation=EvtInfo_SteerFailrMtgtnLvl2LimpOver.GetEventStatus
        OpEventGetEventStatus_GetEventStatus_EvtInfo_SteerFailrMtgtnLvl3FadeOut: start-on-event=GetEventStatus, operation=EvtInfo_SteerFailrMtgtnLvl3FadeOut.GetEventStatus
        OpEventGetEventStatus_GetEventStatus_EvtInfo_SteerWheelAgSnsrCalNorPrfmd: start-on-event=GetEventStatus, operation=EvtInfo_SteerWheelAgSnsrCalNorPrfmd.GetEventStatus
        OpEventGetEventStatus_GetEventStatus_EvtInfo_SteerWheelAgSnsrHwFlt: start-on-event=GetEventStatus, operation=EvtInfo_SteerWheelAgSnsrHwFlt.GetEventStatus
        OpEventGetEventStatus_GetEventStatus_EvtInfo_SteerWheelAgSnsrPlausly: start-on-event=GetEventStatus, operation=EvtInfo_SteerWheelAgSnsrPlausly.GetEventStatus
        OpEventGetEventStatus_GetEventStatus_EvtInfo_SteerWhlTqInpSnsr: start-on-event=GetEventStatus, operation=EvtInfo_SteerWhlTqInpSnsr.GetEventStatus
        OpEventGetEventStatus_GetEventStatus_EvtInfo_SteerWhlTqInpSnsrCalNoLrnd: start-on-event=GetEventStatus, operation=EvtInfo_SteerWhlTqInpSnsrCalNoLrnd.GetEventStatus
        OpEventGetEventStatus_GetEventStatus_EvtInfo_SysThermErrTHi: start-on-event=GetEventStatus, operation=EvtInfo_SysThermErrTHi.GetEventStatus
        OpEventGetEventStatus_GetEventStatus_EvtInfo_WDG_E_DISABLE_REJECTED: start-on-event=GetEventStatus, operation=EvtInfo_WDG_E_DISABLE_REJECTED.GetEventStatus
        OpEventGetEventStatus_GetEventStatus_EvtInfo_WDG_E_MODE_FAILED: start-on-event=GetEventStatus, operation=EvtInfo_WDG_E_MODE_FAILED.GetEventStatus
        OpEventGetEventStatus_GetEventStatus_EvtInfo_WDG_E_READBACK_FAILURE: start-on-event=GetEventStatus, operation=EvtInfo_WDG_E_READBACK_FAILURE.GetEventStatus
        OpEventGetEventStatus_GetEventStatus_EvtInfo_WDG_E_TRIGGER_TIMEOUT: start-on-event=GetEventStatus, operation=EvtInfo_WDG_E_TRIGGER_TIMEOUT.GetEventStatus
        OpEventGetEventStatus_GetEventStatus_GeneralEventInfo: start-on-event=GetEventStatus, operation=GeneralEventInfo.GetEventStatus
        OpEventGetEventTested_GetEventTested_Event_CtrlrComChassisExpBusOff: start-on-event=GetEventTested, operation=Event_CtrlrComChassisExpBusOff.GetEventTested
        OpEventGetEventTested_GetEventTested_Event_CtrlrComHiSpdBusOff: start-on-event=GetEventTested, operation=Event_CtrlrComHiSpdBusOff.GetEventTested
        OpEventGetEventTested_GetEventTested_Event_DevPwrVltgOverMaxThd: start-on-event=GetEventTested, operation=Event_DevPwrVltgOverMaxThd.GetEventTested
        OpEventGetEventTested_GetEventTested_Event_DevPwrVltgUnderMinThd: start-on-event=GetEventTested, operation=Event_DevPwrVltgUnderMinThd.GetEventTested
        OpEventGetEventTested_GetEventTested_Event_DevPwrVltgUnderThd: start-on-event=GetEventTested, operation=Event_DevPwrVltgUnderThd.GetEventTested
        OpEventGetEventTested_GetEventTested_Event_EcuHwPrfmc: start-on-event=GetEventTested, operation=Event_EcuHwPrfmc.GetEventTested
        OpEventGetEventTested_GetEventTested_Event_EcuSwPrfmcCalDataSetNotProgd: start-on-event=GetEventTested, operation=Event_EcuSwPrfmcCalDataSetNotProgd.GetEventTested
        OpEventGetEventTested_GetEventTested_Event_ElecSteerMotCirc: start-on-event=GetEventTested, operation=Event_ElecSteerMotCirc.GetEventTested
        OpEventGetEventTested_GetEventTested_Event_ElecSteerMotPosSnsrCir: start-on-event=GetEventTested, operation=Event_ElecSteerMotPosSnsrCir.GetEventTested
        OpEventGetEventTested_GetEventTested_Event_InvldDataRxdFromBodtCtrlMod: start-on-event=GetEventTested, operation=Event_InvldDataRxdFromBodtCtrlMod.GetEventTested
        OpEventGetEventTested_GetEventTested_Event_InvldDataRxdFromElecBrkCtrlMod: start-on-event=GetEventTested, operation=Event_InvldDataRxdFromElecBrkCtrlMod.GetEventTested
        OpEventGetEventTested_GetEventTested_Event_InvldDataRxdFromElecBrkCtrlModChassisExp: start-on-event=GetEventTested, operation=Event_InvldDataRxdFromElecBrkCtrlModChassisExp.GetEventTested
        OpEventGetEventTested_GetEventTested_Event_InvldDataRxdFromEngCtrlMod: start-on-event=GetEventTested, operation=Event_InvldDataRxdFromEngCtrlMod.GetEventTested
        OpEventGetEventTested_GetEventTested_Event_InvldDataRxdFromFrntCameraMod: start-on-event=GetEventTested, operation=Event_InvldDataRxdFromFrntCameraMod.GetEventTested
        OpEventGetEventTested_GetEventTested_Event_InvldDataRxdFromParkAssiCtrlMod: start-on-event=GetEventTested, operation=Event_InvldDataRxdFromParkAssiCtrlMod.GetEventTested
        OpEventGetEventTested_GetEventTested_Event_InvldDataRxdFromTrsmCtrlMod: start-on-event=GetEventTested, operation=Event_InvldDataRxdFromTrsmCtrlMod.GetEventTested
        OpEventGetEventTested_GetEventTested_Event_LostComWithBodyCtrlMod: start-on-event=GetEventTested, operation=Event_LostComWithBodyCtrlMod.GetEventTested
        OpEventGetEventTested_GetEventTested_Event_LostComWithElecBrkCtrlMod: start-on-event=GetEventTested, operation=Event_LostComWithElecBrkCtrlMod.GetEventTested
        OpEventGetEventTested_GetEventTested_Event_LostComWithElecBrkCtrlModChassisExp: start-on-event=GetEventTested, operation=Event_LostComWithElecBrkCtrlModChassisExp.GetEventTested
        OpEventGetEventTested_GetEventTested_Event_LostComWithEngCtrlMod: start-on-event=GetEventTested, operation=Event_LostComWithEngCtrlMod.GetEventTested
        OpEventGetEventTested_GetEventTested_Event_LostComWithFrntCameraCtrlMod: start-on-event=GetEventTested, operation=Event_LostComWithFrntCameraCtrlMod.GetEventTested
        OpEventGetEventTested_GetEventTested_Event_LostComWithParkAssiCtrlMod: start-on-event=GetEventTested, operation=Event_LostComWithParkAssiCtrlMod.GetEventTested
        OpEventGetEventTested_GetEventTested_Event_LostComWithTrsmCtrlMod: start-on-event=GetEventTested, operation=Event_LostComWithTrsmCtrlMod.GetEventTested
        OpEventGetEventTested_GetEventTested_Event_SteerFailrMtgtnLvl1LimpHomeMod: start-on-event=GetEventTested, operation=Event_SteerFailrMtgtnLvl1LimpHomeMod.GetEventTested
        OpEventGetEventTested_GetEventTested_Event_SteerFailrMtgtnLvl2LimpOver: start-on-event=GetEventTested, operation=Event_SteerFailrMtgtnLvl2LimpOver.GetEventTested
        OpEventGetEventTested_GetEventTested_Event_SteerFailrMtgtnLvl3FadeOut: start-on-event=GetEventTested, operation=Event_SteerFailrMtgtnLvl3FadeOut.GetEventTested
        OpEventGetEventTested_GetEventTested_Event_SteerWheelAgSnsrCalNorPrfmd: start-on-event=GetEventTested, operation=Event_SteerWheelAgSnsrCalNorPrfmd.GetEventTested
        OpEventGetEventTested_GetEventTested_Event_SteerWheelAgSnsrHwFlt: start-on-event=GetEventTested, operation=Event_SteerWheelAgSnsrHwFlt.GetEventTested
        OpEventGetEventTested_GetEventTested_Event_SteerWheelAgSnsrPlausly: start-on-event=GetEventTested, operation=Event_SteerWheelAgSnsrPlausly.GetEventTested
        OpEventGetEventTested_GetEventTested_Event_SteerWhlTqInpSnsr: start-on-event=GetEventTested, operation=Event_SteerWhlTqInpSnsr.GetEventTested
        OpEventGetEventTested_GetEventTested_Event_SteerWhlTqInpSnsrCalNoLrnd: start-on-event=GetEventTested, operation=Event_SteerWhlTqInpSnsrCalNoLrnd.GetEventTested
        OpEventGetEventTested_GetEventTested_Event_SysThermErrTHi: start-on-event=GetEventTested, operation=Event_SysThermErrTHi.GetEventTested
        OpEventGetEventTested_GetEventTested_EvtInfo_CtrlrComChassisExpBusOff: start-on-event=GetEventTested, operation=EvtInfo_CtrlrComChassisExpBusOff.GetEventTested
        OpEventGetEventTested_GetEventTested_EvtInfo_CtrlrComHiSpdBusOff: start-on-event=GetEventTested, operation=EvtInfo_CtrlrComHiSpdBusOff.GetEventTested
        OpEventGetEventTested_GetEventTested_EvtInfo_DevPwrVltgOverMaxThd: start-on-event=GetEventTested, operation=EvtInfo_DevPwrVltgOverMaxThd.GetEventTested
        OpEventGetEventTested_GetEventTested_EvtInfo_DevPwrVltgUnderMinThd: start-on-event=GetEventTested, operation=EvtInfo_DevPwrVltgUnderMinThd.GetEventTested
        OpEventGetEventTested_GetEventTested_EvtInfo_DevPwrVltgUnderThd: start-on-event=GetEventTested, operation=EvtInfo_DevPwrVltgUnderThd.GetEventTested
        OpEventGetEventTested_GetEventTested_EvtInfo_EcuHwPrfmc: start-on-event=GetEventTested, operation=EvtInfo_EcuHwPrfmc.GetEventTested
        OpEventGetEventTested_GetEventTested_EvtInfo_EcuSwPrfmcCalDataSetNotProgd: start-on-event=GetEventTested, operation=EvtInfo_EcuSwPrfmcCalDataSetNotProgd.GetEventTested
        OpEventGetEventTested_GetEventTested_EvtInfo_ElecSteerMotCirc: start-on-event=GetEventTested, operation=EvtInfo_ElecSteerMotCirc.GetEventTested
        OpEventGetEventTested_GetEventTested_EvtInfo_ElecSteerMotPosSnsrCir: start-on-event=GetEventTested, operation=EvtInfo_ElecSteerMotPosSnsrCir.GetEventTested
        OpEventGetEventTested_GetEventTested_EvtInfo_FLS_E_COMPARE_FAILED: start-on-event=GetEventTested, operation=EvtInfo_FLS_E_COMPARE_FAILED.GetEventTested
        OpEventGetEventTested_GetEventTested_EvtInfo_FLS_E_ERASE_FAILED: start-on-event=GetEventTested, operation=EvtInfo_FLS_E_ERASE_FAILED.GetEventTested
        OpEventGetEventTested_GetEventTested_EvtInfo_FLS_E_READ_FAILED: start-on-event=GetEventTested, operation=EvtInfo_FLS_E_READ_FAILED.GetEventTested
        OpEventGetEventTested_GetEventTested_EvtInfo_FLS_E_READ_FAILED_DED: start-on-event=GetEventTested, operation=EvtInfo_FLS_E_READ_FAILED_DED.GetEventTested
        OpEventGetEventTested_GetEventTested_EvtInfo_FLS_E_WRITE_FAILED: start-on-event=GetEventTested, operation=EvtInfo_FLS_E_WRITE_FAILED.GetEventTested
        OpEventGetEventTested_GetEventTested_EvtInfo_InvldDataRxdFromBodtCtrlMod: start-on-event=GetEventTested, operation=EvtInfo_InvldDataRxdFromBodtCtrlMod.GetEventTested
        OpEventGetEventTested_GetEventTested_EvtInfo_InvldDataRxdFromElecBrkCtrlMod: start-on-event=GetEventTested, operation=EvtInfo_InvldDataRxdFromElecBrkCtrlMod.GetEventTested
        OpEventGetEventTested_GetEventTested_EvtInfo_InvldDataRxdFromElecBrkCtrlModChassisExp: start-on-event=GetEventTested, operation=EvtInfo_InvldDataRxdFromElecBrkCtrlModChassisExp.GetEventTested
        OpEventGetEventTested_GetEventTested_EvtInfo_InvldDataRxdFromEngCtrlMod: start-on-event=GetEventTested, operation=EvtInfo_InvldDataRxdFromEngCtrlMod.GetEventTested
        OpEventGetEventTested_GetEventTested_EvtInfo_InvldDataRxdFromFrntCameraMod: start-on-event=GetEventTested, operation=EvtInfo_InvldDataRxdFromFrntCameraMod.GetEventTested
        OpEventGetEventTested_GetEventTested_EvtInfo_InvldDataRxdFromParkAssiCtrlMod: start-on-event=GetEventTested, operation=EvtInfo_InvldDataRxdFromParkAssiCtrlMod.GetEventTested
        OpEventGetEventTested_GetEventTested_EvtInfo_InvldDataRxdFromTrsmCtrlMod: start-on-event=GetEventTested, operation=EvtInfo_InvldDataRxdFromTrsmCtrlMod.GetEventTested
        OpEventGetEventTested_GetEventTested_EvtInfo_LostComWithBodyCtrlMod: start-on-event=GetEventTested, operation=EvtInfo_LostComWithBodyCtrlMod.GetEventTested
        OpEventGetEventTested_GetEventTested_EvtInfo_LostComWithElecBrkCtrlMod: start-on-event=GetEventTested, operation=EvtInfo_LostComWithElecBrkCtrlMod.GetEventTested
        OpEventGetEventTested_GetEventTested_EvtInfo_LostComWithElecBrkCtrlModChassisExp: start-on-event=GetEventTested, operation=EvtInfo_LostComWithElecBrkCtrlModChassisExp.GetEventTested
        OpEventGetEventTested_GetEventTested_EvtInfo_LostComWithEngCtrlMod: start-on-event=GetEventTested, operation=EvtInfo_LostComWithEngCtrlMod.GetEventTested
        OpEventGetEventTested_GetEventTested_EvtInfo_LostComWithFrntCameraCtrlMod: start-on-event=GetEventTested, operation=EvtInfo_LostComWithFrntCameraCtrlMod.GetEventTested
        OpEventGetEventTested_GetEventTested_EvtInfo_LostComWithParkAssiCtrlMod: start-on-event=GetEventTested, operation=EvtInfo_LostComWithParkAssiCtrlMod.GetEventTested
        OpEventGetEventTested_GetEventTested_EvtInfo_LostComWithTrsmCtrlMod: start-on-event=GetEventTested, operation=EvtInfo_LostComWithTrsmCtrlMod.GetEventTested
        OpEventGetEventTested_GetEventTested_EvtInfo_MCU_E_CLM_SELFDIAG_FAILURE: start-on-event=GetEventTested, operation=EvtInfo_MCU_E_CLM_SELFDIAG_FAILURE.GetEventTested
        OpEventGetEventTested_GetEventTested_EvtInfo_MCU_E_CLOCK_FAILURE: start-on-event=GetEventTested, operation=EvtInfo_MCU_E_CLOCK_FAILURE.GetEventTested
        OpEventGetEventTested_GetEventTested_EvtInfo_MCU_E_CVM_SELFDIAG_FAILURE: start-on-event=GetEventTested, operation=EvtInfo_MCU_E_CVM_SELFDIAG_FAILURE.GetEventTested
        OpEventGetEventTested_GetEventTested_EvtInfo_MCU_E_ECM_SELFDIAG_FAILURE: start-on-event=GetEventTested, operation=EvtInfo_MCU_E_ECM_SELFDIAG_FAILURE.GetEventTested
        OpEventGetEventTested_GetEventTested_EvtInfo_MCU_E_LOCKSTEP_SELFDIAG_FAILURE: start-on-event=GetEventTested, operation=EvtInfo_MCU_E_LOCKSTEP_SELFDIAG_FAILURE.GetEventTested
        OpEventGetEventTested_GetEventTested_EvtInfo_MCU_E_WRITE_TIMEOUT_FAILURE: start-on-event=GetEventTested, operation=EvtInfo_MCU_E_WRITE_TIMEOUT_FAILURE.GetEventTested
        OpEventGetEventTested_GetEventTested_EvtInfo_NVM_E_INTEGRITY_FAILED: start-on-event=GetEventTested, operation=EvtInfo_NVM_E_INTEGRITY_FAILED.GetEventTested
        OpEventGetEventTested_GetEventTested_EvtInfo_NVM_E_LOSS_OF_REDUNDANCY: start-on-event=GetEventTested, operation=EvtInfo_NVM_E_LOSS_OF_REDUNDANCY.GetEventTested
        OpEventGetEventTested_GetEventTested_EvtInfo_NVM_E_QUEUE_OVERFLOW: start-on-event=GetEventTested, operation=EvtInfo_NVM_E_QUEUE_OVERFLOW.GetEventTested
        OpEventGetEventTested_GetEventTested_EvtInfo_NVM_E_REQ_FAILED: start-on-event=GetEventTested, operation=EvtInfo_NVM_E_REQ_FAILED.GetEventTested
        OpEventGetEventTested_GetEventTested_EvtInfo_NVM_E_VERIFY_FAILED: start-on-event=GetEventTested, operation=EvtInfo_NVM_E_VERIFY_FAILED.GetEventTested
        OpEventGetEventTested_GetEventTested_EvtInfo_NVM_E_WRITE_PROTECTED: start-on-event=GetEventTested, operation=EvtInfo_NVM_E_WRITE_PROTECTED.GetEventTested
        OpEventGetEventTested_GetEventTested_EvtInfo_NVM_E_WRONG_BLOCK_ID: start-on-event=GetEventTested, operation=EvtInfo_NVM_E_WRONG_BLOCK_ID.GetEventTested
        OpEventGetEventTested_GetEventTested_EvtInfo_PORT_E_WRITE_TIMEOUT_FAILURE: start-on-event=GetEventTested, operation=EvtInfo_PORT_E_WRITE_TIMEOUT_FAILURE.GetEventTested
        OpEventGetEventTested_GetEventTested_EvtInfo_SPI_E_DATA_TX_TIMEOUT_FAILURE: start-on-event=GetEventTested, operation=EvtInfo_SPI_E_DATA_TX_TIMEOUT_FAILURE.GetEventTested
        OpEventGetEventTested_GetEventTested_EvtInfo_SPI_E_HARDWARE_ERROR: start-on-event=GetEventTested, operation=EvtInfo_SPI_E_HARDWARE_ERROR.GetEventTested
        OpEventGetEventTested_GetEventTested_EvtInfo_SteerFailrMtgtnLvl1LimpHomeMod: start-on-event=GetEventTested, operation=EvtInfo_SteerFailrMtgtnLvl1LimpHomeMod.GetEventTested
        OpEventGetEventTested_GetEventTested_EvtInfo_SteerFailrMtgtnLvl2LimpOver: start-on-event=GetEventTested, operation=EvtInfo_SteerFailrMtgtnLvl2LimpOver.GetEventTested
        OpEventGetEventTested_GetEventTested_EvtInfo_SteerFailrMtgtnLvl3FadeOut: start-on-event=GetEventTested, operation=EvtInfo_SteerFailrMtgtnLvl3FadeOut.GetEventTested
        OpEventGetEventTested_GetEventTested_EvtInfo_SteerWheelAgSnsrCalNorPrfmd: start-on-event=GetEventTested, operation=EvtInfo_SteerWheelAgSnsrCalNorPrfmd.GetEventTested
        OpEventGetEventTested_GetEventTested_EvtInfo_SteerWheelAgSnsrHwFlt: start-on-event=GetEventTested, operation=EvtInfo_SteerWheelAgSnsrHwFlt.GetEventTested
        OpEventGetEventTested_GetEventTested_EvtInfo_SteerWheelAgSnsrPlausly: start-on-event=GetEventTested, operation=EvtInfo_SteerWheelAgSnsrPlausly.GetEventTested
        OpEventGetEventTested_GetEventTested_EvtInfo_SteerWhlTqInpSnsr: start-on-event=GetEventTested, operation=EvtInfo_SteerWhlTqInpSnsr.GetEventTested
        OpEventGetEventTested_GetEventTested_EvtInfo_SteerWhlTqInpSnsrCalNoLrnd: start-on-event=GetEventTested, operation=EvtInfo_SteerWhlTqInpSnsrCalNoLrnd.GetEventTested
        OpEventGetEventTested_GetEventTested_EvtInfo_SysThermErrTHi: start-on-event=GetEventTested, operation=EvtInfo_SysThermErrTHi.GetEventTested
        OpEventGetEventTested_GetEventTested_EvtInfo_WDG_E_DISABLE_REJECTED: start-on-event=GetEventTested, operation=EvtInfo_WDG_E_DISABLE_REJECTED.GetEventTested
        OpEventGetEventTested_GetEventTested_EvtInfo_WDG_E_MODE_FAILED: start-on-event=GetEventTested, operation=EvtInfo_WDG_E_MODE_FAILED.GetEventTested
        OpEventGetEventTested_GetEventTested_EvtInfo_WDG_E_READBACK_FAILURE: start-on-event=GetEventTested, operation=EvtInfo_WDG_E_READBACK_FAILURE.GetEventTested
        OpEventGetEventTested_GetEventTested_EvtInfo_WDG_E_TRIGGER_TIMEOUT: start-on-event=GetEventTested, operation=EvtInfo_WDG_E_TRIGGER_TIMEOUT.GetEventTested
        OpEventGetEventTested_GetEventTested_GeneralEventInfo: start-on-event=GetEventTested, operation=GeneralEventInfo.GetEventTested
        OpEventGetFaultDetectionCounter_GetFaultDetectionCounter_Event_CtrlrComChassisExpBusOff: start-on-event=GetFaultDetectionCounter, operation=Event_CtrlrComChassisExpBusOff.GetFaultDetectionCounter
        OpEventGetFaultDetectionCounter_GetFaultDetectionCounter_Event_CtrlrComHiSpdBusOff: start-on-event=GetFaultDetectionCounter, operation=Event_CtrlrComHiSpdBusOff.GetFaultDetectionCounter
        OpEventGetFaultDetectionCounter_GetFaultDetectionCounter_Event_DevPwrVltgOverMaxThd: start-on-event=GetFaultDetectionCounter, operation=Event_DevPwrVltgOverMaxThd.GetFaultDetectionCounter
        OpEventGetFaultDetectionCounter_GetFaultDetectionCounter_Event_DevPwrVltgUnderMinThd: start-on-event=GetFaultDetectionCounter, operation=Event_DevPwrVltgUnderMinThd.GetFaultDetectionCounter
        OpEventGetFaultDetectionCounter_GetFaultDetectionCounter_Event_DevPwrVltgUnderThd: start-on-event=GetFaultDetectionCounter, operation=Event_DevPwrVltgUnderThd.GetFaultDetectionCounter
        OpEventGetFaultDetectionCounter_GetFaultDetectionCounter_Event_EcuHwPrfmc: start-on-event=GetFaultDetectionCounter, operation=Event_EcuHwPrfmc.GetFaultDetectionCounter
        OpEventGetFaultDetectionCounter_GetFaultDetectionCounter_Event_EcuSwPrfmcCalDataSetNotProgd: start-on-event=GetFaultDetectionCounter, operation=Event_EcuSwPrfmcCalDataSetNotProgd.GetFaultDetectionCounter
        OpEventGetFaultDetectionCounter_GetFaultDetectionCounter_Event_ElecSteerMotCirc: start-on-event=GetFaultDetectionCounter, operation=Event_ElecSteerMotCirc.GetFaultDetectionCounter
        OpEventGetFaultDetectionCounter_GetFaultDetectionCounter_Event_ElecSteerMotPosSnsrCir: start-on-event=GetFaultDetectionCounter, operation=Event_ElecSteerMotPosSnsrCir.GetFaultDetectionCounter
        OpEventGetFaultDetectionCounter_GetFaultDetectionCounter_Event_InvldDataRxdFromBodtCtrlMod: start-on-event=GetFaultDetectionCounter, operation=Event_InvldDataRxdFromBodtCtrlMod.GetFaultDetectionCounter
        OpEventGetFaultDetectionCounter_GetFaultDetectionCounter_Event_InvldDataRxdFromElecBrkCtrlMod: start-on-event=GetFaultDetectionCounter, operation=Event_InvldDataRxdFromElecBrkCtrlMod.GetFaultDetectionCounter
        OpEventGetFaultDetectionCounter_GetFaultDetectionCounter_Event_InvldDataRxdFromElecBrkCtrlModChassisExp: start-on-event=GetFaultDetectionCounter, operation=Event_InvldDataRxdFromElecBrkCtrlModChassisExp.GetFaultDetectionCounter
        OpEventGetFaultDetectionCounter_GetFaultDetectionCounter_Event_InvldDataRxdFromEngCtrlMod: start-on-event=GetFaultDetectionCounter, operation=Event_InvldDataRxdFromEngCtrlMod.GetFaultDetectionCounter
        OpEventGetFaultDetectionCounter_GetFaultDetectionCounter_Event_InvldDataRxdFromFrntCameraMod: start-on-event=GetFaultDetectionCounter, operation=Event_InvldDataRxdFromFrntCameraMod.GetFaultDetectionCounter
        OpEventGetFaultDetectionCounter_GetFaultDetectionCounter_Event_InvldDataRxdFromParkAssiCtrlMod: start-on-event=GetFaultDetectionCounter, operation=Event_InvldDataRxdFromParkAssiCtrlMod.GetFaultDetectionCounter
        OpEventGetFaultDetectionCounter_GetFaultDetectionCounter_Event_InvldDataRxdFromTrsmCtrlMod: start-on-event=GetFaultDetectionCounter, operation=Event_InvldDataRxdFromTrsmCtrlMod.GetFaultDetectionCounter
        OpEventGetFaultDetectionCounter_GetFaultDetectionCounter_Event_LostComWithBodyCtrlMod: start-on-event=GetFaultDetectionCounter, operation=Event_LostComWithBodyCtrlMod.GetFaultDetectionCounter
        OpEventGetFaultDetectionCounter_GetFaultDetectionCounter_Event_LostComWithElecBrkCtrlMod: start-on-event=GetFaultDetectionCounter, operation=Event_LostComWithElecBrkCtrlMod.GetFaultDetectionCounter
        OpEventGetFaultDetectionCounter_GetFaultDetectionCounter_Event_LostComWithElecBrkCtrlModChassisExp: start-on-event=GetFaultDetectionCounter, operation=Event_LostComWithElecBrkCtrlModChassisExp.GetFaultDetectionCounter
        OpEventGetFaultDetectionCounter_GetFaultDetectionCounter_Event_LostComWithEngCtrlMod: start-on-event=GetFaultDetectionCounter, operation=Event_LostComWithEngCtrlMod.GetFaultDetectionCounter
        OpEventGetFaultDetectionCounter_GetFaultDetectionCounter_Event_LostComWithFrntCameraCtrlMod: start-on-event=GetFaultDetectionCounter, operation=Event_LostComWithFrntCameraCtrlMod.GetFaultDetectionCounter
        OpEventGetFaultDetectionCounter_GetFaultDetectionCounter_Event_LostComWithParkAssiCtrlMod: start-on-event=GetFaultDetectionCounter, operation=Event_LostComWithParkAssiCtrlMod.GetFaultDetectionCounter
        OpEventGetFaultDetectionCounter_GetFaultDetectionCounter_Event_LostComWithTrsmCtrlMod: start-on-event=GetFaultDetectionCounter, operation=Event_LostComWithTrsmCtrlMod.GetFaultDetectionCounter
        OpEventGetFaultDetectionCounter_GetFaultDetectionCounter_Event_SteerFailrMtgtnLvl1LimpHomeMod: start-on-event=GetFaultDetectionCounter, operation=Event_SteerFailrMtgtnLvl1LimpHomeMod.GetFaultDetectionCounter
        OpEventGetFaultDetectionCounter_GetFaultDetectionCounter_Event_SteerFailrMtgtnLvl2LimpOver: start-on-event=GetFaultDetectionCounter, operation=Event_SteerFailrMtgtnLvl2LimpOver.GetFaultDetectionCounter
        OpEventGetFaultDetectionCounter_GetFaultDetectionCounter_Event_SteerFailrMtgtnLvl3FadeOut: start-on-event=GetFaultDetectionCounter, operation=Event_SteerFailrMtgtnLvl3FadeOut.GetFaultDetectionCounter
        OpEventGetFaultDetectionCounter_GetFaultDetectionCounter_Event_SteerWheelAgSnsrCalNorPrfmd: start-on-event=GetFaultDetectionCounter, operation=Event_SteerWheelAgSnsrCalNorPrfmd.GetFaultDetectionCounter
        OpEventGetFaultDetectionCounter_GetFaultDetectionCounter_Event_SteerWheelAgSnsrHwFlt: start-on-event=GetFaultDetectionCounter, operation=Event_SteerWheelAgSnsrHwFlt.GetFaultDetectionCounter
        OpEventGetFaultDetectionCounter_GetFaultDetectionCounter_Event_SteerWheelAgSnsrPlausly: start-on-event=GetFaultDetectionCounter, operation=Event_SteerWheelAgSnsrPlausly.GetFaultDetectionCounter
        OpEventGetFaultDetectionCounter_GetFaultDetectionCounter_Event_SteerWhlTqInpSnsr: start-on-event=GetFaultDetectionCounter, operation=Event_SteerWhlTqInpSnsr.GetFaultDetectionCounter
        OpEventGetFaultDetectionCounter_GetFaultDetectionCounter_Event_SteerWhlTqInpSnsrCalNoLrnd: start-on-event=GetFaultDetectionCounter, operation=Event_SteerWhlTqInpSnsrCalNoLrnd.GetFaultDetectionCounter
        OpEventGetFaultDetectionCounter_GetFaultDetectionCounter_Event_SysThermErrTHi: start-on-event=GetFaultDetectionCounter, operation=Event_SysThermErrTHi.GetFaultDetectionCounter
        OpEventGetFaultDetectionCounter_GetFaultDetectionCounter_EvtInfo_CtrlrComChassisExpBusOff: start-on-event=GetFaultDetectionCounter, operation=EvtInfo_CtrlrComChassisExpBusOff.GetFaultDetectionCounter
        OpEventGetFaultDetectionCounter_GetFaultDetectionCounter_EvtInfo_CtrlrComHiSpdBusOff: start-on-event=GetFaultDetectionCounter, operation=EvtInfo_CtrlrComHiSpdBusOff.GetFaultDetectionCounter
        OpEventGetFaultDetectionCounter_GetFaultDetectionCounter_EvtInfo_DevPwrVltgOverMaxThd: start-on-event=GetFaultDetectionCounter, operation=EvtInfo_DevPwrVltgOverMaxThd.GetFaultDetectionCounter
        OpEventGetFaultDetectionCounter_GetFaultDetectionCounter_EvtInfo_DevPwrVltgUnderMinThd: start-on-event=GetFaultDetectionCounter, operation=EvtInfo_DevPwrVltgUnderMinThd.GetFaultDetectionCounter
        OpEventGetFaultDetectionCounter_GetFaultDetectionCounter_EvtInfo_DevPwrVltgUnderThd: start-on-event=GetFaultDetectionCounter, operation=EvtInfo_DevPwrVltgUnderThd.GetFaultDetectionCounter
        OpEventGetFaultDetectionCounter_GetFaultDetectionCounter_EvtInfo_EcuHwPrfmc: start-on-event=GetFaultDetectionCounter, operation=EvtInfo_EcuHwPrfmc.GetFaultDetectionCounter
        OpEventGetFaultDetectionCounter_GetFaultDetectionCounter_EvtInfo_EcuSwPrfmcCalDataSetNotProgd: start-on-event=GetFaultDetectionCounter, operation=EvtInfo_EcuSwPrfmcCalDataSetNotProgd.GetFaultDetectionCounter
        OpEventGetFaultDetectionCounter_GetFaultDetectionCounter_EvtInfo_ElecSteerMotCirc: start-on-event=GetFaultDetectionCounter, operation=EvtInfo_ElecSteerMotCirc.GetFaultDetectionCounter
        OpEventGetFaultDetectionCounter_GetFaultDetectionCounter_EvtInfo_ElecSteerMotPosSnsrCir: start-on-event=GetFaultDetectionCounter, operation=EvtInfo_ElecSteerMotPosSnsrCir.GetFaultDetectionCounter
        OpEventGetFaultDetectionCounter_GetFaultDetectionCounter_EvtInfo_FLS_E_COMPARE_FAILED: start-on-event=GetFaultDetectionCounter, operation=EvtInfo_FLS_E_COMPARE_FAILED.GetFaultDetectionCounter
        OpEventGetFaultDetectionCounter_GetFaultDetectionCounter_EvtInfo_FLS_E_ERASE_FAILED: start-on-event=GetFaultDetectionCounter, operation=EvtInfo_FLS_E_ERASE_FAILED.GetFaultDetectionCounter
        OpEventGetFaultDetectionCounter_GetFaultDetectionCounter_EvtInfo_FLS_E_READ_FAILED: start-on-event=GetFaultDetectionCounter, operation=EvtInfo_FLS_E_READ_FAILED.GetFaultDetectionCounter
        OpEventGetFaultDetectionCounter_GetFaultDetectionCounter_EvtInfo_FLS_E_READ_FAILED_DED: start-on-event=GetFaultDetectionCounter, operation=EvtInfo_FLS_E_READ_FAILED_DED.GetFaultDetectionCounter
        OpEventGetFaultDetectionCounter_GetFaultDetectionCounter_EvtInfo_FLS_E_WRITE_FAILED: start-on-event=GetFaultDetectionCounter, operation=EvtInfo_FLS_E_WRITE_FAILED.GetFaultDetectionCounter
        OpEventGetFaultDetectionCounter_GetFaultDetectionCounter_EvtInfo_InvldDataRxdFromBodtCtrlMod: start-on-event=GetFaultDetectionCounter, operation=EvtInfo_InvldDataRxdFromBodtCtrlMod.GetFaultDetectionCounter
        OpEventGetFaultDetectionCounter_GetFaultDetectionCounter_EvtInfo_InvldDataRxdFromElecBrkCtrlMod: start-on-event=GetFaultDetectionCounter, operation=EvtInfo_InvldDataRxdFromElecBrkCtrlMod.GetFaultDetectionCounter
        OpEventGetFaultDetectionCounter_GetFaultDetectionCounter_EvtInfo_InvldDataRxdFromElecBrkCtrlModChassisExp: start-on-event=GetFaultDetectionCounter, operation=EvtInfo_InvldDataRxdFromElecBrkCtrlModChassisExp.GetFaultDetectionCounter
        OpEventGetFaultDetectionCounter_GetFaultDetectionCounter_EvtInfo_InvldDataRxdFromEngCtrlMod: start-on-event=GetFaultDetectionCounter, operation=EvtInfo_InvldDataRxdFromEngCtrlMod.GetFaultDetectionCounter
        OpEventGetFaultDetectionCounter_GetFaultDetectionCounter_EvtInfo_InvldDataRxdFromFrntCameraMod: start-on-event=GetFaultDetectionCounter, operation=EvtInfo_InvldDataRxdFromFrntCameraMod.GetFaultDetectionCounter
        OpEventGetFaultDetectionCounter_GetFaultDetectionCounter_EvtInfo_InvldDataRxdFromParkAssiCtrlMod: start-on-event=GetFaultDetectionCounter, operation=EvtInfo_InvldDataRxdFromParkAssiCtrlMod.GetFaultDetectionCounter
        OpEventGetFaultDetectionCounter_GetFaultDetectionCounter_EvtInfo_InvldDataRxdFromTrsmCtrlMod: start-on-event=GetFaultDetectionCounter, operation=EvtInfo_InvldDataRxdFromTrsmCtrlMod.GetFaultDetectionCounter
        OpEventGetFaultDetectionCounter_GetFaultDetectionCounter_EvtInfo_LostComWithBodyCtrlMod: start-on-event=GetFaultDetectionCounter, operation=EvtInfo_LostComWithBodyCtrlMod.GetFaultDetectionCounter
        OpEventGetFaultDetectionCounter_GetFaultDetectionCounter_EvtInfo_LostComWithElecBrkCtrlMod: start-on-event=GetFaultDetectionCounter, operation=EvtInfo_LostComWithElecBrkCtrlMod.GetFaultDetectionCounter
        OpEventGetFaultDetectionCounter_GetFaultDetectionCounter_EvtInfo_LostComWithElecBrkCtrlModChassisExp: start-on-event=GetFaultDetectionCounter, operation=EvtInfo_LostComWithElecBrkCtrlModChassisExp.GetFaultDetectionCounter
        OpEventGetFaultDetectionCounter_GetFaultDetectionCounter_EvtInfo_LostComWithEngCtrlMod: start-on-event=GetFaultDetectionCounter, operation=EvtInfo_LostComWithEngCtrlMod.GetFaultDetectionCounter
        OpEventGetFaultDetectionCounter_GetFaultDetectionCounter_EvtInfo_LostComWithFrntCameraCtrlMod: start-on-event=GetFaultDetectionCounter, operation=EvtInfo_LostComWithFrntCameraCtrlMod.GetFaultDetectionCounter
        OpEventGetFaultDetectionCounter_GetFaultDetectionCounter_EvtInfo_LostComWithParkAssiCtrlMod: start-on-event=GetFaultDetectionCounter, operation=EvtInfo_LostComWithParkAssiCtrlMod.GetFaultDetectionCounter
        OpEventGetFaultDetectionCounter_GetFaultDetectionCounter_EvtInfo_LostComWithTrsmCtrlMod: start-on-event=GetFaultDetectionCounter, operation=EvtInfo_LostComWithTrsmCtrlMod.GetFaultDetectionCounter
        OpEventGetFaultDetectionCounter_GetFaultDetectionCounter_EvtInfo_MCU_E_CLM_SELFDIAG_FAILURE: start-on-event=GetFaultDetectionCounter, operation=EvtInfo_MCU_E_CLM_SELFDIAG_FAILURE.GetFaultDetectionCounter
        OpEventGetFaultDetectionCounter_GetFaultDetectionCounter_EvtInfo_MCU_E_CLOCK_FAILURE: start-on-event=GetFaultDetectionCounter, operation=EvtInfo_MCU_E_CLOCK_FAILURE.GetFaultDetectionCounter
        OpEventGetFaultDetectionCounter_GetFaultDetectionCounter_EvtInfo_MCU_E_CVM_SELFDIAG_FAILURE: start-on-event=GetFaultDetectionCounter, operation=EvtInfo_MCU_E_CVM_SELFDIAG_FAILURE.GetFaultDetectionCounter
        OpEventGetFaultDetectionCounter_GetFaultDetectionCounter_EvtInfo_MCU_E_ECM_SELFDIAG_FAILURE: start-on-event=GetFaultDetectionCounter, operation=EvtInfo_MCU_E_ECM_SELFDIAG_FAILURE.GetFaultDetectionCounter
        OpEventGetFaultDetectionCounter_GetFaultDetectionCounter_EvtInfo_MCU_E_LOCKSTEP_SELFDIAG_FAILURE: start-on-event=GetFaultDetectionCounter, operation=EvtInfo_MCU_E_LOCKSTEP_SELFDIAG_FAILURE.GetFaultDetectionCounter
        OpEventGetFaultDetectionCounter_GetFaultDetectionCounter_EvtInfo_MCU_E_WRITE_TIMEOUT_FAILURE: start-on-event=GetFaultDetectionCounter, operation=EvtInfo_MCU_E_WRITE_TIMEOUT_FAILURE.GetFaultDetectionCounter
        OpEventGetFaultDetectionCounter_GetFaultDetectionCounter_EvtInfo_NVM_E_INTEGRITY_FAILED: start-on-event=GetFaultDetectionCounter, operation=EvtInfo_NVM_E_INTEGRITY_FAILED.GetFaultDetectionCounter
        OpEventGetFaultDetectionCounter_GetFaultDetectionCounter_EvtInfo_NVM_E_LOSS_OF_REDUNDANCY: start-on-event=GetFaultDetectionCounter, operation=EvtInfo_NVM_E_LOSS_OF_REDUNDANCY.GetFaultDetectionCounter
        OpEventGetFaultDetectionCounter_GetFaultDetectionCounter_EvtInfo_NVM_E_QUEUE_OVERFLOW: start-on-event=GetFaultDetectionCounter, operation=EvtInfo_NVM_E_QUEUE_OVERFLOW.GetFaultDetectionCounter
        OpEventGetFaultDetectionCounter_GetFaultDetectionCounter_EvtInfo_NVM_E_REQ_FAILED: start-on-event=GetFaultDetectionCounter, operation=EvtInfo_NVM_E_REQ_FAILED.GetFaultDetectionCounter
        OpEventGetFaultDetectionCounter_GetFaultDetectionCounter_EvtInfo_NVM_E_VERIFY_FAILED: start-on-event=GetFaultDetectionCounter, operation=EvtInfo_NVM_E_VERIFY_FAILED.GetFaultDetectionCounter
        OpEventGetFaultDetectionCounter_GetFaultDetectionCounter_EvtInfo_NVM_E_WRITE_PROTECTED: start-on-event=GetFaultDetectionCounter, operation=EvtInfo_NVM_E_WRITE_PROTECTED.GetFaultDetectionCounter
        OpEventGetFaultDetectionCounter_GetFaultDetectionCounter_EvtInfo_NVM_E_WRONG_BLOCK_ID: start-on-event=GetFaultDetectionCounter, operation=EvtInfo_NVM_E_WRONG_BLOCK_ID.GetFaultDetectionCounter
        OpEventGetFaultDetectionCounter_GetFaultDetectionCounter_EvtInfo_PORT_E_WRITE_TIMEOUT_FAILURE: start-on-event=GetFaultDetectionCounter, operation=EvtInfo_PORT_E_WRITE_TIMEOUT_FAILURE.GetFaultDetectionCounter
        OpEventGetFaultDetectionCounter_GetFaultDetectionCounter_EvtInfo_SPI_E_DATA_TX_TIMEOUT_FAILURE: start-on-event=GetFaultDetectionCounter, operation=EvtInfo_SPI_E_DATA_TX_TIMEOUT_FAILURE.GetFaultDetectionCounter
        OpEventGetFaultDetectionCounter_GetFaultDetectionCounter_EvtInfo_SPI_E_HARDWARE_ERROR: start-on-event=GetFaultDetectionCounter, operation=EvtInfo_SPI_E_HARDWARE_ERROR.GetFaultDetectionCounter
        OpEventGetFaultDetectionCounter_GetFaultDetectionCounter_EvtInfo_SteerFailrMtgtnLvl1LimpHomeMod: start-on-event=GetFaultDetectionCounter, operation=EvtInfo_SteerFailrMtgtnLvl1LimpHomeMod.GetFaultDetectionCounter
        OpEventGetFaultDetectionCounter_GetFaultDetectionCounter_EvtInfo_SteerFailrMtgtnLvl2LimpOver: start-on-event=GetFaultDetectionCounter, operation=EvtInfo_SteerFailrMtgtnLvl2LimpOver.GetFaultDetectionCounter
        OpEventGetFaultDetectionCounter_GetFaultDetectionCounter_EvtInfo_SteerFailrMtgtnLvl3FadeOut: start-on-event=GetFaultDetectionCounter, operation=EvtInfo_SteerFailrMtgtnLvl3FadeOut.GetFaultDetectionCounter
        OpEventGetFaultDetectionCounter_GetFaultDetectionCounter_EvtInfo_SteerWheelAgSnsrCalNorPrfmd: start-on-event=GetFaultDetectionCounter, operation=EvtInfo_SteerWheelAgSnsrCalNorPrfmd.GetFaultDetectionCounter
        OpEventGetFaultDetectionCounter_GetFaultDetectionCounter_EvtInfo_SteerWheelAgSnsrHwFlt: start-on-event=GetFaultDetectionCounter, operation=EvtInfo_SteerWheelAgSnsrHwFlt.GetFaultDetectionCounter
        OpEventGetFaultDetectionCounter_GetFaultDetectionCounter_EvtInfo_SteerWheelAgSnsrPlausly: start-on-event=GetFaultDetectionCounter, operation=EvtInfo_SteerWheelAgSnsrPlausly.GetFaultDetectionCounter
        OpEventGetFaultDetectionCounter_GetFaultDetectionCounter_EvtInfo_SteerWhlTqInpSnsr: start-on-event=GetFaultDetectionCounter, operation=EvtInfo_SteerWhlTqInpSnsr.GetFaultDetectionCounter
        OpEventGetFaultDetectionCounter_GetFaultDetectionCounter_EvtInfo_SteerWhlTqInpSnsrCalNoLrnd: start-on-event=GetFaultDetectionCounter, operation=EvtInfo_SteerWhlTqInpSnsrCalNoLrnd.GetFaultDetectionCounter
        OpEventGetFaultDetectionCounter_GetFaultDetectionCounter_EvtInfo_SysThermErrTHi: start-on-event=GetFaultDetectionCounter, operation=EvtInfo_SysThermErrTHi.GetFaultDetectionCounter
        OpEventGetFaultDetectionCounter_GetFaultDetectionCounter_EvtInfo_WDG_E_DISABLE_REJECTED: start-on-event=GetFaultDetectionCounter, operation=EvtInfo_WDG_E_DISABLE_REJECTED.GetFaultDetectionCounter
        OpEventGetFaultDetectionCounter_GetFaultDetectionCounter_EvtInfo_WDG_E_MODE_FAILED: start-on-event=GetFaultDetectionCounter, operation=EvtInfo_WDG_E_MODE_FAILED.GetFaultDetectionCounter
        OpEventGetFaultDetectionCounter_GetFaultDetectionCounter_EvtInfo_WDG_E_READBACK_FAILURE: start-on-event=GetFaultDetectionCounter, operation=EvtInfo_WDG_E_READBACK_FAILURE.GetFaultDetectionCounter
        OpEventGetFaultDetectionCounter_GetFaultDetectionCounter_EvtInfo_WDG_E_TRIGGER_TIMEOUT: start-on-event=GetFaultDetectionCounter, operation=EvtInfo_WDG_E_TRIGGER_TIMEOUT.GetFaultDetectionCounter
        OpEventGetFaultDetectionCounter_GetFaultDetectionCounter_GeneralEventInfo: start-on-event=GetFaultDetectionCounter, operation=GeneralEventInfo.GetFaultDetectionCounter
        OpEventGetIndicatorStatus_GetIndicatorStatus_IndStatus_PwrSteerIndcr: start-on-event=GetIndicatorStatus, operation=IndStatus_PwrSteerIndcr.GetIndicatorStatus
        OpEventGetIndicatorStatus_GetIndicatorStatus_IndStatus_SteerAssiLimd: start-on-event=GetIndicatorStatus, operation=IndStatus_SteerAssiLimd.GetIndicatorStatus
        OpEventGetIndicatorStatus_GetIndicatorStatus_IndStatus_SteerAssiLimdLvl2: start-on-event=GetIndicatorStatus, operation=IndStatus_SteerAssiLimdLvl2.GetIndicatorStatus
        OpEventGetIndicatorStatus_GetIndicatorStatus_IndStatus_SteerAssiLimdLvl3: start-on-event=GetIndicatorStatus, operation=IndStatus_SteerAssiLimdLvl3.GetIndicatorStatus
        OpEventGetNumberOfEventMemoryEntries_GetNumberOfEventMemoryEntries_OverflowIndPrimaryMemory: start-on-event=GetNumberOfEventMemoryEntries, operation=OverflowIndPrimaryMemory.GetNumberOfEventMemoryEntries
        OpEventPostRunRequested_GetPostRunRequested_DemServices: start-on-event=PostRunRequested, operation=DemServices.GetPostRunRequested
        OpEventResetEventDebounceStatus_ResetEventDebounceStatus_Event_CtrlrComChassisExpBusOff: start-on-event=ResetEventDebounceStatus, operation=Event_CtrlrComChassisExpBusOff.ResetEventDebounceStatus
        OpEventResetEventDebounceStatus_ResetEventDebounceStatus_Event_CtrlrComHiSpdBusOff: start-on-event=ResetEventDebounceStatus, operation=Event_CtrlrComHiSpdBusOff.ResetEventDebounceStatus
        OpEventResetEventDebounceStatus_ResetEventDebounceStatus_Event_DevPwrVltgOverMaxThd: start-on-event=ResetEventDebounceStatus, operation=Event_DevPwrVltgOverMaxThd.ResetEventDebounceStatus
        OpEventResetEventDebounceStatus_ResetEventDebounceStatus_Event_DevPwrVltgUnderMinThd: start-on-event=ResetEventDebounceStatus, operation=Event_DevPwrVltgUnderMinThd.ResetEventDebounceStatus
        OpEventResetEventDebounceStatus_ResetEventDebounceStatus_Event_DevPwrVltgUnderThd: start-on-event=ResetEventDebounceStatus, operation=Event_DevPwrVltgUnderThd.ResetEventDebounceStatus
        OpEventResetEventDebounceStatus_ResetEventDebounceStatus_Event_EcuHwPrfmc: start-on-event=ResetEventDebounceStatus, operation=Event_EcuHwPrfmc.ResetEventDebounceStatus
        OpEventResetEventDebounceStatus_ResetEventDebounceStatus_Event_EcuSwPrfmcCalDataSetNotProgd: start-on-event=ResetEventDebounceStatus, operation=Event_EcuSwPrfmcCalDataSetNotProgd.ResetEventDebounceStatus
        OpEventResetEventDebounceStatus_ResetEventDebounceStatus_Event_ElecSteerMotCirc: start-on-event=ResetEventDebounceStatus, operation=Event_ElecSteerMotCirc.ResetEventDebounceStatus
        OpEventResetEventDebounceStatus_ResetEventDebounceStatus_Event_ElecSteerMotPosSnsrCir: start-on-event=ResetEventDebounceStatus, operation=Event_ElecSteerMotPosSnsrCir.ResetEventDebounceStatus
        OpEventResetEventDebounceStatus_ResetEventDebounceStatus_Event_InvldDataRxdFromBodtCtrlMod: start-on-event=ResetEventDebounceStatus, operation=Event_InvldDataRxdFromBodtCtrlMod.ResetEventDebounceStatus
        OpEventResetEventDebounceStatus_ResetEventDebounceStatus_Event_InvldDataRxdFromElecBrkCtrlMod: start-on-event=ResetEventDebounceStatus, operation=Event_InvldDataRxdFromElecBrkCtrlMod.ResetEventDebounceStatus
        OpEventResetEventDebounceStatus_ResetEventDebounceStatus_Event_InvldDataRxdFromElecBrkCtrlModChassisExp: start-on-event=ResetEventDebounceStatus, operation=Event_InvldDataRxdFromElecBrkCtrlModChassisExp.ResetEventDebounceStatus
        OpEventResetEventDebounceStatus_ResetEventDebounceStatus_Event_InvldDataRxdFromEngCtrlMod: start-on-event=ResetEventDebounceStatus, operation=Event_InvldDataRxdFromEngCtrlMod.ResetEventDebounceStatus
        OpEventResetEventDebounceStatus_ResetEventDebounceStatus_Event_InvldDataRxdFromFrntCameraMod: start-on-event=ResetEventDebounceStatus, operation=Event_InvldDataRxdFromFrntCameraMod.ResetEventDebounceStatus
        OpEventResetEventDebounceStatus_ResetEventDebounceStatus_Event_InvldDataRxdFromParkAssiCtrlMod: start-on-event=ResetEventDebounceStatus, operation=Event_InvldDataRxdFromParkAssiCtrlMod.ResetEventDebounceStatus
        OpEventResetEventDebounceStatus_ResetEventDebounceStatus_Event_InvldDataRxdFromTrsmCtrlMod: start-on-event=ResetEventDebounceStatus, operation=Event_InvldDataRxdFromTrsmCtrlMod.ResetEventDebounceStatus
        OpEventResetEventDebounceStatus_ResetEventDebounceStatus_Event_LostComWithBodyCtrlMod: start-on-event=ResetEventDebounceStatus, operation=Event_LostComWithBodyCtrlMod.ResetEventDebounceStatus
        OpEventResetEventDebounceStatus_ResetEventDebounceStatus_Event_LostComWithElecBrkCtrlMod: start-on-event=ResetEventDebounceStatus, operation=Event_LostComWithElecBrkCtrlMod.ResetEventDebounceStatus
        OpEventResetEventDebounceStatus_ResetEventDebounceStatus_Event_LostComWithElecBrkCtrlModChassisExp: start-on-event=ResetEventDebounceStatus, operation=Event_LostComWithElecBrkCtrlModChassisExp.ResetEventDebounceStatus
        OpEventResetEventDebounceStatus_ResetEventDebounceStatus_Event_LostComWithEngCtrlMod: start-on-event=ResetEventDebounceStatus, operation=Event_LostComWithEngCtrlMod.ResetEventDebounceStatus
        OpEventResetEventDebounceStatus_ResetEventDebounceStatus_Event_LostComWithFrntCameraCtrlMod: start-on-event=ResetEventDebounceStatus, operation=Event_LostComWithFrntCameraCtrlMod.ResetEventDebounceStatus
        OpEventResetEventDebounceStatus_ResetEventDebounceStatus_Event_LostComWithParkAssiCtrlMod: start-on-event=ResetEventDebounceStatus, operation=Event_LostComWithParkAssiCtrlMod.ResetEventDebounceStatus
        OpEventResetEventDebounceStatus_ResetEventDebounceStatus_Event_LostComWithTrsmCtrlMod: start-on-event=ResetEventDebounceStatus, operation=Event_LostComWithTrsmCtrlMod.ResetEventDebounceStatus
        OpEventResetEventDebounceStatus_ResetEventDebounceStatus_Event_SteerFailrMtgtnLvl1LimpHomeMod: start-on-event=ResetEventDebounceStatus, operation=Event_SteerFailrMtgtnLvl1LimpHomeMod.ResetEventDebounceStatus
        OpEventResetEventDebounceStatus_ResetEventDebounceStatus_Event_SteerFailrMtgtnLvl2LimpOver: start-on-event=ResetEventDebounceStatus, operation=Event_SteerFailrMtgtnLvl2LimpOver.ResetEventDebounceStatus
        OpEventResetEventDebounceStatus_ResetEventDebounceStatus_Event_SteerFailrMtgtnLvl3FadeOut: start-on-event=ResetEventDebounceStatus, operation=Event_SteerFailrMtgtnLvl3FadeOut.ResetEventDebounceStatus
        OpEventResetEventDebounceStatus_ResetEventDebounceStatus_Event_SteerWheelAgSnsrCalNorPrfmd: start-on-event=ResetEventDebounceStatus, operation=Event_SteerWheelAgSnsrCalNorPrfmd.ResetEventDebounceStatus
        OpEventResetEventDebounceStatus_ResetEventDebounceStatus_Event_SteerWheelAgSnsrHwFlt: start-on-event=ResetEventDebounceStatus, operation=Event_SteerWheelAgSnsrHwFlt.ResetEventDebounceStatus
        OpEventResetEventDebounceStatus_ResetEventDebounceStatus_Event_SteerWheelAgSnsrPlausly: start-on-event=ResetEventDebounceStatus, operation=Event_SteerWheelAgSnsrPlausly.ResetEventDebounceStatus
        OpEventResetEventDebounceStatus_ResetEventDebounceStatus_Event_SteerWhlTqInpSnsr: start-on-event=ResetEventDebounceStatus, operation=Event_SteerWhlTqInpSnsr.ResetEventDebounceStatus
        OpEventResetEventDebounceStatus_ResetEventDebounceStatus_Event_SteerWhlTqInpSnsrCalNoLrnd: start-on-event=ResetEventDebounceStatus, operation=Event_SteerWhlTqInpSnsrCalNoLrnd.ResetEventDebounceStatus
        OpEventResetEventDebounceStatus_ResetEventDebounceStatus_Event_SysThermErrTHi: start-on-event=ResetEventDebounceStatus, operation=Event_SysThermErrTHi.ResetEventDebounceStatus
        OpEventResetEventStatus_ResetEventStatus_Event_CtrlrComChassisExpBusOff: start-on-event=ResetEventStatus, operation=Event_CtrlrComChassisExpBusOff.ResetEventStatus
        OpEventResetEventStatus_ResetEventStatus_Event_CtrlrComHiSpdBusOff: start-on-event=ResetEventStatus, operation=Event_CtrlrComHiSpdBusOff.ResetEventStatus
        OpEventResetEventStatus_ResetEventStatus_Event_DevPwrVltgOverMaxThd: start-on-event=ResetEventStatus, operation=Event_DevPwrVltgOverMaxThd.ResetEventStatus
        OpEventResetEventStatus_ResetEventStatus_Event_DevPwrVltgUnderMinThd: start-on-event=ResetEventStatus, operation=Event_DevPwrVltgUnderMinThd.ResetEventStatus
        OpEventResetEventStatus_ResetEventStatus_Event_DevPwrVltgUnderThd: start-on-event=ResetEventStatus, operation=Event_DevPwrVltgUnderThd.ResetEventStatus
        OpEventResetEventStatus_ResetEventStatus_Event_EcuHwPrfmc: start-on-event=ResetEventStatus, operation=Event_EcuHwPrfmc.ResetEventStatus
        OpEventResetEventStatus_ResetEventStatus_Event_EcuSwPrfmcCalDataSetNotProgd: start-on-event=ResetEventStatus, operation=Event_EcuSwPrfmcCalDataSetNotProgd.ResetEventStatus
        OpEventResetEventStatus_ResetEventStatus_Event_ElecSteerMotCirc: start-on-event=ResetEventStatus, operation=Event_ElecSteerMotCirc.ResetEventStatus
        OpEventResetEventStatus_ResetEventStatus_Event_ElecSteerMotPosSnsrCir: start-on-event=ResetEventStatus, operation=Event_ElecSteerMotPosSnsrCir.ResetEventStatus
        OpEventResetEventStatus_ResetEventStatus_Event_InvldDataRxdFromBodtCtrlMod: start-on-event=ResetEventStatus, operation=Event_InvldDataRxdFromBodtCtrlMod.ResetEventStatus
        OpEventResetEventStatus_ResetEventStatus_Event_InvldDataRxdFromElecBrkCtrlMod: start-on-event=ResetEventStatus, operation=Event_InvldDataRxdFromElecBrkCtrlMod.ResetEventStatus
        OpEventResetEventStatus_ResetEventStatus_Event_InvldDataRxdFromElecBrkCtrlModChassisExp: start-on-event=ResetEventStatus, operation=Event_InvldDataRxdFromElecBrkCtrlModChassisExp.ResetEventStatus
        OpEventResetEventStatus_ResetEventStatus_Event_InvldDataRxdFromEngCtrlMod: start-on-event=ResetEventStatus, operation=Event_InvldDataRxdFromEngCtrlMod.ResetEventStatus
        OpEventResetEventStatus_ResetEventStatus_Event_InvldDataRxdFromFrntCameraMod: start-on-event=ResetEventStatus, operation=Event_InvldDataRxdFromFrntCameraMod.ResetEventStatus
        OpEventResetEventStatus_ResetEventStatus_Event_InvldDataRxdFromParkAssiCtrlMod: start-on-event=ResetEventStatus, operation=Event_InvldDataRxdFromParkAssiCtrlMod.ResetEventStatus
        OpEventResetEventStatus_ResetEventStatus_Event_InvldDataRxdFromTrsmCtrlMod: start-on-event=ResetEventStatus, operation=Event_InvldDataRxdFromTrsmCtrlMod.ResetEventStatus
        OpEventResetEventStatus_ResetEventStatus_Event_LostComWithBodyCtrlMod: start-on-event=ResetEventStatus, operation=Event_LostComWithBodyCtrlMod.ResetEventStatus
        OpEventResetEventStatus_ResetEventStatus_Event_LostComWithElecBrkCtrlMod: start-on-event=ResetEventStatus, operation=Event_LostComWithElecBrkCtrlMod.ResetEventStatus
        OpEventResetEventStatus_ResetEventStatus_Event_LostComWithElecBrkCtrlModChassisExp: start-on-event=ResetEventStatus, operation=Event_LostComWithElecBrkCtrlModChassisExp.ResetEventStatus
        OpEventResetEventStatus_ResetEventStatus_Event_LostComWithEngCtrlMod: start-on-event=ResetEventStatus, operation=Event_LostComWithEngCtrlMod.ResetEventStatus
        OpEventResetEventStatus_ResetEventStatus_Event_LostComWithFrntCameraCtrlMod: start-on-event=ResetEventStatus, operation=Event_LostComWithFrntCameraCtrlMod.ResetEventStatus
        OpEventResetEventStatus_ResetEventStatus_Event_LostComWithParkAssiCtrlMod: start-on-event=ResetEventStatus, operation=Event_LostComWithParkAssiCtrlMod.ResetEventStatus
        OpEventResetEventStatus_ResetEventStatus_Event_LostComWithTrsmCtrlMod: start-on-event=ResetEventStatus, operation=Event_LostComWithTrsmCtrlMod.ResetEventStatus
        OpEventResetEventStatus_ResetEventStatus_Event_SteerFailrMtgtnLvl1LimpHomeMod: start-on-event=ResetEventStatus, operation=Event_SteerFailrMtgtnLvl1LimpHomeMod.ResetEventStatus
        OpEventResetEventStatus_ResetEventStatus_Event_SteerFailrMtgtnLvl2LimpOver: start-on-event=ResetEventStatus, operation=Event_SteerFailrMtgtnLvl2LimpOver.ResetEventStatus
        OpEventResetEventStatus_ResetEventStatus_Event_SteerFailrMtgtnLvl3FadeOut: start-on-event=ResetEventStatus, operation=Event_SteerFailrMtgtnLvl3FadeOut.ResetEventStatus
        OpEventResetEventStatus_ResetEventStatus_Event_SteerWheelAgSnsrCalNorPrfmd: start-on-event=ResetEventStatus, operation=Event_SteerWheelAgSnsrCalNorPrfmd.ResetEventStatus
        OpEventResetEventStatus_ResetEventStatus_Event_SteerWheelAgSnsrHwFlt: start-on-event=ResetEventStatus, operation=Event_SteerWheelAgSnsrHwFlt.ResetEventStatus
        OpEventResetEventStatus_ResetEventStatus_Event_SteerWheelAgSnsrPlausly: start-on-event=ResetEventStatus, operation=Event_SteerWheelAgSnsrPlausly.ResetEventStatus
        OpEventResetEventStatus_ResetEventStatus_Event_SteerWhlTqInpSnsr: start-on-event=ResetEventStatus, operation=Event_SteerWhlTqInpSnsr.ResetEventStatus
        OpEventResetEventStatus_ResetEventStatus_Event_SteerWhlTqInpSnsrCalNoLrnd: start-on-event=ResetEventStatus, operation=Event_SteerWhlTqInpSnsrCalNoLrnd.ResetEventStatus
        OpEventResetEventStatus_ResetEventStatus_Event_SysThermErrTHi: start-on-event=ResetEventStatus, operation=Event_SysThermErrTHi.ResetEventStatus
        OpEventSetEnableCondition_SetEnableCondition_EnableCond_DemEnableConditionA: start-on-event=SetEnableCondition, operation=EnableCond_DemEnableConditionA.SetEnableCondition
        OpEventSetEnableCondition_SetEnableCondition_EnableCond_DemEnableConditionB: start-on-event=SetEnableCondition, operation=EnableCond_DemEnableConditionB.SetEnableCondition
        OpEventSetEnableCondition_SetEnableCondition_EnableCond_DemEnableConditionC: start-on-event=SetEnableCondition, operation=EnableCond_DemEnableConditionC.SetEnableCondition
        OpEventSetEnableCondition_SetEnableCondition_EnableCond_DemEnableConditionD: start-on-event=SetEnableCondition, operation=EnableCond_DemEnableConditionD.SetEnableCondition
        OpEventSetEnableCondition_SetEnableCondition_EnableCond_DemEnableConditionE: start-on-event=SetEnableCondition, operation=EnableCond_DemEnableConditionE.SetEnableCondition
        OpEventSetEnableCondition_SetEnableCondition_EnableCond_DemEnableConditionF: start-on-event=SetEnableCondition, operation=EnableCond_DemEnableConditionF.SetEnableCondition
        OpEventSetEnableCondition_SetEnableCondition_EnableCond_DemEnableConditionG: start-on-event=SetEnableCondition, operation=EnableCond_DemEnableConditionG.SetEnableCondition
        OpEventSetEnableCondition_SetEnableCondition_EnableCond_DemEnableConditionH: start-on-event=SetEnableCondition, operation=EnableCond_DemEnableConditionH.SetEnableCondition
        OpEventSetEnableCondition_SetEnableCondition_EnableCond_DemEnableConditionI: start-on-event=SetEnableCondition, operation=EnableCond_DemEnableConditionI.SetEnableCondition
        OpEventSetEnableCondition_SetEnableCondition_EnableCond_DemEnableConditionJ: start-on-event=SetEnableCondition, operation=EnableCond_DemEnableConditionJ.SetEnableCondition
        OpEventSetEventStatus_SetEventStatus_Event_CtrlrComChassisExpBusOff: start-on-event=SetEventStatus, operation=Event_CtrlrComChassisExpBusOff.SetEventStatus
        OpEventSetEventStatus_SetEventStatus_Event_CtrlrComHiSpdBusOff: start-on-event=SetEventStatus, operation=Event_CtrlrComHiSpdBusOff.SetEventStatus
        OpEventSetEventStatus_SetEventStatus_Event_DevPwrVltgOverMaxThd: start-on-event=SetEventStatus, operation=Event_DevPwrVltgOverMaxThd.SetEventStatus
        OpEventSetEventStatus_SetEventStatus_Event_DevPwrVltgUnderMinThd: start-on-event=SetEventStatus, operation=Event_DevPwrVltgUnderMinThd.SetEventStatus
        OpEventSetEventStatus_SetEventStatus_Event_DevPwrVltgUnderThd: start-on-event=SetEventStatus, operation=Event_DevPwrVltgUnderThd.SetEventStatus
        OpEventSetEventStatus_SetEventStatus_Event_EcuHwPrfmc: start-on-event=SetEventStatus, operation=Event_EcuHwPrfmc.SetEventStatus
        OpEventSetEventStatus_SetEventStatus_Event_EcuSwPrfmcCalDataSetNotProgd: start-on-event=SetEventStatus, operation=Event_EcuSwPrfmcCalDataSetNotProgd.SetEventStatus
        OpEventSetEventStatus_SetEventStatus_Event_ElecSteerMotCirc: start-on-event=SetEventStatus, operation=Event_ElecSteerMotCirc.SetEventStatus
        OpEventSetEventStatus_SetEventStatus_Event_ElecSteerMotPosSnsrCir: start-on-event=SetEventStatus, operation=Event_ElecSteerMotPosSnsrCir.SetEventStatus
        OpEventSetEventStatus_SetEventStatus_Event_InvldDataRxdFromBodtCtrlMod: start-on-event=SetEventStatus, operation=Event_InvldDataRxdFromBodtCtrlMod.SetEventStatus
        OpEventSetEventStatus_SetEventStatus_Event_InvldDataRxdFromElecBrkCtrlMod: start-on-event=SetEventStatus, operation=Event_InvldDataRxdFromElecBrkCtrlMod.SetEventStatus
        OpEventSetEventStatus_SetEventStatus_Event_InvldDataRxdFromElecBrkCtrlModChassisExp: start-on-event=SetEventStatus, operation=Event_InvldDataRxdFromElecBrkCtrlModChassisExp.SetEventStatus
        OpEventSetEventStatus_SetEventStatus_Event_InvldDataRxdFromEngCtrlMod: start-on-event=SetEventStatus, operation=Event_InvldDataRxdFromEngCtrlMod.SetEventStatus
        OpEventSetEventStatus_SetEventStatus_Event_InvldDataRxdFromFrntCameraMod: start-on-event=SetEventStatus, operation=Event_InvldDataRxdFromFrntCameraMod.SetEventStatus
        OpEventSetEventStatus_SetEventStatus_Event_InvldDataRxdFromParkAssiCtrlMod: start-on-event=SetEventStatus, operation=Event_InvldDataRxdFromParkAssiCtrlMod.SetEventStatus
        OpEventSetEventStatus_SetEventStatus_Event_InvldDataRxdFromTrsmCtrlMod: start-on-event=SetEventStatus, operation=Event_InvldDataRxdFromTrsmCtrlMod.SetEventStatus
        OpEventSetEventStatus_SetEventStatus_Event_LostComWithBodyCtrlMod: start-on-event=SetEventStatus, operation=Event_LostComWithBodyCtrlMod.SetEventStatus
        OpEventSetEventStatus_SetEventStatus_Event_LostComWithElecBrkCtrlMod: start-on-event=SetEventStatus, operation=Event_LostComWithElecBrkCtrlMod.SetEventStatus
        OpEventSetEventStatus_SetEventStatus_Event_LostComWithElecBrkCtrlModChassisExp: start-on-event=SetEventStatus, operation=Event_LostComWithElecBrkCtrlModChassisExp.SetEventStatus
        OpEventSetEventStatus_SetEventStatus_Event_LostComWithEngCtrlMod: start-on-event=SetEventStatus, operation=Event_LostComWithEngCtrlMod.SetEventStatus
        OpEventSetEventStatus_SetEventStatus_Event_LostComWithFrntCameraCtrlMod: start-on-event=SetEventStatus, operation=Event_LostComWithFrntCameraCtrlMod.SetEventStatus
        OpEventSetEventStatus_SetEventStatus_Event_LostComWithParkAssiCtrlMod: start-on-event=SetEventStatus, operation=Event_LostComWithParkAssiCtrlMod.SetEventStatus
        OpEventSetEventStatus_SetEventStatus_Event_LostComWithTrsmCtrlMod: start-on-event=SetEventStatus, operation=Event_LostComWithTrsmCtrlMod.SetEventStatus
        OpEventSetEventStatus_SetEventStatus_Event_SteerFailrMtgtnLvl1LimpHomeMod: start-on-event=SetEventStatus, operation=Event_SteerFailrMtgtnLvl1LimpHomeMod.SetEventStatus
        OpEventSetEventStatus_SetEventStatus_Event_SteerFailrMtgtnLvl2LimpOver: start-on-event=SetEventStatus, operation=Event_SteerFailrMtgtnLvl2LimpOver.SetEventStatus
        OpEventSetEventStatus_SetEventStatus_Event_SteerFailrMtgtnLvl3FadeOut: start-on-event=SetEventStatus, operation=Event_SteerFailrMtgtnLvl3FadeOut.SetEventStatus
        OpEventSetEventStatus_SetEventStatus_Event_SteerWheelAgSnsrCalNorPrfmd: start-on-event=SetEventStatus, operation=Event_SteerWheelAgSnsrCalNorPrfmd.SetEventStatus
        OpEventSetEventStatus_SetEventStatus_Event_SteerWheelAgSnsrHwFlt: start-on-event=SetEventStatus, operation=Event_SteerWheelAgSnsrHwFlt.SetEventStatus
        OpEventSetEventStatus_SetEventStatus_Event_SteerWheelAgSnsrPlausly: start-on-event=SetEventStatus, operation=Event_SteerWheelAgSnsrPlausly.SetEventStatus
        OpEventSetEventStatus_SetEventStatus_Event_SteerWhlTqInpSnsr: start-on-event=SetEventStatus, operation=Event_SteerWhlTqInpSnsr.SetEventStatus
        OpEventSetEventStatus_SetEventStatus_Event_SteerWhlTqInpSnsrCalNoLrnd: start-on-event=SetEventStatus, operation=Event_SteerWhlTqInpSnsrCalNoLrnd.SetEventStatus
        OpEventSetEventStatus_SetEventStatus_Event_SysThermErrTHi: start-on-event=SetEventStatus, operation=Event_SysThermErrTHi.SetEventStatus
        OpEventSetOperationCycleState_SetOperationCycleState_OpCycle_PowerCycle: start-on-event=SetOperationCycleState, operation=OpCycle_PowerCycle.SetOperationCycleState
      port-api-options:
        enable-take-address=true, indirect-api=false, port=CBReadData_BattVltgEcu
        enable-take-address=true, indirect-api=false, port=CBReadData_EcuIntT
        enable-take-address=true, indirect-api=false, port=CBReadData_EngSpd
        enable-take-address=true, indirect-api=false, port=CBReadData_EpdMotOvldProtnCntr
        enable-take-address=true, indirect-api=false, port=CBReadData_EpsAgOvrlSts
        enable-take-address=true, indirect-api=false, port=CBReadData_EpsApaAgOvrlReq
        enable-take-address=true, indirect-api=false, port=CBReadData_EpsMotCurr
        enable-take-address=true, indirect-api=false, port=CBReadData_EpsMotCurrFb
        enable-take-address=true, indirect-api=false, port=CBReadData_EpsStopStrtSts
        enable-take-address=true, indirect-api=false, port=CBReadData_EpsTqOvrlReq
        enable-take-address=true, indirect-api=false, port=CBReadData_EpsTqOvrlSts
        enable-take-address=true, indirect-api=false, port=CBReadData_IgnCycCntr
        enable-take-address=true, indirect-api=false, port=CBReadData_SplrIntDtcInfo
        enable-take-address=true, indirect-api=false, port=CBReadData_SteerInpTq
        enable-take-address=true, indirect-api=false, port=CBReadData_SteerOutpTq
        enable-take-address=true, indirect-api=false, port=CBReadData_SteerWhlAg
        enable-take-address=true, indirect-api=false, port=CBReadData_SysPwrMod
        enable-take-address=true, indirect-api=false, port=CBReadData_TiIgnOn
        enable-take-address=true, indirect-api=false, port=CBReadData_VehSpd
        enable-take-address=true, indirect-api=false, port=CBStatusDTC_1
        enable-take-address=true, indirect-api=false, port=Cdd
        enable-take-address=true, indirect-api=false, port=Dcm
        enable-take-address=true, indirect-api=false, port=DemServices
        {enable-take-address=true, indirect-api=false, port-defined-argument-value{value=EnableCond_DemEnableConditionA_0:2, value-type=uint8}, port=EnableCond_DemEnableConditionA}
        {enable-take-address=true, indirect-api=false, port-defined-argument-value{value=EnableCond_DemEnableConditionB_0:3, value-type=uint8}, port=EnableCond_DemEnableConditionB}
        {enable-take-address=true, indirect-api=false, port-defined-argument-value{value=EnableCond_DemEnableConditionC_0:4, value-type=uint8}, port=EnableCond_DemEnableConditionC}
        {enable-take-address=true, indirect-api=false, port-defined-argument-value{value=EnableCond_DemEnableConditionD_0:5, value-type=uint8}, port=EnableCond_DemEnableConditionD}
        {enable-take-address=true, indirect-api=false, port-defined-argument-value{value=EnableCond_DemEnableConditionE_0:6, value-type=uint8}, port=EnableCond_DemEnableConditionE}
        {enable-take-address=true, indirect-api=false, port-defined-argument-value{value=EnableCond_DemEnableConditionF_0:7, value-type=uint8}, port=EnableCond_DemEnableConditionF}
        {enable-take-address=true, indirect-api=false, port-defined-argument-value{value=EnableCond_DemEnableConditionG_0:8, value-type=uint8}, port=EnableCond_DemEnableConditionG}
        {enable-take-address=true, indirect-api=false, port-defined-argument-value{value=EnableCond_DemEnableConditionH_0:9, value-type=uint8}, port=EnableCond_DemEnableConditionH}
        {enable-take-address=true, indirect-api=false, port-defined-argument-value{value=EnableCond_DemEnableConditionI_0:10, value-type=uint8}, port=EnableCond_DemEnableConditionI}
        {enable-take-address=true, indirect-api=false, port-defined-argument-value{value=EnableCond_DemEnableConditionJ_0:1, value-type=uint8}, port=EnableCond_DemEnableConditionJ}
        {enable-take-address=true, indirect-api=false, port-defined-argument-value{value=Event_CtrlrComChassisExpBusOff_0:3, value-type=Dem_EventIdType}, port=Event_CtrlrComChassisExpBusOff}
        {enable-take-address=true, indirect-api=false, port-defined-argument-value{value=Event_CtrlrComHiSpdBusOff_0:4, value-type=Dem_EventIdType}, port=Event_CtrlrComHiSpdBusOff}
        {enable-take-address=true, indirect-api=false, port-defined-argument-value{value=Event_DevPwrVltgOverMaxThd_0:5, value-type=Dem_EventIdType}, port=Event_DevPwrVltgOverMaxThd}
        {enable-take-address=true, indirect-api=false, port-defined-argument-value{value=Event_DevPwrVltgUnderMinThd_0:32, value-type=Dem_EventIdType}, port=Event_DevPwrVltgUnderMinThd}
        {enable-take-address=true, indirect-api=false, port-defined-argument-value{value=Event_DevPwrVltgUnderThd_0:6, value-type=Dem_EventIdType}, port=Event_DevPwrVltgUnderThd}
        {enable-take-address=true, indirect-api=false, port-defined-argument-value{value=Event_EcuHwPrfmc_0:7, value-type=Dem_EventIdType}, port=Event_EcuHwPrfmc}
        {enable-take-address=true, indirect-api=false, port-defined-argument-value{value=Event_EcuSwPrfmcCalDataSetNotProgd_0:8, value-type=Dem_EventIdType}, port=Event_EcuSwPrfmcCalDataSetNotProgd}
        {enable-take-address=true, indirect-api=false, port-defined-argument-value{value=Event_ElecSteerMotCirc_0:9, value-type=Dem_EventIdType}, port=Event_ElecSteerMotCirc}
        {enable-take-address=true, indirect-api=false, port-defined-argument-value{value=Event_ElecSteerMotPosSnsrCir_0:10, value-type=Dem_EventIdType}, port=Event_ElecSteerMotPosSnsrCir}
        {enable-take-address=true, indirect-api=false, port-defined-argument-value{value=Event_InvldDataRxdFromBodtCtrlMod_0:11, value-type=Dem_EventIdType}, port=Event_InvldDataRxdFromBodtCtrlMod}
        {enable-take-address=true, indirect-api=false, port-defined-argument-value{value=Event_InvldDataRxdFromElecBrkCtrlMod_0:12, value-type=Dem_EventIdType}, port=Event_InvldDataRxdFromElecBrkCtrlMod}
        {enable-take-address=true, indirect-api=false, port-defined-argument-value{value=Event_InvldDataRxdFromElecBrkCtrlModChassisExp_0:13, value-type=Dem_EventIdType}, port=Event_InvldDataRxdFromElecBrkCtrlModChassisExp}
        {enable-take-address=true, indirect-api=false, port-defined-argument-value{value=Event_InvldDataRxdFromEngCtrlMod_0:14, value-type=Dem_EventIdType}, port=Event_InvldDataRxdFromEngCtrlMod}
        {enable-take-address=true, indirect-api=false, port-defined-argument-value{value=Event_InvldDataRxdFromFrntCameraMod_0:15, value-type=Dem_EventIdType}, port=Event_InvldDataRxdFromFrntCameraMod}
        {enable-take-address=true, indirect-api=false, port-defined-argument-value{value=Event_InvldDataRxdFromParkAssiCtrlMod_0:16, value-type=Dem_EventIdType}, port=Event_InvldDataRxdFromParkAssiCtrlMod}
        {enable-take-address=true, indirect-api=false, port-defined-argument-value{value=Event_InvldDataRxdFromTrsmCtrlMod_0:17, value-type=Dem_EventIdType}, port=Event_InvldDataRxdFromTrsmCtrlMod}
        {enable-take-address=true, indirect-api=false, port-defined-argument-value{value=Event_LostComWithBodyCtrlMod_0:18, value-type=Dem_EventIdType}, port=Event_LostComWithBodyCtrlMod}
        {enable-take-address=true, indirect-api=false, port-defined-argument-value{value=Event_LostComWithElecBrkCtrlMod_0:19, value-type=Dem_EventIdType}, port=Event_LostComWithElecBrkCtrlMod}
        {enable-take-address=true, indirect-api=false, port-defined-argument-value{value=Event_LostComWithElecBrkCtrlModChassisExp_0:20, value-type=Dem_EventIdType}, port=Event_LostComWithElecBrkCtrlModChassisExp}
        {enable-take-address=true, indirect-api=false, port-defined-argument-value{value=Event_LostComWithEngCtrlMod_0:21, value-type=Dem_EventIdType}, port=Event_LostComWithEngCtrlMod}
        {enable-take-address=true, indirect-api=false, port-defined-argument-value{value=Event_LostComWithFrntCameraCtrlMod_0:22, value-type=Dem_EventIdType}, port=Event_LostComWithFrntCameraCtrlMod}
        {enable-take-address=true, indirect-api=false, port-defined-argument-value{value=Event_LostComWithParkAssiCtrlMod_0:23, value-type=Dem_EventIdType}, port=Event_LostComWithParkAssiCtrlMod}
        {enable-take-address=true, indirect-api=false, port-defined-argument-value{value=Event_LostComWithTrsmCtrlMod_0:24, value-type=Dem_EventIdType}, port=Event_LostComWithTrsmCtrlMod}
        {enable-take-address=true, indirect-api=false, port-defined-argument-value{value=Event_SteerFailrMtgtnLvl1LimpHomeMod_0:25, value-type=Dem_EventIdType}, port=Event_SteerFailrMtgtnLvl1LimpHomeMod}
        {enable-take-address=true, indirect-api=false, port-defined-argument-value{value=Event_SteerFailrMtgtnLvl2LimpOver_0:26, value-type=Dem_EventIdType}, port=Event_SteerFailrMtgtnLvl2LimpOver}
        {enable-take-address=true, indirect-api=false, port-defined-argument-value{value=Event_SteerFailrMtgtnLvl3FadeOut_0:27, value-type=Dem_EventIdType}, port=Event_SteerFailrMtgtnLvl3FadeOut}
        {enable-take-address=true, indirect-api=false, port-defined-argument-value{value=Event_SteerWheelAgSnsrCalNorPrfmd_0:1, value-type=Dem_EventIdType}, port=Event_SteerWheelAgSnsrCalNorPrfmd}
        {enable-take-address=true, indirect-api=false, port-defined-argument-value{value=Event_SteerWheelAgSnsrHwFlt_0:28, value-type=Dem_EventIdType}, port=Event_SteerWheelAgSnsrHwFlt}
        {enable-take-address=true, indirect-api=false, port-defined-argument-value{value=Event_SteerWheelAgSnsrPlausly_0:29, value-type=Dem_EventIdType}, port=Event_SteerWheelAgSnsrPlausly}
        {enable-take-address=true, indirect-api=false, port-defined-argument-value{value=Event_SteerWhlTqInpSnsr_0:30, value-type=Dem_EventIdType}, port=Event_SteerWhlTqInpSnsr}
        {enable-take-address=true, indirect-api=false, port-defined-argument-value{value=Event_SteerWhlTqInpSnsrCalNoLrnd_0:31, value-type=Dem_EventIdType}, port=Event_SteerWhlTqInpSnsrCalNoLrnd}
        {enable-take-address=true, indirect-api=false, port-defined-argument-value{value=Event_SysThermErrTHi_0:2, value-type=Dem_EventIdType}, port=Event_SysThermErrTHi}
        {enable-take-address=true, indirect-api=false, port-defined-argument-value{value=EvtInfo_CtrlrComChassisExpBusOff_0:3, value-type=Dem_EventIdType}, port=EvtInfo_CtrlrComChassisExpBusOff}
        {enable-take-address=true, indirect-api=false, port-defined-argument-value{value=EvtInfo_CtrlrComHiSpdBusOff_0:4, value-type=Dem_EventIdType}, port=EvtInfo_CtrlrComHiSpdBusOff}
        {enable-take-address=true, indirect-api=false, port-defined-argument-value{value=EvtInfo_DevPwrVltgOverMaxThd_0:5, value-type=Dem_EventIdType}, port=EvtInfo_DevPwrVltgOverMaxThd}
        {enable-take-address=true, indirect-api=false, port-defined-argument-value{value=EvtInfo_DevPwrVltgUnderMinThd_0:32, value-type=Dem_EventIdType}, port=EvtInfo_DevPwrVltgUnderMinThd}
        {enable-take-address=true, indirect-api=false, port-defined-argument-value{value=EvtInfo_DevPwrVltgUnderThd_0:6, value-type=Dem_EventIdType}, port=EvtInfo_DevPwrVltgUnderThd}
        {enable-take-address=true, indirect-api=false, port-defined-argument-value{value=EvtInfo_EcuHwPrfmc_0:7, value-type=Dem_EventIdType}, port=EvtInfo_EcuHwPrfmc}
        {enable-take-address=true, indirect-api=false, port-defined-argument-value{value=EvtInfo_EcuSwPrfmcCalDataSetNotProgd_0:8, value-type=Dem_EventIdType}, port=EvtInfo_EcuSwPrfmcCalDataSetNotProgd}
        {enable-take-address=true, indirect-api=false, port-defined-argument-value{value=EvtInfo_ElecSteerMotCirc_0:9, value-type=Dem_EventIdType}, port=EvtInfo_ElecSteerMotCirc}
        {enable-take-address=true, indirect-api=false, port-defined-argument-value{value=EvtInfo_ElecSteerMotPosSnsrCir_0:10, value-type=Dem_EventIdType}, port=EvtInfo_ElecSteerMotPosSnsrCir}
        {enable-take-address=true, indirect-api=false, port-defined-argument-value{value=EvtInfo_FLS_E_COMPARE_FAILED_0:33, value-type=Dem_EventIdType}, port=EvtInfo_FLS_E_COMPARE_FAILED}
        {enable-take-address=true, indirect-api=false, port-defined-argument-value{value=EvtInfo_FLS_E_ERASE_FAILED_0:34, value-type=Dem_EventIdType}, port=EvtInfo_FLS_E_ERASE_FAILED}
        {enable-take-address=true, indirect-api=false, port-defined-argument-value{value=EvtInfo_FLS_E_READ_FAILED_0:35, value-type=Dem_EventIdType}, port=EvtInfo_FLS_E_READ_FAILED}
        {enable-take-address=true, indirect-api=false, port-defined-argument-value{value=EvtInfo_FLS_E_READ_FAILED_DED_0:36, value-type=Dem_EventIdType}, port=EvtInfo_FLS_E_READ_FAILED_DED}
        {enable-take-address=true, indirect-api=false, port-defined-argument-value{value=EvtInfo_FLS_E_WRITE_FAILED_0:37, value-type=Dem_EventIdType}, port=EvtInfo_FLS_E_WRITE_FAILED}
        {enable-take-address=true, indirect-api=false, port-defined-argument-value{value=EvtInfo_InvldDataRxdFromBodtCtrlMod_0:11, value-type=Dem_EventIdType}, port=EvtInfo_InvldDataRxdFromBodtCtrlMod}
        {enable-take-address=true, indirect-api=false, port-defined-argument-value{value=EvtInfo_InvldDataRxdFromElecBrkCtrlMod_0:12, value-type=Dem_EventIdType}, port=EvtInfo_InvldDataRxdFromElecBrkCtrlMod}
        {enable-take-address=true, indirect-api=false, port-defined-argument-value{value=EvtInfo_InvldDataRxdFromElecBrkCtrlModChassisExp_0:13, value-type=Dem_EventIdType}, port=EvtInfo_InvldDataRxdFromElecBrkCtrlModChassisExp}
        {enable-take-address=true, indirect-api=false, port-defined-argument-value{value=EvtInfo_InvldDataRxdFromEngCtrlMod_0:14, value-type=Dem_EventIdType}, port=EvtInfo_InvldDataRxdFromEngCtrlMod}
        {enable-take-address=true, indirect-api=false, port-defined-argument-value{value=EvtInfo_InvldDataRxdFromFrntCameraMod_0:15, value-type=Dem_EventIdType}, port=EvtInfo_InvldDataRxdFromFrntCameraMod}
        {enable-take-address=true, indirect-api=false, port-defined-argument-value{value=EvtInfo_InvldDataRxdFromParkAssiCtrlMod_0:16, value-type=Dem_EventIdType}, port=EvtInfo_InvldDataRxdFromParkAssiCtrlMod}
        {enable-take-address=true, indirect-api=false, port-defined-argument-value{value=EvtInfo_InvldDataRxdFromTrsmCtrlMod_0:17, value-type=Dem_EventIdType}, port=EvtInfo_InvldDataRxdFromTrsmCtrlMod}
        {enable-take-address=true, indirect-api=false, port-defined-argument-value{value=EvtInfo_LostComWithBodyCtrlMod_0:18, value-type=Dem_EventIdType}, port=EvtInfo_LostComWithBodyCtrlMod}
        {enable-take-address=true, indirect-api=false, port-defined-argument-value{value=EvtInfo_LostComWithElecBrkCtrlMod_0:19, value-type=Dem_EventIdType}, port=EvtInfo_LostComWithElecBrkCtrlMod}
        {enable-take-address=true, indirect-api=false, port-defined-argument-value{value=EvtInfo_LostComWithElecBrkCtrlModChassisExp_0:20, value-type=Dem_EventIdType}, port=EvtInfo_LostComWithElecBrkCtrlModChassisExp}
        {enable-take-address=true, indirect-api=false, port-defined-argument-value{value=EvtInfo_LostComWithEngCtrlMod_0:21, value-type=Dem_EventIdType}, port=EvtInfo_LostComWithEngCtrlMod}
        {enable-take-address=true, indirect-api=false, port-defined-argument-value{value=EvtInfo_LostComWithFrntCameraCtrlMod_0:22, value-type=Dem_EventIdType}, port=EvtInfo_LostComWithFrntCameraCtrlMod}
        {enable-take-address=true, indirect-api=false, port-defined-argument-value{value=EvtInfo_LostComWithParkAssiCtrlMod_0:23, value-type=Dem_EventIdType}, port=EvtInfo_LostComWithParkAssiCtrlMod}
        {enable-take-address=true, indirect-api=false, port-defined-argument-value{value=EvtInfo_LostComWithTrsmCtrlMod_0:24, value-type=Dem_EventIdType}, port=EvtInfo_LostComWithTrsmCtrlMod}
        {enable-take-address=true, indirect-api=false, port-defined-argument-value{value=EvtInfo_MCU_E_CLM_SELFDIAG_FAILURE_0:38, value-type=Dem_EventIdType}, port=EvtInfo_MCU_E_CLM_SELFDIAG_FAILURE}
        {enable-take-address=true, indirect-api=false, port-defined-argument-value{value=EvtInfo_MCU_E_CLOCK_FAILURE_0:39, value-type=Dem_EventIdType}, port=EvtInfo_MCU_E_CLOCK_FAILURE}
        {enable-take-address=true, indirect-api=false, port-defined-argument-value{value=EvtInfo_MCU_E_CVM_SELFDIAG_FAILURE_0:40, value-type=Dem_EventIdType}, port=EvtInfo_MCU_E_CVM_SELFDIAG_FAILURE}
        {enable-take-address=true, indirect-api=false, port-defined-argument-value{value=EvtInfo_MCU_E_ECM_SELFDIAG_FAILURE_0:56, value-type=Dem_EventIdType}, port=EvtInfo_MCU_E_ECM_SELFDIAG_FAILURE}
        {enable-take-address=true, indirect-api=false, port-defined-argument-value{value=EvtInfo_MCU_E_LOCKSTEP_SELFDIAG_FAILURE_0:57, value-type=Dem_EventIdType}, port=EvtInfo_MCU_E_LOCKSTEP_SELFDIAG_FAILURE}
        {enable-take-address=true, indirect-api=false, port-defined-argument-value{value=EvtInfo_MCU_E_WRITE_TIMEOUT_FAILURE_0:41, value-type=Dem_EventIdType}, port=EvtInfo_MCU_E_WRITE_TIMEOUT_FAILURE}
        {enable-take-address=true, indirect-api=false, port-defined-argument-value{value=EvtInfo_NVM_E_INTEGRITY_FAILED_0:42, value-type=Dem_EventIdType}, port=EvtInfo_NVM_E_INTEGRITY_FAILED}
        {enable-take-address=true, indirect-api=false, port-defined-argument-value{value=EvtInfo_NVM_E_LOSS_OF_REDUNDANCY_0:43, value-type=Dem_EventIdType}, port=EvtInfo_NVM_E_LOSS_OF_REDUNDANCY}
        {enable-take-address=true, indirect-api=false, port-defined-argument-value{value=EvtInfo_NVM_E_QUEUE_OVERFLOW_0:44, value-type=Dem_EventIdType}, port=EvtInfo_NVM_E_QUEUE_OVERFLOW}
        {enable-take-address=true, indirect-api=false, port-defined-argument-value{value=EvtInfo_NVM_E_REQ_FAILED_0:45, value-type=Dem_EventIdType}, port=EvtInfo_NVM_E_REQ_FAILED}
        {enable-take-address=true, indirect-api=false, port-defined-argument-value{value=EvtInfo_NVM_E_VERIFY_FAILED_0:46, value-type=Dem_EventIdType}, port=EvtInfo_NVM_E_VERIFY_FAILED}
        {enable-take-address=true, indirect-api=false, port-defined-argument-value{value=EvtInfo_NVM_E_WRITE_PROTECTED_0:47, value-type=Dem_EventIdType}, port=EvtInfo_NVM_E_WRITE_PROTECTED}
        {enable-take-address=true, indirect-api=false, port-defined-argument-value{value=EvtInfo_NVM_E_WRONG_BLOCK_ID_0:48, value-type=Dem_EventIdType}, port=EvtInfo_NVM_E_WRONG_BLOCK_ID}
        {enable-take-address=true, indirect-api=false, port-defined-argument-value{value=EvtInfo_PORT_E_WRITE_TIMEOUT_FAILURE_0:49, value-type=Dem_EventIdType}, port=EvtInfo_PORT_E_WRITE_TIMEOUT_FAILURE}
        {enable-take-address=true, indirect-api=false, port-defined-argument-value{value=EvtInfo_SPI_E_DATA_TX_TIMEOUT_FAILURE_0:50, value-type=Dem_EventIdType}, port=EvtInfo_SPI_E_DATA_TX_TIMEOUT_FAILURE}
        {enable-take-address=true, indirect-api=false, port-defined-argument-value{value=EvtInfo_SPI_E_HARDWARE_ERROR_0:51, value-type=Dem_EventIdType}, port=EvtInfo_SPI_E_HARDWARE_ERROR}
        {enable-take-address=true, indirect-api=false, port-defined-argument-value{value=EvtInfo_SteerFailrMtgtnLvl1LimpHomeMod_0:25, value-type=Dem_EventIdType}, port=EvtInfo_SteerFailrMtgtnLvl1LimpHomeMod}
        {enable-take-address=true, indirect-api=false, port-defined-argument-value{value=EvtInfo_SteerFailrMtgtnLvl2LimpOver_0:26, value-type=Dem_EventIdType}, port=EvtInfo_SteerFailrMtgtnLvl2LimpOver}
        {enable-take-address=true, indirect-api=false, port-defined-argument-value{value=EvtInfo_SteerFailrMtgtnLvl3FadeOut_0:27, value-type=Dem_EventIdType}, port=EvtInfo_SteerFailrMtgtnLvl3FadeOut}
        {enable-take-address=true, indirect-api=false, port-defined-argument-value{value=EvtInfo_SteerWheelAgSnsrCalNorPrfmd_0:1, value-type=Dem_EventIdType}, port=EvtInfo_SteerWheelAgSnsrCalNorPrfmd}
        {enable-take-address=true, indirect-api=false, port-defined-argument-value{value=EvtInfo_SteerWheelAgSnsrHwFlt_0:28, value-type=Dem_EventIdType}, port=EvtInfo_SteerWheelAgSnsrHwFlt}
        {enable-take-address=true, indirect-api=false, port-defined-argument-value{value=EvtInfo_SteerWheelAgSnsrPlausly_0:29, value-type=Dem_EventIdType}, port=EvtInfo_SteerWheelAgSnsrPlausly}
        {enable-take-address=true, indirect-api=false, port-defined-argument-value{value=EvtInfo_SteerWhlTqInpSnsr_0:30, value-type=Dem_EventIdType}, port=EvtInfo_SteerWhlTqInpSnsr}
        {enable-take-address=true, indirect-api=false, port-defined-argument-value{value=EvtInfo_SteerWhlTqInpSnsrCalNoLrnd_0:31, value-type=Dem_EventIdType}, port=EvtInfo_SteerWhlTqInpSnsrCalNoLrnd}
        {enable-take-address=true, indirect-api=false, port-defined-argument-value{value=EvtInfo_SysThermErrTHi_0:2, value-type=Dem_EventIdType}, port=EvtInfo_SysThermErrTHi}
        {enable-take-address=true, indirect-api=false, port-defined-argument-value{value=EvtInfo_WDG_E_DISABLE_REJECTED_0:52, value-type=Dem_EventIdType}, port=EvtInfo_WDG_E_DISABLE_REJECTED}
        {enable-take-address=true, indirect-api=false, port-defined-argument-value{value=EvtInfo_WDG_E_MODE_FAILED_0:53, value-type=Dem_EventIdType}, port=EvtInfo_WDG_E_MODE_FAILED}
        {enable-take-address=true, indirect-api=false, port-defined-argument-value{value=EvtInfo_WDG_E_READBACK_FAILURE_0:54, value-type=Dem_EventIdType}, port=EvtInfo_WDG_E_READBACK_FAILURE}
        {enable-take-address=true, indirect-api=false, port-defined-argument-value{value=EvtInfo_WDG_E_TRIGGER_TIMEOUT_0:55, value-type=Dem_EventIdType}, port=EvtInfo_WDG_E_TRIGGER_TIMEOUT}
        enable-take-address=true, indirect-api=false, port=GeneralEventInfo
        {enable-take-address=true, indirect-api=false, port-defined-argument-value{value=IndStatus_PwrSteerIndcr_0:1, value-type=uint8}, port=IndStatus_PwrSteerIndcr}
        {enable-take-address=true, indirect-api=false, port-defined-argument-value{value=IndStatus_SteerAssiLimd_0:2, value-type=uint8}, port=IndStatus_SteerAssiLimd}
        {enable-take-address=true, indirect-api=false, port-defined-argument-value{value=IndStatus_SteerAssiLimdLvl2_0:3, value-type=uint8}, port=IndStatus_SteerAssiLimdLvl2}
        {enable-take-address=true, indirect-api=false, port-defined-argument-value{value=IndStatus_SteerAssiLimdLvl3_0:0, value-type=uint8}, port=IndStatus_SteerAssiLimdLvl3}
        {enable-take-address=true, indirect-api=false, port-defined-argument-value{value=OpCycle_PowerCycle_0:0, value-type=Dem_OperationCycleIdType}, port=OpCycle_PowerCycle}
        {enable-take-address=true, indirect-api=false, port-defined-argument-value{value=OverflowIndPrimaryMemory_0:1, value-type=Dem_DTCOriginType}, port=OverflowIndPrimaryMemory}
      26 x runnable:
        ClearDTC: can-be-invoked-concurrently=true, symbol=Dem_ClearDTC
        DcmClearDTC: can-be-invoked-concurrently=true, symbol=Dem_DcmClearDTC
        DcmEnableDTCSetting: can-be-invoked-concurrently=true, symbol=Dem_DcmEnableDTCSetting
        DcmGetExtendedDataRecordByDTC: can-be-invoked-concurrently=true, symbol=Dem_DcmGetExtendedDataRecordByDTC
        DcmGetFreezeFrameDataByDTC: can-be-invoked-concurrently=true, symbol=Dem_DcmGetFreezeFrameDataByDTC
        DcmGetNextFilteredDTCAndFDC: can-be-invoked-concurrently=true, symbol=Dem_DcmGetNextFilteredDTCAndFDC
        Dem_MainFunction
          20 x sync call, all with timeout=0:
            OpServerCallDem_MainFunction_DTCStatusChanged_CBStatusDTC_1: operation=CBStatusDTC_1.DTCStatusChanged
            OpServerCallDem_MainFunction_ReadData_CBReadData_BattVltgEcu: operation=CBReadData_BattVltgEcu.ReadData
            OpServerCallDem_MainFunction_ReadData_CBReadData_EcuIntT: operation=CBReadData_EcuIntT.ReadData
            OpServerCallDem_MainFunction_ReadData_CBReadData_EngSpd: operation=CBReadData_EngSpd.ReadData
            OpServerCallDem_MainFunction_ReadData_CBReadData_EpdMotOvldProtnCntr: operation=CBReadData_EpdMotOvldProtnCntr.ReadData
            OpServerCallDem_MainFunction_ReadData_CBReadData_EpsAgOvrlSts: operation=CBReadData_EpsAgOvrlSts.ReadData
            OpServerCallDem_MainFunction_ReadData_CBReadData_EpsApaAgOvrlReq: operation=CBReadData_EpsApaAgOvrlReq.ReadData
            OpServerCallDem_MainFunction_ReadData_CBReadData_EpsMotCurr: operation=CBReadData_EpsMotCurr.ReadData
            OpServerCallDem_MainFunction_ReadData_CBReadData_EpsMotCurrFb: operation=CBReadData_EpsMotCurrFb.ReadData
            OpServerCallDem_MainFunction_ReadData_CBReadData_EpsStopStrtSts: operation=CBReadData_EpsStopStrtSts.ReadData
            OpServerCallDem_MainFunction_ReadData_CBReadData_EpsTqOvrlReq: operation=CBReadData_EpsTqOvrlReq.ReadData
            OpServerCallDem_MainFunction_ReadData_CBReadData_EpsTqOvrlSts: operation=CBReadData_EpsTqOvrlSts.ReadData
            OpServerCallDem_MainFunction_ReadData_CBReadData_IgnCycCntr: operation=CBReadData_IgnCycCntr.ReadData
            OpServerCallDem_MainFunction_ReadData_CBReadData_SplrIntDtcInfo: operation=CBReadData_SplrIntDtcInfo.ReadData
            OpServerCallDem_MainFunction_ReadData_CBReadData_SteerInpTq: operation=CBReadData_SteerInpTq.ReadData
            OpServerCallDem_MainFunction_ReadData_CBReadData_SteerOutpTq: operation=CBReadData_SteerOutpTq.ReadData
            OpServerCallDem_MainFunction_ReadData_CBReadData_SteerWhlAg: operation=CBReadData_SteerWhlAg.ReadData
            OpServerCallDem_MainFunction_ReadData_CBReadData_SysPwrMod: operation=CBReadData_SysPwrMod.ReadData
            OpServerCallDem_MainFunction_ReadData_CBReadData_TiIgnOn: operation=CBReadData_TiIgnOn.ReadData
            OpServerCallDem_MainFunction_ReadData_CBReadData_VehSpd: operation=CBReadData_VehSpd.ReadData
        GetDebouncingOfEvent: can-be-invoked-concurrently=true, symbol=Dem_GetDebouncingOfEvent
        GetDTCOfEvent: can-be-invoked-concurrently=true, symbol=Dem_GetDTCOfEvent
        GetDTCStatusAvailabilityMask: can-be-invoked-concurrently=true, symbol=Dem_DcmGetDTCStatusAvailabilityMask
        GetEventEnableCondition: can-be-invoked-concurrently=true, symbol=Dem_GetEventEnableCondition
        GetEventExtendedDataRecord: can-be-invoked-concurrently=true, symbol=Dem_GetEventExtendedDataRecord
        GetEventFailed: can-be-invoked-concurrently=true, symbol=Dem_GetEventFailed
        GetEventFreezeFrameData: can-be-invoked-concurrently=true, symbol=Dem_GetEventFreezeFrameData
        GetEventMemoryOverflow: can-be-invoked-concurrently=true, symbol=Dem_GetEventMemoryOverflow
        GetEventStatus: can-be-invoked-concurrently=true, symbol=Dem_GetEventStatus
        GetEventTested: can-be-invoked-concurrently=true, symbol=Dem_GetEventTested
        GetFaultDetectionCounter: can-be-invoked-concurrently=true, symbol=Dem_GetFaultDetectionCounter
        GetIndicatorStatus: can-be-invoked-concurrently=true, symbol=Dem_GetIndicatorStatus
        GetNumberOfEventMemoryEntries: can-be-invoked-concurrently=true, symbol=Dem_GetNumberOfEventMemoryEntries
        PostRunRequested: can-be-invoked-concurrently=true, symbol=Dem_PostRunRequested
        ResetEventDebounceStatus: can-be-invoked-concurrently=true, symbol=Dem_ResetEventDebounceStatus
        ResetEventStatus: can-be-invoked-concurrently=true, symbol=Dem_ResetEventStatus
          sync call OpServerCallResetEventStatus_DTCStatusChanged_CBStatusDTC_1: operation=CBStatusDTC_1.DTCStatusChanged, timeout=0
        SetEnableCondition: can-be-invoked-concurrently=true, symbol=Dem_SetEnableCondition
        SetEventStatus: can-be-invoked-concurrently=true, symbol=Dem_SetEventStatus
          sync call OpServerCallSetEventStatus_DTCStatusChanged_CBStatusDTC_1: operation=CBStatusDTC_1.DTCStatusChanged, timeout=0
        SetOperationCycleState: can-be-invoked-concurrently=true, symbol=Dem_SetOperationCycleState
  swc implementation DemImplementation: behavior=DemInternalBehavior
    code-descriptors:
      code Default: artifact-descriptors=autosar-engineering-object={short-label=Default, category=SWSRC}
