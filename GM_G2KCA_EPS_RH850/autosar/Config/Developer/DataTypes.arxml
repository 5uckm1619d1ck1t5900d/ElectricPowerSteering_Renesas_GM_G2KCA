AUTOSAR XML (schema 4-0-3)
standard types defined: UInt16, UInt8, float32_DataConstr, float64_DataConstr, sint16_DataConstr, sint32_DataConstr, sint8_DataConstr, uint16_DataConstr, uint32_DataConstr, uint8_DataConstr, boolean, float32, float64, sint16, sint32, sint8, uint16, uint32, uint8, Boolean, dtRef_const_VOID, dtRef_VOID
package /ComponentType/DataTypes/BaseTypes
  base type WdgM_GlobalStatusType: category=FIXED_LENGTH, base-type-size=8, base-type-encoding=NONE, native-declaration=uint8
  base type WdgM_LocalStatusType: category=FIXED_LENGTH, base-type-size=8, base-type-encoding=NONE, native-declaration=uint8
package /DataDictionary/ComponentTypes/DataTypeMappingSets
  data type mapping set Cals
    data-type-maps:
      application-data-type=AssiPahSumHysCmpLimDataType, implementation-data-type=float32
      application-data-type=AssiSumLimNtc0x0C4FailStepDataType, implementation-data-type=uint16
      application-data-type=AssiSumLimNtc0x0C4PassStepDataType, implementation-data-type=uint16
      application-data-type=AssiSumLimPullCmpLimDataType, implementation-data-type=float32
      application-data-type=BattVltgCorrlnAllwdVltgDifDataType, implementation-data-type=float32
      application-data-type=BattVltgCorrlnNtc0x03C0x0440x04CFailStepDataType, implementation-data-type=uint16
      application-data-type=BattVltgCorrlnNtc0x03C0x0440x04CPassStepDataType, implementation-data-type=uint16
      application-data-type=BattVltgSwdMaxDataType, implementation-data-type=float32
      application-data-type=CmnMfgSrvCal0RelNrDataType, implementation-data-type=uint32
      application-data-type=CurrMeasArbnDaxQaxScagFacDataType, implementation-data-type=float32
      application-data-type=CurrMeasArbnMaxStallCntrDataType, implementation-data-type=uint8
      application-data-type=CurrMeasCorrlnErrNstepDataType, implementation-data-type=uint16
      application-data-type=CurrMeasCorrlnErrPstepDataType, implementation-data-type=uint16
      application-data-type=CurrMeasCorrlnMaxErrCurrDataType, implementation-data-type=float32
      application-data-type=CurrMeasCorrlnMaxStallCntrDataType, implementation-data-type=uint8
      application-data-type=CurrMeasEolFixdPwmPerdDataType, implementation-data-type=uint32
      application-data-type=CurrMeasEolGainMaxDataType, implementation-data-type=float32
      application-data-type=CurrMeasEolGainMinDataType, implementation-data-type=float32
      application-data-type=CurrMeasEolGainNrOfSampleDataType, implementation-data-type=uint16
      application-data-type=CurrMeasEolGainNumerDataType, implementation-data-type=float32
      application-data-type=CurrMeasEolMaxMotVelDataType, implementation-data-type=float32
      application-data-type=CurrMeasEolOffsHiBrdgVltgMinDataType, implementation-data-type=uint32
      application-data-type=CurrMeasEolOffsHiCmuOffsDataType, implementation-data-type=uint32
      application-data-type=CurrMeasEolOffsLoCmuOffsDataType, implementation-data-type=uint32
      application-data-type=CurrMeasEolOffsMaxDataType, implementation-data-type=float32
      application-data-type=CurrMeasEolOffsMinDataType, implementation-data-type=float32
      application-data-type=CurrMeasEolOffsNrOfSampleDataType, implementation-data-type=uint16
      application-data-type=CurrMeasEolTranCntrThdDataType, implementation-data-type=uint8
      application-data-type=CurrMeasMinRqrdPhaOnTiDataType, implementation-data-type=uint32
      application-data-type=CurrMeasMotAgCompuDlyDataType, implementation-data-type=uint32
      application-data-type=CurrMeasMotCurrAdcVlyEnadMaxDataType, implementation-data-type=float32
      application-data-type=CurrMeasMotCurrAdcVlyEnadMinDataType, implementation-data-type=float32
      application-data-type=CurrMeasMotCurrAdcVlyWrmIninMaxDataType, implementation-data-type=float32
      application-data-type=CurrMeasMotCurrAdcVlyWrmIninMinDataType, implementation-data-type=float32
      application-data-type=CurrMeasNtc0x05DFailStepDataType, implementation-data-type=uint16
      application-data-type=CurrMeasNtc0x05DPassStepDataType, implementation-data-type=uint16
      application-data-type=CurrMeasNtc0x06DFailStepDataType, implementation-data-type=uint16
      application-data-type=CurrMeasNtc0x06DPassStepDataType, implementation-data-type=uint16
      application-data-type=CurrMeasNtc0x1ECFailStepDataType, implementation-data-type=uint16
      application-data-type=CurrMeasNtc0x1ECPassStepDataType, implementation-data-type=uint16
      application-data-type=CurrMeasNtc0x1EDFailStepDataType, implementation-data-type=uint16
      application-data-type=CurrMeasNtc0x1EDPassStepDataType, implementation-data-type=uint16
      application-data-type=DampgHydBasCoeff{1..4}DataType, implementation-data-type=float32
      application-data-type=DampgHydOutpLimDataType, implementation-data-type=float32
      application-data-type=DampgMotVelLpFilFrqDataType, implementation-data-type=float32
      application-data-type=DampgQuad13MplrDataType, implementation-data-type=float32
      application-data-type=DampgQuad24MplrDataType, implementation-data-type=float32
      application-data-type=DampgQuadHwTqBacklshDataType, implementation-data-type=float32
      application-data-type=DampgQuadHwTqLpFilFrqDataType, implementation-data-type=float32
      application-data-type=DampgQuadMotVelBacklshDataType, implementation-data-type=float32
      application-data-type=DampgQuadMotVelLpFilFrqDataType, implementation-data-type=float32
      application-data-type=DampgQuadScaLpFilFrqDataType, implementation-data-type=float32
      application-data-type=EcuTMeasDftTDataType, implementation-data-type=float32
      application-data-type=EcuTMeasFilTauDataType, implementation-data-type=float32
      application-data-type=EcuTMeasNtc0x045FailStepDataType, implementation-data-type=uint16
      application-data-type=EcuTMeasNtc0x045PassStepDataType, implementation-data-type=uint16
      application-data-type=EcuTMeasRngDiagcMaxDataType, implementation-data-type=float32
      application-data-type=EcuTMeasRngDiagcMinDataType, implementation-data-type=float32
      application-data-type=EcuTMeasScagDataType, implementation-data-type=float32
      application-data-type=EcuTMeasScagOffsDataType, implementation-data-type=float32
      application-data-type=GateDrvCtrlNtcNr0x050FailStepDataType, implementation-data-type=uint16
      application-data-type=GateDrvCtrlNtcNr0x060FailStepDataType, implementation-data-type=uint16
      application-data-type=GateDrvCtrlUnit0Cfg{2..4}WrValDataType, implementation-data-type=uint16
      application-data-type=GateDrvCtrlUnit0Cfg7WrValDataType, implementation-data-type=uint16
      application-data-type=GateDrvCtrlUnit1Cfg{2..4}WrValDataType, implementation-data-type=uint16
      application-data-type=GateDrvCtrlUnit1Cfg7WrValDataType, implementation-data-type=uint16
      application-data-type=HwAg0MeasNtc0x093FailStepDataType, implementation-data-type=uint16
      application-data-type=HwAg0MeasNtc0x093PassStepDataType, implementation-data-type=uint16
      application-data-type=HwAg0MeasNtc0x094FailStepDataType, implementation-data-type=uint16
      application-data-type=HwAg0MeasNtc0x094PassStepDataType, implementation-data-type=uint16
      application-data-type=HwAg0MeasNtc0x095FailStepDataType, implementation-data-type=uint16
      application-data-type=HwAg0MeasNtc0x095PassStepDataType, implementation-data-type=uint16
      application-data-type=HwAg0MeasVrnrErrThdDataType, implementation-data-type=uint8
      application-data-type=HwAg1MeasNtc0x097FailStepDataType, implementation-data-type=uint16
      application-data-type=HwAg1MeasNtc0x097PassStepDataType, implementation-data-type=uint16
      application-data-type=HwAg1MeasNtc0x098FailStepDataType, implementation-data-type=uint16
      application-data-type=HwAg1MeasNtc0x098PassStepDataType, implementation-data-type=uint16
      application-data-type=HwAg1MeasNtc0x099FailStepDataType, implementation-data-type=uint16
      application-data-type=HwAg1MeasNtc0x099PassStepDataType, implementation-data-type=uint16
      application-data-type=HwAg1MeasVrnrErrThdDataType, implementation-data-type=uint8
      application-data-type=HwTq0MeasNtc0x073FailStepDataType, implementation-data-type=uint16
      application-data-type=HwTq0MeasNtc0x073PassStepDataType, implementation-data-type=uint16
      application-data-type=HwTqArbnMaxStallTqADataType, implementation-data-type=uint8
      application-data-type=HwTqArbnMaxStallTqBDataType, implementation-data-type=uint8
      application-data-type=HwTqArbnMaxStallTqCDataType, implementation-data-type=uint8
      application-data-type=HwTqArbnMaxStallTqDDataType, implementation-data-type=uint8
      application-data-type=MotCtrlPrmEstimnFetRNomDataType, implementation-data-type=float32
      application-data-type=MotCtrlPrmEstimnFetThermCoeffDataType, implementation-data-type=float32
      application-data-type=MotCtrlPrmEstimnMagThermCoeffDataType, implementation-data-type=float32
      application-data-type=MotCtrlPrmEstimnMotBackEmfConHiLimDataType, implementation-data-type=float32
      application-data-type=MotCtrlPrmEstimnMotBackEmfConLoLimDataType, implementation-data-type=float32
      application-data-type=MotCtrlPrmEstimnMotBackEmfConNomDataType, implementation-data-type=float32
      application-data-type=MotCtrlPrmEstimnMotInduDaxHiLimDataType, implementation-data-type=float32
      application-data-type=MotCtrlPrmEstimnMotInduDaxLoLimDataType, implementation-data-type=float32
      application-data-type=MotCtrlPrmEstimnMotInduDaxNomDataType, implementation-data-type=float32
      application-data-type=MotCtrlPrmEstimnMotInduQaxHiLimDataType, implementation-data-type=float32
      application-data-type=MotCtrlPrmEstimnMotInduQaxLoLimDataType, implementation-data-type=float32
      application-data-type=MotCtrlPrmEstimnMotInduQaxNomDataType, implementation-data-type=float32
      application-data-type=MotCtrlPrmEstimnMotRHiLimDataType, implementation-data-type=float32
      application-data-type=MotCtrlPrmEstimnMotRLoLimDataType, implementation-data-type=float32
      application-data-type=MotCtrlPrmEstimnMotRNomDataType, implementation-data-type=float32
      application-data-type=MotCtrlPrmEstimnMotWidgThermCoeffDataType, implementation-data-type=float32
      application-data-type=MotCtrlPrmEstimnTNomDataType, implementation-data-type=float32
      application-data-type=MotCurrRegCfgCtrlrDynGainVehSpdCutOffDataType, implementation-data-type=float32
      application-data-type=MotCurrRegCfgCurrLoopSecOrderTrfFcnEnaDataType, implementation-data-type=uint8
      application-data-type=MotCurrRegCfgIntgrlGainSampleTiDataType, implementation-data-type=float32
      application-data-type=MotCurrRegCfgMotAgCompuDlyDataType, implementation-data-type=float32
      application-data-type=MotCurrRegCfgMotDampgRatDaxDataType, implementation-data-type=float32
      application-data-type=MotCurrRegCfgMotDampgRatQaxDataType, implementation-data-type=float32
      application-data-type=MotCurrRegCfgMotRVirtDaxDataType, implementation-data-type=float32
      application-data-type=MotCurrRegCfgMotRVirtQaxDataType, implementation-data-type=float32
      application-data-type=MotCurrRegCfgMotVelFilFrqDataType, implementation-data-type=float32
      application-data-type=MotCurrRegVltgLimrCurrLoaScarSlewRateDataType, implementation-data-type=float32
      application-data-type=MotCurrRegVltgLimrDaxAntiWdupCoeffDataType, implementation-data-type=float32
      application-data-type=MotCurrRegVltgLimrIvtrLoaScarSlewRateDataType, implementation-data-type=float32
      application-data-type=MotCurrRegVltgLimrQaxAntiWdupCoeffDataType, implementation-data-type=float32
      application-data-type=MotCurrRegVltgLimrQaxAntiWdupScagDiDataType, implementation-data-type=uint8
      application-data-type=MotQuadDetnMotDirHysInstsDataType, implementation-data-type=DataTypes/s18p13
      application-data-type=MotRefMdlCurrDaxBoostGainDataType, implementation-data-type=float32
      application-data-type=MotRefMdlCurrIterTolDataType, implementation-data-type=float32
      application-data-type=MotRefMdlFbCtrlDiDataType, implementation-data-type=uint8
      application-data-type=MotRefMdlIvtrDeadTiBrdgVltgScaDataType, implementation-data-type=float32
      application-data-type=MotRefMdlMinCurrIterLimDataType, implementation-data-type=uint8
      application-data-type=MotRefMdlMotCurrDaxMaxScaDataType, implementation-data-type=float32
      application-data-type=MotRefMdlMotVelLpFilFrqDataType, implementation-data-type=float32
      application-data-type=MotRefMdlMotVltgDerivtvTiConDataType, implementation-data-type=float32
      application-data-type=MotRefMdlRefLocnIterLimDataType, implementation-data-type=uint8
      application-data-type=MotRefMdlTqIterLimDataType, implementation-data-type=uint8
      application-data-type=MotRefMdlTqIterTolDataType, implementation-data-type=float32
      application-data-type=MotRefMdlVltgModDynCmpEnaDataType, implementation-data-type=uint8
      application-data-type=MotRefMdlVltgOvrRThdScaDataType, implementation-data-type=float32
      application-data-type=PwrDiscnctNtc0x042FailStepDataType, implementation-data-type=uint16
      application-data-type=PwrDiscnctNtc0x042PassStepDataType, implementation-data-type=uint16
      application-data-type=PwrDiscnctNtc0x04AFailStepDataType, implementation-data-type=uint16
      application-data-type=PwrDiscnctNtc0x04APassStepDataType, implementation-data-type=uint16
      application-data-type=PwrDiscnctOpenThdDataType, implementation-data-type=float32
      application-data-type=RtnHwAuthySlewDataType, implementation-data-type=float32
      application-data-type=RtnOffsRngDataType, implementation-data-type=float32
      application-data-type=RtnOffsSlewDataType, implementation-data-type=float32
      application-data-type=SinVltgGennDitherLpfCoeffDataType, implementation-data-type=float32
      application-data-type=SysGlbPrmMotPoleCntDataType, implementation-data-type=uint8
      application-data-type=SysGlbPrmSysKineRatDataType, implementation-data-type=float32
      application-data-type=SysGlbPrmSysTqRatDataType, implementation-data-type=float32
      application-data-type=SysGlbPrmTorsBarStfnDataType, implementation-data-type=float32
      application-data-type=TSG31CfgAndUseAdcStrtOfCnvn2OffsDataType, implementation-data-type=uint32
      application-data-type=TSG31CfgAndUseAdcStrtOfCnvnMotCtrlPeakOffsDataType, implementation-data-type=uint32
      application-data-type=TSG31CfgAndUseAdcStrtOfCnvnMotCtrlVlyOffsDataType, implementation-data-type=uint32
      application-data-type=TSG31CfgAndUseMtrAg0SPIStartDataType, implementation-data-type=uint32
      application-data-type=TSG31CfgAndUsePwmDbndDataType, implementation-data-type=uint32
      application-data-type=VehSigCdngDftLatADataType, implementation-data-type=float32
      application-data-type=VehSigCdngDftLgtADataType, implementation-data-type=float32
      application-data-type=VehSigCdngDftVehSpdDataType, implementation-data-type=float32
      application-data-type=VehSigCdngDftYawRateDataType, implementation-data-type=float32
      application-data-type=VehSigCdngLatADifThdDataType, implementation-data-type=float32
      application-data-type=VehSigCdngLatAFilFrqDataType, implementation-data-type=float32
      application-data-type=VehSigCdngLatASlewRateDataType, implementation-data-type=float32
      application-data-type=VehSigCdngLtgADifThdDataType, implementation-data-type=float32
      application-data-type=VehSigCdngLtgASlewRateDataType, implementation-data-type=float32
      application-data-type=VehSigCdngVehSpdDifThdDataType, implementation-data-type=float32
      application-data-type=VehSigCdngVehSpdSlewRateDataType, implementation-data-type=float32
      application-data-type=VehSigCdngVehYawSlewRateDataType, implementation-data-type=float32
      application-data-type=VehSigCdngYawRateDifThdDataType, implementation-data-type=float32
package /DataDictionary/DataTypes
  169 x app type, all with category=VALUE, sw-calibration-access=READ-ONLY:
    AssiPahSumHysCmpLimDataType: range phys 0..0.3, unit=MotNwtMtr
    AssiSumLimNtc0x0C4FailStepDataType: range phys 0..65535, unit=Cnt
    AssiSumLimNtc0x0C4PassStepDataType: range phys 0..65535, unit=Cnt
    AssiSumLimPullCmpLimDataType: range phys 0..8.8, unit=MotNwtMtr
    BattVltgCorrlnAllwdVltgDifDataType: range phys 0..1, unit=Volt
    BattVltgCorrlnNtc0x03C0x0440x04CFailStepDataType: range phys 0..65535, unit=Cnt
    BattVltgCorrlnNtc0x03C0x0440x04CPassStepDataType: range phys 0..65535, unit=Cnt
    BattVltgSwdMaxDataType: range phys 6..26.5, unit=Volt
    CmnMfgSrvCal0RelNrDataType: range phys 0..4294967295, unit=Cnt
    CurrMeasArbnDaxQaxScagFacDataType: range phys 0.5..1, unit=Uls
    CurrMeasArbnMaxStallCntrDataType: range phys 0..255, unit=Cnt
    CurrMeasCorrlnErrNstepDataType: range phys 0..65535, unit=Cnt
    CurrMeasCorrlnErrPstepDataType: range phys 0..65535, unit=Cnt
    CurrMeasCorrlnMaxErrCurrDataType: range phys 0..50, unit=Ampr
    CurrMeasCorrlnMaxStallCntrDataType: range phys 0..255, unit=Cnt
    CurrMeasEolFixdPwmPerdDataType: range phys 55555..71429, unit=NanoSec
    CurrMeasEolGainMaxDataType: range phys 70..76, unit=AmprPerVolt
    CurrMeasEolGainMinDataType: range phys 56..60, unit=AmprPerVolt
    CurrMeasEolGainNrOfSampleDataType: range phys 1..1000, unit=Cnt
    CurrMeasEolGainNumerDataType: range phys 10..100, unit=Ampr
    CurrMeasEolMaxMotVelDataType: range phys 0..1350, unit=MotRadPerSec
    CurrMeasEolOffsHiBrdgVltgMinDataType: range phys 233330..1325008, unit=VoltNanoSec
    CurrMeasEolOffsHiCmuOffsDataType: range phys 0..71429, unit=NanoSec
    CurrMeasEolOffsLoCmuOffsDataType: range phys 0..71429, unit=NanoSec
    CurrMeasEolOffsMaxDataType: range phys 2.8..3, unit=Volt
    CurrMeasEolOffsMinDataType: range phys 2..2.3, unit=Volt
    CurrMeasEolOffsNrOfSampleDataType: range phys 1..10000, unit=Cnt
    CurrMeasEolTranCntrThdDataType: range phys 0..255, unit=Cnt
    CurrMeasMinRqrdPhaOnTiDataType: range phys 6666..8572, unit=NanoSec
    CurrMeasMotAgCompuDlyDataType: range phys 0..30000, unit=NanoSec
    CurrMeasMotCurrAdcVlyEnadMaxDataType: range phys 2.5..4.8, unit=Volt
    CurrMeasMotCurrAdcVlyEnadMinDataType: range phys 0.3..2.5, unit=Volt
    CurrMeasMotCurrAdcVlyWrmIninMaxDataType: range phys 2.5..3, unit=Volt
    CurrMeasMotCurrAdcVlyWrmIninMinDataType: range phys 2..2.5, unit=Volt
    CurrMeasNtc0x05DFailStepDataType: range phys 0..65535, unit=Cnt
    CurrMeasNtc0x05DPassStepDataType: range phys 0..65535, unit=Cnt
    CurrMeasNtc0x06DFailStepDataType: range phys 0..65535, unit=Cnt
    CurrMeasNtc0x06DPassStepDataType: range phys 0..65535, unit=Cnt
    CurrMeasNtc0x1ECFailStepDataType: range phys 0..65535, unit=Cnt
    CurrMeasNtc0x1ECPassStepDataType: range phys 0..65535, unit=Cnt
    CurrMeasNtc0x1EDFailStepDataType: range phys 0..65535, unit=Cnt
    CurrMeasNtc0x1EDPassStepDataType: range phys 0..65535, unit=Cnt
    DampgHydBasCoeff{1..4}DataType: range phys 0..0.1, unit=MotNwtMtrPerMotRadPerSec
    DampgHydOutpLimDataType: range phys -8.8..8.8, unit=MotNwtMtr
    DampgMotVelLpFilFrqDataType: range phys 5..100, unit=Hz
    DampgQuad13MplrDataType: range phys 0..2, unit=Uls
    DampgQuad24MplrDataType: range phys 0..2, unit=Uls
    DampgQuadHwTqBacklshDataType: range phys 0..10, unit=HwNwtMtr
    DampgQuadHwTqLpFilFrqDataType: range phys 5..31.25, unit=Hz
    DampgQuadMotVelBacklshDataType: range phys 0..128, unit=MotRadPerSec
    DampgQuadMotVelLpFilFrqDataType: range phys 5..31.25, unit=Hz
    DampgQuadScaLpFilFrqDataType: range phys 0.0039..100, unit=Hz
    EcuTMeasDftTDataType: range phys -50..150, unit=DegCgrd
    EcuTMeasFilTauDataType: range phys 0.1..10, unit=Hz
    EcuTMeasNtc0x045FailStepDataType: range phys 0..65535, unit=Cnt
    EcuTMeasNtc0x045PassStepDataType: range phys 0..65535, unit=Cnt
    EcuTMeasRngDiagcMaxDataType: range phys -50..200, unit=DegCgrd
    EcuTMeasRngDiagcMinDataType: range phys -50..200, unit=DegCgrd
    EcuTMeasScagDataType: range phys 0..200, unit=DegCgrdPerVolt
    EcuTMeasScagOffsDataType: range phys -100..150, unit=DegCgrd
    GateDrvCtrlNtcNr0x050FailStepDataType: range phys 0..65535, unit=Cnt
    GateDrvCtrlNtcNr0x060FailStepDataType: range phys 0..65535, unit=Cnt
    GateDrvCtrlUnit0Cfg{2..4}WrValDataType: range phys 0..65535, unit=Cnt
    GateDrvCtrlUnit0Cfg7WrValDataType: range phys 0..65535, unit=Cnt
    GateDrvCtrlUnit1Cfg{2..4}WrValDataType: range phys 0..65535, unit=Cnt
    GateDrvCtrlUnit1Cfg7WrValDataType: range phys 0..65535, unit=Cnt
    HwAg0MeasNtc0x093FailStepDataType: range phys 0..65535, unit=Cnt
    HwAg0MeasNtc0x093PassStepDataType: range phys 0..65535, unit=Cnt
    HwAg0MeasNtc0x094FailStepDataType: range phys 0..65535, unit=Cnt
    HwAg0MeasNtc0x094PassStepDataType: range phys 0..65535, unit=Cnt
    HwAg0MeasNtc0x095FailStepDataType: range phys 0..65535, unit=Cnt
    HwAg0MeasNtc0x095PassStepDataType: range phys 0..65535, unit=Cnt
    HwAg0MeasVrnrErrThdDataType: range phys 0..20, unit=Cnt
    HwAg1MeasNtc0x097FailStepDataType: range phys 0..65535, unit=Cnt
    HwAg1MeasNtc0x097PassStepDataType: range phys 0..65535, unit=Cnt
    HwAg1MeasNtc0x098FailStepDataType: range phys 0..65535, unit=Cnt
    HwAg1MeasNtc0x098PassStepDataType: range phys 0..65535, unit=Cnt
    HwAg1MeasNtc0x099FailStepDataType: range phys 0..65535, unit=Cnt
    HwAg1MeasNtc0x099PassStepDataType: range phys 0..65535, unit=Cnt
    HwAg1MeasVrnrErrThdDataType: range phys 0..20, unit=Cnt
    HwTq0MeasNtc0x073FailStepDataType: range phys 0..65535, unit=Cnt
    HwTq0MeasNtc0x073PassStepDataType: range phys 0..65535, unit=Cnt
    HwTqArbnMaxStallTqADataType: range phys 0..255, unit=Cnt
    HwTqArbnMaxStallTqBDataType: range phys 0..255, unit=Cnt
    HwTqArbnMaxStallTqCDataType: range phys 0..255, unit=Cnt
    HwTqArbnMaxStallTqDDataType: range phys 0..255, unit=Cnt
    MotCtrlPrmEstimnFetRNomDataType: range phys 0..0.1, unit=Ohm
    MotCtrlPrmEstimnFetThermCoeffDataType: range phys 0..0.006, unit=OhmPerDegCgrd
    MotCtrlPrmEstimnMagThermCoeffDataType: range phys -0.0015..0, unit=VoltPerMotRadPerSecPerDegCgrd
    MotCtrlPrmEstimnMotBackEmfConHiLimDataType: range phys 0.025..0.075, unit=VoltPerMotRadPerSec
    MotCtrlPrmEstimnMotBackEmfConLoLimDataType: range phys 0.025..0.075, unit=VoltPerMotRadPerSec
    MotCtrlPrmEstimnMotBackEmfConNomDataType: range phys 0.025..0.075, unit=VoltPerMotRadPerSec
    MotCtrlPrmEstimnMotInduDaxHiLimDataType: range phys 3e-05..0.00041, unit=Henry
    MotCtrlPrmEstimnMotInduDaxLoLimDataType: range phys 3e-05..0.00041, unit=Henry
    MotCtrlPrmEstimnMotInduDaxNomDataType: range phys 3e-05..0.00041, unit=Henry
    MotCtrlPrmEstimnMotInduQaxHiLimDataType: range phys 3e-05..0.00041, unit=Henry
    MotCtrlPrmEstimnMotInduQaxLoLimDataType: range phys 3e-05..0.00041, unit=Henry
    MotCtrlPrmEstimnMotInduQaxNomDataType: range phys 3e-05..0.00041, unit=Henry
    MotCtrlPrmEstimnMotRHiLimDataType: range phys 0.005..0.12565, unit=Ohm
    MotCtrlPrmEstimnMotRLoLimDataType: range phys 0.005..0.12565, unit=Ohm
    MotCtrlPrmEstimnMotRNomDataType: range phys 0.005..0.12565, unit=Ohm
    MotCtrlPrmEstimnMotWidgThermCoeffDataType: range phys 0..0.0045, unit=OhmPerDegCgrd
    MotCtrlPrmEstimnTNomDataType: range phys -40..150, unit=DegCgrd
    MotCurrRegCfgCtrlrDynGainVehSpdCutOffDataType: range phys 0..255, unit=Kph
    MotCurrRegCfgCurrLoopSecOrderTrfFcnEnaDataType: range phys 0..1, unit=Cnt
    MotCurrRegCfgIntgrlGainSampleTiDataType: range phys 9.1e-05..0.000143, unit=Sec
    MotCurrRegCfgMotAgCompuDlyDataType: range phys 0..0.0002, unit=Sec
    MotCurrRegCfgMotDampgRatDaxDataType: range phys 0..20, unit=Uls
    MotCurrRegCfgMotDampgRatQaxDataType: range phys 0..20, unit=Uls
    MotCurrRegCfgMotRVirtDaxDataType: range phys 0..0.2, unit=Ohm
    MotCurrRegCfgMotRVirtQaxDataType: range phys 0..0.2, unit=Ohm
    MotCurrRegCfgMotVelFilFrqDataType: range phys 1..200, unit=Hz
    MotCurrRegVltgLimrCurrLoaScarSlewRateDataType: range phys 0..1000, unit=UlsPerSec
    MotCurrRegVltgLimrDaxAntiWdupCoeffDataType: range phys -25..25, unit=Uls
    MotCurrRegVltgLimrIvtrLoaScarSlewRateDataType: range phys 0..1000, unit=UlsPerSec
    MotCurrRegVltgLimrQaxAntiWdupCoeffDataType: range phys -25..25, unit=Uls
    MotCurrRegVltgLimrQaxAntiWdupScagDiDataType: range phys 0..1, unit=Cnt
    MotQuadDetnMotDirHysInstsDataType: range phys 0..6.25, unit=MotDeg
    MotRefMdlCurrDaxBoostGainDataType: range phys 0..1, unit=Uls
    MotRefMdlCurrIterTolDataType: range phys 0.01..20, unit=Ampr
    MotRefMdlFbCtrlDiDataType: range phys 0..1, unit=Cnt
    MotRefMdlIvtrDeadTiBrdgVltgScaDataType: range phys 0.98..1, unit=Uls
    MotRefMdlMinCurrIterLimDataType: range phys 1..5, unit=Cnt
    MotRefMdlMotCurrDaxMaxScaDataType: range phys 1..2, unit=Uls
    MotRefMdlMotVelLpFilFrqDataType: range phys 1..200, unit=Hz
    MotRefMdlMotVltgDerivtvTiConDataType: range phys 0..0.05, unit=Sec
    MotRefMdlRefLocnIterLimDataType: range phys 1..20, unit=Cnt
    MotRefMdlTqIterLimDataType: range phys 1..5, unit=Cnt
    MotRefMdlTqIterTolDataType: range phys 0.001..0.1, unit=MotRad
    MotRefMdlVltgModDynCmpEnaDataType: range phys 0..1, unit=Cnt
    MotRefMdlVltgOvrRThdScaDataType: range phys 0..1, unit=Uls
    PwrDiscnctNtc0x042FailStepDataType: range phys 0..65535, unit=Cnt
    PwrDiscnctNtc0x042PassStepDataType: range phys 0..65535, unit=Cnt
    PwrDiscnctNtc0x04AFailStepDataType: range phys 0..65535, unit=Cnt
    PwrDiscnctNtc0x04APassStepDataType: range phys 0..65535, unit=Cnt
    PwrDiscnctOpenThdDataType: range phys 0..26.5, unit=Volt
    RtnHwAuthySlewDataType: range phys 0.1..10, unit=UlsPerSec
    RtnOffsRngDataType: range phys 0..20, unit=HwDeg
    RtnOffsSlewDataType: range phys 0..0.5, unit=HwDegPerSec
    SinVltgGennDitherLpfCoeffDataType: range phys 0..1, unit=Uls
    SysGlbPrmMotPoleCntDataType: range phys 2..12, unit=Cnt
    SysGlbPrmSysKineRatDataType: range phys 10..40, unit=MotDegPerHwDeg
    SysGlbPrmSysTqRatDataType: range phys 10..40, unit=HwNwtMtrPerMotNwtMtr
    SysGlbPrmTorsBarStfnDataType: range phys 0.5..10, unit=HwNwtMtrPerHwDeg
    TSG31CfgAndUseAdcStrtOfCnvn2OffsDataType: range phys 0..25000, unit=NanoSec
    TSG31CfgAndUseAdcStrtOfCnvnMotCtrlPeakOffsDataType: range phys 0..25000, unit=NanoSec
    TSG31CfgAndUseAdcStrtOfCnvnMotCtrlVlyOffsDataType: range phys 0..25000, unit=NanoSec
    TSG31CfgAndUseMtrAg0SPIStartDataType: range phys 0..71429, unit=NanoSec
    TSG31CfgAndUsePwmDbndDataType: range phys 1..1000, unit=NanoSec
    VehSigCdngDftLatADataType: range phys -10..10, unit=MtrPerSecSqd
    VehSigCdngDftLgtADataType: range phys -50..50, unit=KphPerSec
    VehSigCdngDftVehSpdDataType: range phys 0..511, unit=Kph
    VehSigCdngDftYawRateDataType: range phys -120..120, unit=VehDegPerSec
    VehSigCdngLatADifThdDataType: range phys 0.1..10, unit=MtrPerSecSqd
    VehSigCdngLatAFilFrqDataType: range phys 1..100, unit=Hz
    VehSigCdngLatASlewRateDataType: range phys 0.1..400, unit=MtrPerSecSqd
    VehSigCdngLtgADifThdDataType: range phys 0.1..10, unit=KphPerSec
    VehSigCdngLtgASlewRateDataType: range phys 0.1..500, unit=KphPerSecSqd
    VehSigCdngVehSpdDifThdDataType: range phys 0.1..511, unit=Kph
    VehSigCdngVehSpdSlewRateDataType: range phys 1..50, unit=KphPerSec
    VehSigCdngVehYawSlewRateDataType: range phys 1..1200, unit=VehDegPerSecSqd
    VehSigCdngYawRateDifThdDataType: range phys 0.1..120, unit=VehDegPerSec
  impl type s18p13: compu {raw=phys*8192 for phys >0..<255; unit FixdPt}, implementation-data-type=sint32, type-emitter=RTE
package /DataDictionary/Units
  35 x unit, all with factor-si-to-unit=1, offset-si-to-unit=0:
    Ampr: display-name=Ampr
    AmprPerVolt: display-name=AmprPerVolt
    Cnt: display-name=Cnt
    DegCgrd: display-name=DegCgrd
    DegCgrdPerVolt: display-name=DegCgrdPerVolt
    FixdPt: display-name=FixdPt
    Henry: display-name=Henry
    HwDeg: display-name=HwDeg
    HwDegPerSec: display-name=HwDegPerSec
    HwNwtMtr: display-name=HwNwtMtr
    HwNwtMtrPerHwDeg: display-name=HwNwtMtrPerHwDeg
    HwNwtMtrPerMotNwtMtr: display-name=HwNwtMtrPerMotNwtMtr
    Hz: display-name=Hz
    Kph: display-name=Kph
    KphPerSec: display-name=KphPerSec
    KphPerSecSqd: display-name=KphPerSecSqd
    MotDeg: display-name=MotDeg
    MotDegPerHwDeg: display-name=MotDegPerHwDeg
    MotNwtMtr: display-name=MotNwtMtr
    MotNwtMtrPerMotRadPerSec: display-name=MotNwtMtrPerMotRadPerSec
    MotRad: display-name=MotRad
    MotRadPerSec: display-name=MotRadPerSec
    MtrPerSecSqd: display-name=MtrPerSecSqd
    NanoSec: display-name=NanoSec
    Ohm: display-name=Ohm
    OhmPerDegCgrd: display-name=OhmPerDegCgrd
    Sec: display-name=Sec
    Uls: display-name=Uls
    UlsPerSec: display-name=UlsPerSec
    VehDegPerSec: display-name=VehDegPerSec
    VehDegPerSecSqd: display-name=VehDegPerSecSqd
    Volt: display-name=Volt
    VoltNanoSec: display-name=VoltNanoSec
    VoltPerMotRadPerSec: display-name=VoltPerMotRadPerSec
    VoltPerMotRadPerSecPerDegCgrd: display-name=VoltPerMotRadPerSecPerDegCgrd
package /DataType
  5 x impl type, all with category=VALUE:
    WdgM_CheckpointIdType: base-type=UInt16, range raw 0..65535
    WdgM_GlobalStatusType: base-type=WdgM_GlobalStatusType, compu {0=WDGM_GLOBAL_STATUS_OK, 1=WDGM_GLOBAL_STATUS_FAILED, 2=WDGM_GLOBAL_STATUS_EXPIRED, 3=WDGM_GLOBAL_STATUS_STOPPED, 4=WDGM_GLOBAL_STATUS_DEACTIVATED}, range raw 0..255
    WdgM_LocalStatusType: base-type=WdgM_LocalStatusType, compu {0=WDGM_LOCAL_STATUS_OK, 1=WDGM_LOCAL_STATUS_FAILED, 2=WDGM_LOCAL_STATUS_EXPIRED, 4=WDGM_LOCAL_STATUS_DEACTIVATED}, range raw 0..255
    WdgM_ModeType: base-type=BaseTypes/UInt8, range raw 0..255
    WdgM_SupervisedEntityIdType: base-type=BaseTypes/UInt8, range raw 0..255
package /DataTypes
  impl type Ary1D_u8_12: category=ARRAY, sw-calibration-access=READ-ONLY, type-emitter=RTE
    element Element: array-size=12, array-size-semantics=FIXED-SIZE, implementation-data-type=uint8
  impl type Ary1D_u8_20: category=ARRAY, sw-calibration-access=READ-ONLY, type-emitter=RTE
    element Element: array-size=20, array-size-semantics=FIXED-SIZE, implementation-data-type=uint8
  impl type Ary1D_u8_8: category=ARRAY, sw-calibration-access=READ-ONLY, type-emitter=RTE
    element Element: array-size=8, array-size-semantics=FIXED-SIZE, implementation-data-type=uint8
package /MICROSAR/Dem_swc/DataTypes
  22 x impl type:
    DataArray_Type_1: category=ARRAY, sw-calibration-access=READ-ONLY
      element DataArray_Type_1Element: array-size=1, array-size-semantics=FIXED-SIZE, implementation-data-type=DataTypes/UInt8
    DataArray_Type_2: category=ARRAY, sw-calibration-access=READ-ONLY
      element DataArray_Type_2Element: array-size=2, array-size-semantics=FIXED-SIZE, implementation-data-type=DataTypes/UInt8
    DataArray_Type_4: category=ARRAY, sw-calibration-access=READ-ONLY
      element DataArray_Type_4Element: array-size=4, array-size-semantics=FIXED-SIZE, implementation-data-type=DataTypes/UInt8
    DataArray_Type_5: category=ARRAY, sw-calibration-access=READ-ONLY
      element DataArray_Type_5Element: array-size=5, array-size-semantics=FIXED-SIZE, implementation-data-type=DataTypes/UInt8
    Dem_DebounceResetStatusType: compu {0=DEM_DEBOUNCE_STATUS_FREEZE, 1=DEM_DEBOUNCE_STATUS_RESET}, implementation-data-type=DataTypes/UInt8
    Dem_DebouncingStateType: compu {1=DEM_TEMPORARILY_DEFECTIVE, 2=DEM_FINALLY_DEFECTIVE, 4=DEM_TEMPORARILY_HEALED, 8=DEM_TEST_COMPLETE, 16=DEM_DTR_UPDATE}, implementation-data-type=DataTypes/UInt8
    Dem_DTCFormatType: compu {0=DEM_DTC_FORMAT_OBD, 1=DEM_DTC_FORMAT_UDS, 2=DEM_DTC_FORMAT_J1939}, implementation-data-type=DataTypes/UInt8
    Dem_DTCGroupType: range raw 0..16777215, implementation-data-type=uint32
    Dem_DTCKindType: compu {1=DEM_DTC_KIND_ALL_DTCS, 2=DEM_DTC_KIND_EMISSION_REL_DTCS}, implementation-data-type=DataTypes/UInt8
    Dem_DTCOriginType: compu {1=DEM_DTC_ORIGIN_PRIMARY_MEMORY, 2=DEM_DTC_ORIGIN_MIRROR_MEMORY, 3=DEM_DTC_ORIGIN_PERMANENT_MEMORY, 4=DEM_DTC_ORIGIN_SECONDARY_MEMORY}, implementation-data-type=DataTypes/UInt8
    Dem_DTCStatusMaskType: range raw 0..255, implementation-data-type=DataTypes/UInt8
    Dem_EventIdType: range raw 1..65535, implementation-data-type=uint16
    Dem_EventStatusExtendedType: compu {1=DEM_UDS_STATUS_TF, 2=DEM_UDS_STATUS_TFTOC, 4=DEM_UDS_STATUS_PDTC, 8=DEM_UDS_STATUS_CDTC, 16=DEM_UDS_STATUS_TNCSLC, 32=DEM_UDS_STATUS_TFSLC, 64=DEM_UDS_STATUS_TNCTOC, 128=DEM_UDS_STATUS_WIR}, implementation-data-type=DataTypes/UInt8
    Dem_EventStatusType: compu {0=DEM_EVENT_STATUS_PASSED, 1=DEM_EVENT_STATUS_FAILED, 2=DEM_EVENT_STATUS_PREPASSED, 3=DEM_EVENT_STATUS_PREFAILED}, implementation-data-type=DataTypes/UInt8
    Dem_IndicatorStatusType: compu {0=DEM_INDICATOR_OFF, 1=DEM_INDICATOR_CONTINUOUS, 2=DEM_INDICATOR_BLINKING, 3=DEM_INDICATOR_BLINK_CONT, 4=DEM_INDICATOR_SLOW_FLASH, 5=DEM_INDICATOR_FAST_FLASH, 6=DEM_INDICATOR_ON_DEMAND, 7=DEM_INDICATOR_SHORT}, implementation-data-type=DataTypes/UInt8
    Dem_InitMonitorReasonType: compu {1=DEM_INIT_MONITOR_CLEAR, 2=DEM_INIT_MONITOR_RESTART, 3=DEM_INIT_MONITOR_REENABLED}, implementation-data-type=DataTypes/UInt8
    Dem_IumprDenomCondIdType: compu {1=DEM_IUMPR_GENERAL_DENOMINATOR, 2=DEM_IUMPR_DEN_COND_COLDSTART, 3=DEM_IUMPR_DEN_COND_EVAP, 4=DEM_IUMPR_DEN_COND_500MI}, implementation-data-type=DataTypes/UInt8
    Dem_IumprDenomCondStatusType: compu {0=DEM_IUMPR_DEN_STATUS_NOT_REACHED, 1=DEM_IUMPR_DEN_STATUS_REACHED, 2=DEM_IUMPR_DEN_STATUS_INHIBITED}, implementation-data-type=DataTypes/UInt8
    Dem_MaxDataValueType: category=ARRAY, sw-calibration-access=READ-ONLY
      element Dem_MaxDataValueTypeElement: array-size=5, array-size-semantics=FIXED-SIZE, implementation-data-type=DataTypes/UInt8
    Dem_OperationCycleIdType: range raw 0..255, implementation-data-type=DataTypes/UInt8
    Dem_OperationCycleStateType: compu {0=DEM_CYCLE_STATE_START, 1=DEM_CYCLE_STATE_END}, implementation-data-type=DataTypes/UInt8
    Dem_RatioIdType: range raw 1..65535, implementation-data-type=uint16
package /MICROSAR/NvM_swc/DataTypes
  impl type NvM_BlockIdType: range raw 1..32767, implementation-data-type=uint16
  impl type NvM_RequestResultType: compu {0=NVM_REQ_OK, 1=NVM_REQ_NOT_OK, 2=NVM_REQ_PENDING, 3=NVM_REQ_INTEGRITY_FAILED, 4=NVM_REQ_BLOCK_SKIPPED, 5=NVM_REQ_NV_INVALIDATED, 6=NVM_REQ_CANCELED, 7=NVM_REQ_REDUNDANCY_FAILED, 8=NVM_REQ_RESTORED_FROM_ROM}, implementation-data-type=uint8
package /MICROSAR_SWCS_DEV/BswM_swc
  data type mapping set BswMMappingSet  # Contains Mapping for ModeDeclarations Groups which are provided by BswM.
    mode-request-type-maps:
      implementation-data-type=BswM_ModeGroup_Logl, mode-group=ModeGroup_Logl
      implementation-data-type=BswM_ModeGroup_SysSt, mode-group=ModeGroup_SysSt
package /MICROSAR_SWCS_DEV/BswM_swc/DataTypes
  impl type BswM_ModeGroup_Logl: compu {0=FALSE, 1=TRUE}, implementation-data-type=uint8  # Unique value for each user
  impl type BswM_ModeGroup_SysSt: compu {0=DISABLE, 4=TRANSITION, 1=OFF, 3=WARMININ, 2=ENABLE}, implementation-data-type=uint8  # Unique value for each user
package /MICROSAR_SWCS_DEV/Dem_swc/DataTypes
  22 x impl type:
    DataArray_Type_1: category=ARRAY, sw-calibration-access=READ-ONLY
      element DataArray_Type_1Element: array-size=1, array-size-semantics=FIXED-SIZE, implementation-data-type=uint8
    DataArray_Type_2: category=ARRAY, sw-calibration-access=READ-ONLY
      element DataArray_Type_2Element: array-size=2, array-size-semantics=FIXED-SIZE, implementation-data-type=uint8
    DataArray_Type_4: category=ARRAY, sw-calibration-access=READ-ONLY
      element DataArray_Type_4Element: array-size=4, array-size-semantics=FIXED-SIZE, implementation-data-type=uint8
    DataArray_Type_5: category=ARRAY, sw-calibration-access=READ-ONLY
      element DataArray_Type_5Element: array-size=5, array-size-semantics=FIXED-SIZE, implementation-data-type=uint8
    Dem_DebounceResetStatusType: compu {0=DEM_DEBOUNCE_STATUS_FREEZE, 1=DEM_DEBOUNCE_STATUS_RESET}, implementation-data-type=uint8
    Dem_DebouncingStateType: compu {1=DEM_TEMPORARILY_DEFECTIVE, 2=DEM_FINALLY_DEFECTIVE, 4=DEM_TEMPORARILY_HEALED, 8=DEM_TEST_COMPLETE, 16=DEM_DTR_UPDATE}, implementation-data-type=uint8
    Dem_DTCFormatType: compu {0=DEM_DTC_FORMAT_OBD, 1=DEM_DTC_FORMAT_UDS, 2=DEM_DTC_FORMAT_J1939}, implementation-data-type=uint8
    Dem_DTCGroupType: range raw 0..16777215, implementation-data-type=uint32
    Dem_DTCKindType: compu {1=DEM_DTC_KIND_ALL_DTCS, 2=DEM_DTC_KIND_EMISSION_REL_DTCS}, implementation-data-type=uint8
    Dem_DTCOriginType: compu {1=DEM_DTC_ORIGIN_PRIMARY_MEMORY, 2=DEM_DTC_ORIGIN_MIRROR_MEMORY, 3=DEM_DTC_ORIGIN_PERMANENT_MEMORY, 4=DEM_DTC_ORIGIN_SECONDARY_MEMORY}, implementation-data-type=uint8
    Dem_DTCStatusMaskType: range raw 0..255, implementation-data-type=uint8
    Dem_EventIdType: range raw 1..65535, implementation-data-type=uint16
    Dem_EventStatusExtendedType: compu {1=DEM_UDS_STATUS_TF, 2=DEM_UDS_STATUS_TFTOC, 4=DEM_UDS_STATUS_PDTC, 8=DEM_UDS_STATUS_CDTC, 16=DEM_UDS_STATUS_TNCSLC, 32=DEM_UDS_STATUS_TFSLC, 64=DEM_UDS_STATUS_TNCTOC, 128=DEM_UDS_STATUS_WIR}, implementation-data-type=uint8
    Dem_EventStatusType: compu {0=DEM_EVENT_STATUS_PASSED, 1=DEM_EVENT_STATUS_FAILED, 2=DEM_EVENT_STATUS_PREPASSED, 3=DEM_EVENT_STATUS_PREFAILED}, implementation-data-type=uint8
    Dem_IndicatorStatusType: compu {0=DEM_INDICATOR_OFF, 1=DEM_INDICATOR_CONTINUOUS, 2=DEM_INDICATOR_BLINKING, 3=DEM_INDICATOR_BLINK_CONT, 4=DEM_INDICATOR_SLOW_FLASH, 5=DEM_INDICATOR_FAST_FLASH, 6=DEM_INDICATOR_ON_DEMAND, 7=DEM_INDICATOR_SHORT}, implementation-data-type=uint8
    Dem_InitMonitorReasonType: compu {1=DEM_INIT_MONITOR_CLEAR, 2=DEM_INIT_MONITOR_RESTART, 3=DEM_INIT_MONITOR_REENABLED}, implementation-data-type=uint8
    Dem_IumprDenomCondIdType: compu {1=DEM_IUMPR_GENERAL_DENOMINATOR, 2=DEM_IUMPR_DEN_COND_COLDSTART, 3=DEM_IUMPR_DEN_COND_EVAP, 4=DEM_IUMPR_DEN_COND_500MI}, implementation-data-type=uint8
    Dem_IumprDenomCondStatusType: compu {0=DEM_IUMPR_DEN_STATUS_NOT_REACHED, 1=DEM_IUMPR_DEN_STATUS_REACHED, 2=DEM_IUMPR_DEN_STATUS_INHIBITED}, implementation-data-type=uint8
    Dem_MaxDataValueType: category=ARRAY, sw-calibration-access=READ-ONLY
      element Dem_MaxDataValueTypeElement: array-size=5, array-size-semantics=FIXED-SIZE, implementation-data-type=uint8
    Dem_OperationCycleIdType: range raw 0..255, implementation-data-type=uint8
    Dem_OperationCycleStateType: compu {0=DEM_CYCLE_STATE_START, 1=DEM_CYCLE_STATE_END}, implementation-data-type=uint8
    Dem_RatioIdType: range raw 1..65535, implementation-data-type=uint16
package /MICROSAR_SWCS_DEV/IoHwAb_swc/DataTypes
  impl type IOHWAB_BOOL: implementation-data-type=boolean
package /MICROSAR_SWCS_DEV/NvM_swc/DataTypes
  impl type NvM_BlockIdType: range raw 1..32767, implementation-data-type=uint16
  impl type NvM_RequestResultType: compu {0=NVM_REQ_OK, 1=NVM_REQ_NOT_OK, 2=NVM_REQ_PENDING, 3=NVM_REQ_INTEGRITY_FAILED, 4=NVM_REQ_BLOCK_SKIPPED, 5=NVM_REQ_NV_INVALIDATED, 6=NVM_REQ_CANCELED, 7=NVM_REQ_REDUNDANCY_FAILED, 8=NVM_REQ_RESTORED_FROM_ROM}, implementation-data-type=uint8
package /Nexteer/CDD_NvMProxy_swc/DataTypes
  impl type NvM_BlockIdType: category=VALUE, base-type=BaseTypes/NvM_BlockIdType, range raw 1..32767
  impl type NvM_RequestResultType: category=VALUE, base-type=BaseTypes/NvM_RequestResultType, compu {0=NVM_REQ_OK, 1=NVM_REQ_NOT_OK, 2=NVM_REQ_PENDING, 3=NVM_REQ_INTEGRITY_FAILED, 4=NVM_REQ_BLOCK_SKIPPED, 5=NVM_REQ_NV_INVALIDATED, 6=NVM_REQ_CANCELED, 7=NVM_REQ_REDUNDANCY_FAILED, 8=NVM_REQ_RESTORED_FROM_ROM}
package /Nexteer/CDD_NvMProxy_swc/DataTypes/BaseTypes
  base type NvM_BlockIdType: category=FIXED_LENGTH, base-type-size=16, base-type-encoding=NONE, native-declaration=uint16
  base type NvM_RequestResultType: category=FIXED_LENGTH, base-type-size=8, base-type-encoding=NONE, native-declaration=uint8
package /Nexteer/CDD_NvMProxy_swc/DataTypes/DataConstrs
  range UInt8_Constr: raw 0..255
package /Nexteer/DataConstrs
  range n128pt0_p127pt0: phys -128..127
  range n1pt0e7_p1pt0e5: phys -100000..100000, raw 0
  range n2147483648pt0_p2147483647pt0: phys -2147483648..2147483647
  range n2pt35e7_p2pt35e7: phys -23500000..23500000
  range n32768pt0_p32767pt0: phys -32768..32767
  range n99999pt0_p99999pt0: phys -99999..99999
  range p0pt0_0pt006: phys 0..0.006
  range p0pt0_n8pt8: phys 0..8.8
  range p0pt0_p0pt12565: phys 0..0.12565
  range p0pt0_p250pt0: phys 0..250
  range p0pt0_p2pt8: phys 0..2.8
  range p0pt0_p32pt0: phys 0..32
package /Nexteer/DataTypeMappingSets
  data type mapping set Nexteer
    data-type-maps:
      application-data-type=A{1..5}, implementation-data-type=float32
      application-data-type=Ag1, implementation-data-type=float32
      application-data-type=Ag{10..17}, implementation-data-type=float32
      application-data-type=Ag18, implementation-data-type=u12p4
      application-data-type=Ag19, implementation-data-type=float32
      application-data-type=Ag2, implementation-data-type=float32
      application-data-type=Ag3, implementation-data-type=float32
      application-data-type=Ag4, implementation-data-type=s2p13
      application-data-type=Ag5, implementation-data-type=u0p16
      application-data-type=Ag6, implementation-data-type=DataTypes/s18p13
      application-data-type=Ag7, implementation-data-type=DataTypes/s18p13
      application-data-type=Ag8, implementation-data-type=s15p16
      application-data-type=Ag9, implementation-data-type=u0p16
      application-data-type=AgAry1D1, implementation-data-type=Ary1D_s2p13_1024
      application-data-type=AgAry1D2, implementation-data-type=Ary1D_u0p16_8
      application-data-type=AgAry1D3, implementation-data-type=Ary1D_s2p13_1025
      application-data-type=AgAry1D4, implementation-data-type=Ary1D_f32_8
      application-data-type=AgAry1D5, implementation-data-type=Ary1D_u12p4_16
      application-data-type=AgAry2D1, implementation-data-type=Ary2D_u12p4_9_16
      application-data-type=Cnt1, implementation-data-type=uint8
      application-data-type=Cnt10, implementation-data-type=uint16
      application-data-type=Cnt11, implementation-data-type=uint16
      application-data-type=Cnt{12..14}, implementation-data-type=uint8
      application-data-type=Cnt15, implementation-data-type=uint32
      application-data-type=Cnt16, implementation-data-type=uint16
      application-data-type=Cnt17, implementation-data-type=uint32
      application-data-type=Cnt18, implementation-data-type=uint8
      application-data-type=Cnt19, implementation-data-type=uint8
      application-data-type=Cnt2, implementation-data-type=sint8
      application-data-type=Cnt20, implementation-data-type=sint16
      application-data-type=Cnt21, implementation-data-type=uint8
      application-data-type=Cnt22, implementation-data-type=uint8
      application-data-type=Cnt23, implementation-data-type=u16p0
      application-data-type=Cnt24, implementation-data-type=uint8
      application-data-type=Cnt25, implementation-data-type=uint8
      application-data-type=Cnt26, implementation-data-type=u16p0
      application-data-type=Cnt{27..29}, implementation-data-type=uint8
      application-data-type=Cnt3, implementation-data-type=uint16
      application-data-type=Cnt30, implementation-data-type=uint8
      application-data-type=Cnt31, implementation-data-type=uint16
      application-data-type=Cnt32, implementation-data-type=float32
      application-data-type=Cnt33, implementation-data-type=uint8
      application-data-type=Cnt34, implementation-data-type=float32
      application-data-type=Cnt35, implementation-data-type=sint16
      application-data-type=Cnt4, implementation-data-type=uint16
      application-data-type=Cnt5, implementation-data-type=uint16
      application-data-type=Cnt6, implementation-data-type=uint8
      application-data-type=Cnt7, implementation-data-type=uint8
      application-data-type=Cnt8, implementation-data-type=uint32
      application-data-type=Cnt9, implementation-data-type=uint16
      application-data-type=CntAry1D1, implementation-data-type=Ary1D_u16p0_2
      application-data-type=CntAry1D2, implementation-data-type=Ary1D_u32_8
      application-data-type=CntAry1D3, implementation-data-type=Ary1D_u16_257
      application-data-type=CntAry1D4, implementation-data-type=Ary1D_u16p0_2
      application-data-type=CntAry1D5, implementation-data-type=Ary1D_u8_22
      application-data-type=CntAry1D6, implementation-data-type=Ary1D_s16_22
      application-data-type=Curr{1..7}, implementation-data-type=float32
      application-data-type=Curr8, implementation-data-type=u9p7
      application-data-type=Curr9, implementation-data-type=float32
      application-data-type=CurrAry1D1, implementation-data-type=Ary1D_u9p7_16
      application-data-type=CurrAry1D2, implementation-data-type=Ary1D_u9p7_6
      application-data-type=CurrAry1D3, implementation-data-type=Ary1D_u9p7_7
      application-data-type=CurrSqd1, implementation-data-type=float32
      application-data-type=Frq1, implementation-data-type=float32
      application-data-type=Frq10, implementation-data-type=float32
      application-data-type=Frq2, implementation-data-type=float32
      application-data-type=Frq3, implementation-data-type=u10p6
      application-data-type=Frq4, implementation-data-type=u10p6
      application-data-type=Frq5, implementation-data-type=u9p7
      application-data-type=Frq6, implementation-data-type=u9p7
      application-data-type=Frq{7..9}, implementation-data-type=float32
      application-data-type=FrqAry1D1, implementation-data-type=Ary1D_u10p6_4
      application-data-type=FrqAry1D2, implementation-data-type=Ary1D_u10p6_4
      application-data-type=FrqAry1D3, implementation-data-type=Ary1D_u9p7_4
      application-data-type=FrqAry1D4, implementation-data-type=Ary1D_u9p7_4
      application-data-type=Gain{1..8}, implementation-data-type=float32
      application-data-type=HwAgOffsRecAppl1, implementation-data-type=HwAgOffsRec1
      application-data-type=Indu1, implementation-data-type=float32
      application-data-type=Indu2, implementation-data-type=float32
      application-data-type=Logl1, implementation-data-type=boolean
      application-data-type=MotCon1, implementation-data-type=float32
      application-data-type=MotPrmNomEolRecAppl2, implementation-data-type=MotPrmNomEolRec2
      application-data-type=MotPrmNomEolRecAppl3, implementation-data-type=MotPrmNomEolRec3
      application-data-type=R{1..8}, implementation-data-type=float32
      application-data-type=Rate1, implementation-data-type=float32
      application-data-type=Rate10, implementation-data-type=float32
      application-data-type=Rate{2..9}, implementation-data-type=float32
      application-data-type=Spd1, implementation-data-type=float32
      application-data-type=Spd2, implementation-data-type=u9p7
      application-data-type=Spd3, implementation-data-type=float32
      application-data-type=Spd4, implementation-data-type=float32
      application-data-type=SpdAry1D1, implementation-data-type=Ary1D_u9p7_12
      application-data-type=SpdAry1D2, implementation-data-type=Ary1D_u9p7_9
      application-data-type=T{1..5}, implementation-data-type=float32
      application-data-type=T6, implementation-data-type=s11p4
      application-data-type=T7, implementation-data-type=s8p7
      application-data-type=T8, implementation-data-type=float32
      application-data-type=TAry1D1, implementation-data-type=Ary1D_s11p4_14
      application-data-type=TAry1D2, implementation-data-type=Ary1D_s8p7_14
      application-data-type=Ti1, implementation-data-type=uint32
      application-data-type=Ti{10..12}, implementation-data-type=float32
      application-data-type=Ti{2..6}, implementation-data-type=uint32
      application-data-type=Ti7, implementation-data-type=float32
      application-data-type=Ti8, implementation-data-type=float32
      application-data-type=Ti9, implementation-data-type=uint32
      application-data-type=Tq1, implementation-data-type=float32
      application-data-type=Tq10, implementation-data-type=float32
      application-data-type=Tq11, implementation-data-type=s4p11
      application-data-type=Tq12, implementation-data-type=u5p11
      application-data-type=Tq13, implementation-data-type=u4p12
      application-data-type=Tq14, implementation-data-type=u5p11
      application-data-type=Tq{15..19}, implementation-data-type=float32
      application-data-type=Tq2, implementation-data-type=float32
      application-data-type=Tq3, implementation-data-type=float32
      application-data-type=Tq4, implementation-data-type=u5p11
      application-data-type=Tq5, implementation-data-type=s4p11
      application-data-type=Tq6, implementation-data-type=u8p8
      application-data-type=Tq7, implementation-data-type=u5p11
      application-data-type=Tq8, implementation-data-type=float32
      application-data-type=Tq9, implementation-data-type=float32
      application-data-type=TqAry1D1, implementation-data-type=Ary1D_s4p11_20
      application-data-type=TqAry1D10, implementation-data-type=Ary1D_u4p12_12
      application-data-type=TqAry1D11, implementation-data-type=Ary1D_u5p11_13
      application-data-type=TqAry1D2, implementation-data-type=Ary1D_u8p8_20
      application-data-type=TqAry1D3, implementation-data-type=Ary1D_u5p11_5
      application-data-type=TqAry1D4, implementation-data-type=Ary1D_s4p11_20
      application-data-type=TqAry1D5, implementation-data-type=Ary1D_u5p11_5
      application-data-type=TqAry1D6, implementation-data-type=Ary1D_u4p12_11
      application-data-type=TqAry1D7, implementation-data-type=Ary1D_u5p11_16
      application-data-type=TqAry1D8, implementation-data-type=Ary1D_u8p8_8
      application-data-type=TqAry1D9, implementation-data-type=Ary1D_u8p8_2
      application-data-type=TqAry2D1, implementation-data-type=Ary2D_s4p11_12_20
      application-data-type=TqAry2D2, implementation-data-type=Ary2D_u8p8_12_20
      application-data-type=TqAry2D3, implementation-data-type=Ary2D_u5p11_12_5
      application-data-type=TqAry2D4, implementation-data-type=Ary2D_s4p11_12_20
      application-data-type=TqAry2D5, implementation-data-type=Ary2D_u5p11_12_5
      application-data-type=TqAry2D6, implementation-data-type=Ary2D_u5p11_9_16
      application-data-type=TqAry2D7, implementation-data-type=Ary2D_u8p8_9_8
      application-data-type=TqAry2D8, implementation-data-type=Ary2D_u5p11_12_13
      application-data-type=Uls1, implementation-data-type=float32
      application-data-type=Uls10, implementation-data-type=float32
      application-data-type=Uls11, implementation-data-type=u2p14
      application-data-type=Uls{12..14}, implementation-data-type=float32
      application-data-type=Uls15, implementation-data-type=u1p15
      application-data-type=Uls16, implementation-data-type=float32
      application-data-type=Uls17, implementation-data-type=u8p8
      application-data-type=Uls18, implementation-data-type=u9p7
      application-data-type=Uls19, implementation-data-type=u8p8
      application-data-type=Uls2, implementation-data-type=float32
      application-data-type=Uls20, implementation-data-type=u4p12
      application-data-type=Uls21, implementation-data-type=float32
      application-data-type=Uls22, implementation-data-type=float32
      application-data-type=Uls23, implementation-data-type=u8p8
      application-data-type=Uls24, implementation-data-type=uint8
      application-data-type=Uls3, implementation-data-type=sint8
      application-data-type=Uls4, implementation-data-type=u2p14
      application-data-type=Uls{5..9}, implementation-data-type=float32
      application-data-type=UlsAry1D1, implementation-data-type=Ary1D_u2p14_5
      application-data-type=UlsAry1D10, implementation-data-type=Ary1D_u8p8_4
      application-data-type=UlsAry1D11, implementation-data-type=Ary1D_u8p8_14
      application-data-type=UlsAry1D12, implementation-data-type=Ary1D_u1p15_2
      application-data-type=UlsAry1D13, implementation-data-type=Ary1D_u4p12_12
      application-data-type=UlsAry1D14, implementation-data-type=Ary1D_u4p12_14
      application-data-type=UlsAry1D15, implementation-data-type=Ary1D_u8p8_14
      application-data-type=UlsAry1D2, implementation-data-type=Ary1D_u2p14_2
      application-data-type=UlsAry1D3, implementation-data-type=Ary1D_u2p14_16
      application-data-type=UlsAry1D4, implementation-data-type=Ary1D_u2p14_6
      application-data-type=UlsAry1D5, implementation-data-type=Ary1D_u1p15_11
      application-data-type=UlsAry1D6, implementation-data-type=Ary1D_f32_8
      application-data-type=UlsAry1D7, implementation-data-type=Ary1D_u8p8_4
      application-data-type=UlsAry1D8, implementation-data-type=Ary1D_u9p7_4
      application-data-type=UlsAry1D9, implementation-data-type=Ary1D_u8p8_8
      application-data-type=UlsAry2D1, implementation-data-type=Ary2D_u2p14_12_5
      application-data-type=UlsAry2D2, implementation-data-type=Ary2D_u2p14_7_6
      application-data-type=UlsAry2D3, implementation-data-type=Ary2D_u8p8_9_8
      application-data-type=UlsAry2D4, implementation-data-type=Ary2D_u8p8_9_4
      application-data-type=Vel{1..3}, implementation-data-type=float32
      application-data-type=Vel4, implementation-data-type=u11p5
      application-data-type=Vel5, implementation-data-type=float32
      application-data-type=Vel6, implementation-data-type=u7p9
      application-data-type=Vel7, implementation-data-type=u12p4
      application-data-type=Vel8, implementation-data-type=float32
      application-data-type=Vel9, implementation-data-type=float32
      application-data-type=VelAry1D1, implementation-data-type=Ary1D_u11p5_4
      application-data-type=VelAry1D2, implementation-data-type=Ary1D_u11p5_11
      application-data-type=VelAry1D3, implementation-data-type=Ary1D_u11p5_10
      application-data-type=VelAry1D4, implementation-data-type=Ary1D_u7p9_4
      application-data-type=VelAry1D5, implementation-data-type=Ary1D_u12p4_13
      application-data-type=VelAry2D1, implementation-data-type=Ary2D_u7p9_8_4
      application-data-type=VelAry2D2, implementation-data-type=Ary2D_u7p9_9_4
      application-data-type=VelAry2D3, implementation-data-type=Ary2D_u12p4_12_13
      application-data-type=Volt1, implementation-data-type=float32
      application-data-type=Volt{10..17}, implementation-data-type=float32
      application-data-type=Volt18, implementation-data-type=u3p13
      application-data-type=Volt{2..9}, implementation-data-type=float32
      application-data-type=VoltAry1D1, implementation-data-type=Ary1D_u3p13_10
      application-data-type=VoltGain1, implementation-data-type=float32
      application-data-type=VoltTi1, implementation-data-type=uint32
      application-data-type=VoltTi2, implementation-data-type=uint32
package /Nexteer/DataTypes
  72 x application array data type, all with category=ARRAY, sw-calibration-access=READ-ONLY:
    AgAry1D1
      element Element: category=VALUE, type=Ag4, array-size-semantics=FIXED-SIZE, max-number-of-elements=1024
    AgAry1D2
      element Element: category=VALUE, type=Ag5, array-size-semantics=FIXED-SIZE, max-number-of-elements=8
    AgAry1D3
      element Element: category=VALUE, type=Ag4, array-size-semantics=FIXED-SIZE, max-number-of-elements=1025
    AgAry1D4
      element Element: category=VALUE, type=Ag14, array-size-semantics=FIXED-SIZE, max-number-of-elements=8
    AgAry1D5
      element Element: category=VALUE, type=Ag18, array-size-semantics=FIXED-SIZE, max-number-of-elements=16
    AgAry2D1
      element Element: category=ARRAY, type=AgAry1D5, array-size-semantics=FIXED-SIZE, max-number-of-elements=9
    CntAry1D1
      element Element: category=VALUE, type=Cnt23, array-size-semantics=FIXED-SIZE, max-number-of-elements=2
    CntAry1D2
      element Element: category=VALUE, type=Cnt15, array-size-semantics=FIXED-SIZE, max-number-of-elements=8
    CntAry1D3
      element Element: category=VALUE, type=Cnt16, array-size-semantics=FIXED-SIZE, max-number-of-elements=257
    CntAry1D4
      element Element: category=VALUE, type=Cnt26, array-size-semantics=FIXED-SIZE, max-number-of-elements=2
    CntAry1D5
      element Element: category=VALUE, type=Cnt19, array-size-semantics=FIXED-SIZE, max-number-of-elements=22
    CntAry1D6
      element Element: category=VALUE, type=Cnt35, array-size-semantics=FIXED-SIZE, max-number-of-elements=22
    CurrAry1D1
      element Element: category=VALUE, type=Curr8, array-size-semantics=FIXED-SIZE, max-number-of-elements=16
    CurrAry1D2
      element Element: category=VALUE, type=Curr8, array-size-semantics=FIXED-SIZE, max-number-of-elements=6
    CurrAry1D3
      element Element: category=VALUE, type=Curr8, array-size-semantics=FIXED-SIZE, max-number-of-elements=7
    FrqAry1D1
      element Element: category=VALUE, type=Frq3, array-size-semantics=FIXED-SIZE, max-number-of-elements=4
    FrqAry1D2
      element Element: category=VALUE, type=Frq4, array-size-semantics=FIXED-SIZE, max-number-of-elements=4
    FrqAry1D3
      element Element: category=VALUE, type=Frq5, array-size-semantics=FIXED-SIZE, max-number-of-elements=4
    FrqAry1D4
      element Element: category=VALUE, type=Frq6, array-size-semantics=FIXED-SIZE, max-number-of-elements=4
    NvMProxyFltTblApplAry1D1
      element Element: category=STRUCTURE, type=NvMProxyFltTblApplRec1, array-size-semantics=FIXED-SIZE, max-number-of-elements=5
    NvMProxyRtnBufApplAry1D
      element Element: category=STRUCTURE, type=NvMProxyRtnBufApplRec, array-size-semantics=FIXED-SIZE, max-number-of-elements=30
    SpdAry1D1
      element Element: category=VALUE, type=Spd2, array-size-semantics=FIXED-SIZE, max-number-of-elements=12
    SpdAry1D2
      element Element: category=VALUE, type=Spd2, array-size-semantics=FIXED-SIZE, max-number-of-elements=9
    TAry1D1
      element Element: category=VALUE, type=T6, array-size-semantics=FIXED-SIZE, max-number-of-elements=14
    TAry1D2
      element Element: category=VALUE, type=T7, array-size-semantics=FIXED-SIZE, max-number-of-elements=14
    TqAry1D1
      element Element: category=VALUE, type=Tq5, array-size-semantics=FIXED-SIZE, max-number-of-elements=20
    TqAry1D10
      element Element: category=VALUE, type=Tq13, array-size-semantics=FIXED-SIZE, max-number-of-elements=12
    TqAry1D11
      element Element: category=VALUE, type=Tq12, array-size-semantics=FIXED-SIZE, max-number-of-elements=13
    TqAry1D2
      element Element: category=VALUE, type=Tq6, array-size-semantics=FIXED-SIZE, max-number-of-elements=20
    TqAry1D3
      element Element: category=VALUE, type=Tq7, array-size-semantics=FIXED-SIZE, max-number-of-elements=5
    TqAry1D4
      element Element: category=VALUE, type=Tq11, array-size-semantics=FIXED-SIZE, max-number-of-elements=20
    TqAry1D5
      element Element: category=VALUE, type=Tq12, array-size-semantics=FIXED-SIZE, max-number-of-elements=5
    TqAry1D6
      element Element: category=VALUE, type=Tq13, array-size-semantics=FIXED-SIZE, max-number-of-elements=11
    TqAry1D7
      element Element: category=VALUE, type=Tq14, array-size-semantics=FIXED-SIZE, max-number-of-elements=16
    TqAry1D8
      element Element: category=VALUE, type=Tq6, array-size-semantics=FIXED-SIZE, max-number-of-elements=8
    TqAry1D9
      element Element: category=VALUE, type=Tq6, array-size-semantics=FIXED-SIZE, max-number-of-elements=2
    TqAry2D1
      element Element: category=ARRAY, type=TqAry1D1, array-size-semantics=FIXED-SIZE, max-number-of-elements=12
    TqAry2D2
      element Element: category=ARRAY, type=TqAry1D2, array-size-semantics=FIXED-SIZE, max-number-of-elements=12
    TqAry2D3
      element Element: category=ARRAY, type=TqAry1D3, array-size-semantics=FIXED-SIZE, max-number-of-elements=12
    TqAry2D4
      element Element: category=ARRAY, type=TqAry1D4, array-size-semantics=FIXED-SIZE, max-number-of-elements=12
    TqAry2D5
      element Element: category=ARRAY, type=TqAry1D5, array-size-semantics=FIXED-SIZE, max-number-of-elements=12
    TqAry2D6
      element Element: category=ARRAY, type=TqAry1D7, array-size-semantics=FIXED-SIZE, max-number-of-elements=9
    TqAry2D7
      element Element: category=ARRAY, type=TqAry1D8, array-size-semantics=FIXED-SIZE, max-number-of-elements=9
    TqAry2D8
      element Element: category=ARRAY, type=TqAry1D11, array-size-semantics=FIXED-SIZE, max-number-of-elements=12
    UlsAry1D1
      element Element: category=VALUE, type=Uls4, array-size-semantics=FIXED-SIZE, max-number-of-elements=5
    UlsAry1D10
      element Element: category=VALUE, type=Uls19, array-size-semantics=FIXED-SIZE, max-number-of-elements=4
    UlsAry1D11
      element Element: category=VALUE, type=Uls17, array-size-semantics=FIXED-SIZE, max-number-of-elements=14
    UlsAry1D12
      element Element: category=VALUE, type=Uls15, array-size-semantics=FIXED-SIZE, max-number-of-elements=2
    UlsAry1D13
      element Element: category=VALUE, type=Uls20, array-size-semantics=FIXED-SIZE, max-number-of-elements=12
    UlsAry1D14
      element Element: category=VALUE, type=Uls20, array-size-semantics=FIXED-SIZE, max-number-of-elements=14
    UlsAry1D15
      element Element: category=VALUE, type=Uls23, array-size-semantics=FIXED-SIZE, max-number-of-elements=14
    UlsAry1D2
      element Element: category=VALUE, type=Uls4, array-size-semantics=FIXED-SIZE, max-number-of-elements=2
    UlsAry1D3
      element Element: category=VALUE, type=Uls11, array-size-semantics=FIXED-SIZE, max-number-of-elements=16
    UlsAry1D4
      element Element: category=VALUE, type=Uls11, array-size-semantics=FIXED-SIZE, max-number-of-elements=6
    UlsAry1D5
      element Element: category=VALUE, type=Uls15, array-size-semantics=FIXED-SIZE, max-number-of-elements=11
    UlsAry1D6
      element Element: category=VALUE, type=Uls12, array-size-semantics=FIXED-SIZE, max-number-of-elements=8
    UlsAry1D7
      element Element: category=VALUE, type=Uls17, array-size-semantics=FIXED-SIZE, max-number-of-elements=4
    UlsAry1D8
      element Element: category=VALUE, type=Uls18, array-size-semantics=FIXED-SIZE, max-number-of-elements=4
    UlsAry1D9
      element Element: category=VALUE, type=Uls17, array-size-semantics=FIXED-SIZE, max-number-of-elements=8
    UlsAry2D1
      element Element: category=ARRAY, type=UlsAry1D1, array-size-semantics=FIXED-SIZE, max-number-of-elements=12
    UlsAry2D2
      element Element: category=ARRAY, type=UlsAry1D4, array-size-semantics=FIXED-SIZE, max-number-of-elements=7
    UlsAry2D3
      element Element: category=ARRAY, type=UlsAry1D9, array-size-semantics=FIXED-SIZE, max-number-of-elements=9
    UlsAry2D4
      element Element: category=ARRAY, type=UlsAry1D10, array-size-semantics=FIXED-SIZE, max-number-of-elements=9
    VelAry1D1
      element Element: category=VALUE, type=Vel4, array-size-semantics=FIXED-SIZE, max-number-of-elements=4
    VelAry1D2
      element Element: category=VALUE, type=Vel4, array-size-semantics=FIXED-SIZE, max-number-of-elements=11
    VelAry1D3
      element Element: category=VALUE, type=Vel4, array-size-semantics=FIXED-SIZE, max-number-of-elements=10
    VelAry1D4
      element Element: category=VALUE, type=Vel6, array-size-semantics=FIXED-SIZE, max-number-of-elements=4
    VelAry1D5
      element Element: category=VALUE, type=Vel7, array-size-semantics=FIXED-SIZE, max-number-of-elements=13
    VelAry2D1
      element Element: category=ARRAY, type=VelAry1D4, array-size-semantics=FIXED-SIZE, max-number-of-elements=8
    VelAry2D2
      element Element: category=ARRAY, type=VelAry1D4, array-size-semantics=FIXED-SIZE, max-number-of-elements=9
    VelAry2D3
      element Element: category=ARRAY, type=VelAry1D5, array-size-semantics=FIXED-SIZE, max-number-of-elements=12
    VoltAry1D1
      element Element: category=VALUE, type=Volt18, array-size-semantics=FIXED-SIZE, max-number-of-elements=10
  206 x app type, all with sw-calibration-access=READ-ONLY:
    A1: category=VALUE, range phys -10..10, unit=m/s^2
    A2: category=VALUE, range phys -180..180, unit=m/s^2
    A3: category=VALUE, range phys -50..50, unit=kph/s
    A4: category=VALUE, range phys 0.1..10, unit=m/s^2
    A5: category=VALUE, range phys 0.1..10, unit=kph/s
    Ag1: category=VALUE, range phys 0..6.25, unit=MotDeg
    Ag10: category=VALUE, range phys 0..6.2832, unit=MotRad
    Ag11: category=VALUE, range phys 10..40, unit=MotDeg/HwDeg
    Ag12: category=VALUE, range phys -1.62..1.62, unit=MotRad
    Ag13: category=VALUE, range phys 0.001..0.1, unit=MotRad
    Ag14: category=VALUE, range phys -3.1415927..3.1415927, unit=MotRad
    Ag15: category=VALUE, range phys -1440..1440, unit=HwDeg
    Ag16: category=VALUE, range phys 0..20, unit=HwDeg
    Ag17: category=VALUE, range phys 0..1440, unit=HwDeg
    Ag18: category=VALUE, compu {phys=raw*16 for raw 0; unit Units/FixdPt}, range phys 0..1440, unit=HwDeg
    Ag19: category=VALUE, range phys -900..900, unit=HwDeg
    Ag2: category=VALUE, range phys -11796480..11796480, unit=MotDeg
    Ag3: category=VALUE, range phys 0..0.999, unit=MotRevElec
    Ag4: category=VALUE, compu {raw=phys*8192 for phys 0; unit Units/FixdPt}, range phys -0.05555555556..0.05555555556, unit=MotRev
    Ag5: category=VALUE, compu {raw=phys*65536 for phys 0; unit Units/FixdPt}, range phys 0..0.9999847412, unit=MotRev
    Ag6: category=VALUE, compu {raw=phys*8192 for phys 0; unit Units/FixdPt}, range phys 0..6.25, unit=MotDeg
    Ag7: category=VALUE, compu {raw=phys*8192 for phys 0; unit Units/FixdPt}, range phys -262144..262143.9998, unit=MotDeg
    Ag8: category=VALUE, compu {raw=phys*65536 for phys 0; unit Units/FixdPt}, range phys -32768..32767.999984741, unit=MotRev
    Ag9: category=VALUE, compu {raw=phys*65536 for phys 0; unit Units/FixdPt}, range phys 0..0.9999847412, unit=MotRevElec
    Cnt1: category=VALUE, range phys 1..4, unit=Cnt
    Cnt10: category=VALUE, range phys 1..10000, unit=Cnt
    Cnt11: category=VALUE, range phys 0..10000, unit=Cnt
    Cnt12: category=VALUE, range phys 0..3, unit=Cnt
    Cnt13: category=VALUE, range phys 0..3, unit=Cnt
    Cnt14: category=VALUE, range phys 2..12, unit=Cnt
    Cnt15: category=VALUE, range phys 0..4294967295, unit=Cnt
    Cnt16: category=VALUE, range phys 0..65535, unit=Cnt
    Cnt17: category=VALUE, range phys 0..67108863, unit=Cnt
    Cnt18: category=VALUE, range phys 0..31, unit=Cnt
    Cnt19: category=VALUE, range phys 0..255, unit=Cnt
    Cnt2: category=VALUE, range phys -1..1, unit=Cnt
    Cnt20: category=VALUE, range phys -512..511, unit=Cnt
    Cnt21: category=VALUE, range phys 1..3, unit=Cnt
    Cnt22: category=VALUE, range phys 0..7, unit=Cnt
    Cnt23: category=VALUE, range phys 0..100, unit=Cnt
    Cnt24: category=VALUE, range phys 0..42, unit=Cnt
    Cnt25: category=VALUE, range phys 0..2, unit=Cnt
    Cnt26: category=VALUE, range phys 0..200, unit=Cnt
    Cnt27: category=VALUE, range phys 0..8, unit=Cnt
    Cnt28: category=VALUE, range phys 1..5, unit=Cnt
    Cnt29: category=VALUE, range phys 1..20, unit=Cnt
    Cnt3: category=VALUE, range phys 0..1, unit=Cnt
    Cnt30: category=VALUE, range phys 0..20, unit=Cnt
    Cnt31: category=VALUE, range phys 0..4095, unit=Cnt
    Cnt32: category=VALUE, range phys 0..360, unit=Cnt
    Cnt33: category=VALUE, range phys 0..22, unit=Cnt
    Cnt34: category=VALUE, range phys -900..900, unit=Cnt
    Cnt35: category=VALUE, range phys -500..500, unit=Cnt
    Cnt4: category=VALUE, range phys 0..31, unit=Cnt
    Cnt5: category=VALUE, range phys 0..32767, unit=Cnt
    Cnt6: category=VALUE, range phys 0..63, unit=Cnt
    Cnt7: category=VALUE, range phys 20..160, unit=Cnt
    Cnt8: category=VALUE, range phys 0..1800, unit=Cnt
    Cnt9: category=VALUE, range phys 1..1000, unit=Cnt
    Curr1: category=VALUE, range phys -145..145, unit=Amp
    Curr2: category=VALUE, range phys 0..50, unit=Amp
    Curr3: category=VALUE, range phys 10..100, unit=Amp
    Curr4: category=VALUE, range phys -450..450, unit=Amp
    Curr5: category=VALUE, range phys -1000..1000, unit=Amp
    Curr6: category=VALUE, range phys 0..200, unit=Amp
    Curr7: category=VALUE, range phys -200..200, unit=Amp
    Curr8: category=VALUE, compu {raw=phys*128 for phys 0; unit Units/FixdPt}, range phys 0..200, unit=Amp
    Curr9: category=VALUE, range phys 0.01..20, unit=Amp
    CurrSqd1: category=VALUE, range phys 0..40000, unit=Amp^2
    Frq1: category=VALUE, range phys 0.1..10, unit=Hz
    Frq10: category=VALUE, range phys 1..100, unit=Hz
    Frq2: category=VALUE, range phys 1..200, unit=Hz
    Frq3: category=VALUE, compu {raw=phys*64 for phys 0; unit Units/FixdPt}, range phys 0..750, unit=Hz
    Frq4: category=VALUE, compu {raw=phys*64 for phys 0; unit Units/FixdPt}, range phys 0..1000, unit=Hz
    Frq5: category=VALUE, compu {raw=phys*128 for phys 0; unit Units/FixdPt}, range phys 0..500, unit=Hz
    Frq6: category=VALUE, compu {raw=phys*128 for phys 0; unit Units/FixdPt}, range phys 0..400, unit=Hz
    Frq7: category=VALUE, range phys 5..100, unit=Hz
    Frq8: category=VALUE, range phys 5..31.25, unit=Hz
    Frq9: category=VALUE, range phys 0.0039..100, unit=Hz
    Gain1: category=VALUE, range phys 0..200, unit=degC/Volt
    Gain2: category=VALUE, range phys 70..76, unit=Amp/V
    Gain3: category=VALUE, range phys 56..60, unit=Amp/V
    Gain4: category=VALUE, range phys 0..76, unit=Amp/V
    Gain5: category=VALUE, range phys 0..0.006, unit=ohm/degC
    Gain6: category=VALUE, range phys -0.0015..0, unit=V/MotRad/S/degC
    Gain7: category=VALUE, range phys 0..0.0045, unit=ohm/degC
    Gain8: category=VALUE, range phys 0..0.1, unit=MotNm/MotRad/S
    Indu1: category=VALUE, range phys 3e-05..0.00041, unit=H
    Indu2: category=VALUE, range phys 0..0.0023, unit=H
    Logl1: category=BOOLEAN, range phys 0..1
    MotCon1: category=VALUE, range phys 0.025..0.075, unit=V/MotRad/Sec
    R1: category=VALUE, range phys 0..0.2, unit=ohm
    R2: category=VALUE, range phys 0..45, unit=ohm
    R3: category=VALUE, range phys 0..2.25, unit=ohm
    R4: category=VALUE, range phys 0..3.6, unit=ohm
    R5: category=VALUE, range phys 0.005..0.125, unit=ohm
    R6: category=VALUE, range phys 0.005..0.12565, unit=ohm
    R7: category=VALUE, range phys -0.5..0.5, unit=ohm
    R8: category=VALUE, range phys 0..0.1, unit=ohm
    Rate1: category=VALUE, range phys 0.1..500, unit=Uls/S
    Rate10: category=VALUE, range phys 1..1200, unit=VehDeg/S^2
    Rate2: category=VALUE, range phys 0..500, unit=Uls/S
    Rate3: category=VALUE, range phys 0..1000, unit=Uls/S
    Rate4: category=VALUE, range phys 0.1..10, unit=Uls/S
    Rate5: category=VALUE, range phys -120..120, unit=VehDeg/S
    Rate6: category=VALUE, range phys 0.1..400, unit=m/s^2
    Rate7: category=VALUE, range phys 0.1..500, unit=kph/s^2
    Rate8: category=VALUE, range phys 1..50, unit=kph/s
    Rate9: category=VALUE, range phys 0.1..120, unit=VehDeg/S
    Spd1: category=VALUE, range phys 0..511, unit=kph
    Spd2: category=VALUE, compu {raw=phys*128 for phys 0; unit Units/FixdPt}, range phys 0..511, unit=kph
    Spd3: category=VALUE, range phys 0..255, unit=kph
    Spd4: category=VALUE, range phys 0.1..511, unit=kph
    T1: category=VALUE, range phys -50..150, unit=degC
    T2: category=VALUE, range phys -50..200, unit=degC
    T3: category=VALUE, range phys -50..300, unit=degC
    T4: category=VALUE, range phys -100..150, unit=degC
    T5: category=VALUE, range phys -40..150, unit=degC
    T6: category=VALUE, compu {phys=raw*16 for raw 0; unit Units/FixdPt}, range phys -50..150, unit=degC
    T7: category=VALUE, compu {raw=phys*128 for phys 0; unit Units/FixdPt}, range phys -50..150, unit=degC
    T8: category=VALUE, range phys 0..10, unit=degC
    Ti1: category=VALUE, range phys 0..25000, unit=nS
    Ti10: category=VALUE, range phys 0..0.0002, unit=sec
    Ti11: category=VALUE, range phys 9.1e-05..0.000143, unit=sec
    Ti12: category=VALUE, range phys 0..0.05, unit=sec
    Ti2: category=VALUE, range phys 1..1000, unit=nS
    Ti3: category=VALUE, range phys 0..71429, unit=nS
    Ti4: category=VALUE, range phys 55555..71429, unit=nS
    Ti5: category=VALUE, range phys 6666..8572, unit=nS
    Ti6: category=VALUE, range phys 0..30000, unit=nS
    Ti7: category=VALUE, range phys 0..4295, unit=uS
    Ti8: category=VALUE, range phys 0..71429, unit=nS
    Ti9: category=VALUE, range phys 0..4294967295, unit=nS
    Tq1: category=VALUE, range phys -8.8..8.8, unit=MotNm
    Tq10: category=VALUE, range phys 0..8.8, unit=MotNm
    Tq11: category=VALUE, compu {raw=phys*2048 for phys 0; unit Units/FixdPt}, range phys -1..15.99, unit=MotNm
    Tq12: category=VALUE, compu {raw=phys*2048 for phys 0; unit Units/FixdPt}, range phys 0..8.8, unit=MotNm
    Tq13: category=VALUE, compu {phys=raw*4096 for raw 0; unit Units/FixdPt}, range phys 0..8.8, unit=MotNm
    Tq14: category=VALUE, compu {raw=phys*2048 for phys 0; unit Units/FixdPt}, range phys 0..0.5, unit=MotNm
    Tq15: category=VALUE, range phys 0..0.3, unit=MotNm
    Tq16: category=VALUE, range phys 0..64, unit=HwNm
    Tq17: category=VALUE, range phys 0..63, unit=HwNm
    Tq18: category=VALUE, range phys 0..10, unit=HwNm
    Tq19: category=VALUE, range phys 0..1799, unit=HwNm
    Tq2: category=VALUE, range phys -10..10, unit=HwNm
    Tq3: category=VALUE, range phys 0..8.8, unit=HwNm
    Tq4: category=VALUE, compu {raw=phys*2048 for phys 0; unit Units/FixdPt}, range phys 0..8, unit=MotNm
    Tq5: category=VALUE, compu {raw=phys*2048 for phys 0; unit Units/FixdPt}, range phys -10..10, unit=MotNm
    Tq6: category=VALUE, compu {raw=phys*256 for phys 0; unit Units/FixdPt}, range phys 0..10, unit=HwNm
    Tq7: category=VALUE, compu {raw=phys*2048 for phys 0; unit Units/FixdPt}, range phys 0..1.1, unit=MotNm
    Tq8: category=VALUE, range phys -3..3, unit=MotNm
    Tq9: category=VALUE, range phys -8..8, unit=MotNm
    Uls1: category=VALUE, range phys 0.5..1, unit=Uls
    Uls10: category=VALUE, range phys 0..20, unit=Uls
    Uls11: category=VALUE, compu {raw=phys*16384 for phys 0; unit Units/FixdPt}, range phys 0..2, unit=Uls
    Uls12: category=VALUE, range phys -1..1, unit=Uls
    Uls13: category=VALUE, range phys -100..100, unit=Uls
    Uls14: category=VALUE, range phys 1..2, unit=Uls
    Uls15: category=VALUE, compu {phys=raw*32768 for raw 0; unit Units/FixdPt}, range phys 0..1, unit=Uls
    Uls16: category=VALUE, range phys 0.1..10, unit=Uls
    Uls17: category=VALUE, compu {raw=phys*256 for phys 0; unit Units/FixdPt}, range phys 0..1, unit=Uls
    Uls18: category=VALUE, compu {raw=phys*128 for phys 0; unit Units/FixdPt}, range phys 0..1, unit=Uls
    Uls19: category=VALUE, compu {raw=phys*256 for phys 0; unit Units/FixdPt}, range phys 0..2.5, unit=Uls
    Uls2: category=VALUE, range phys 0..1, unit=Uls
    Uls20: category=VALUE, compu {phys=raw*4096 for raw 0; unit Units/FixdPt}, range phys 0..10, unit=Uls
    Uls21: category=VALUE, range phys 0..2, unit=Uls
    Uls22: category=VALUE, range phys 0..10, unit=Uls
    Uls23: category=VALUE, compu {raw=phys*256 for phys 0; unit Units/FixdPt}, range phys 0..1, unit=Uls
    Uls24: category=VALUE, range phys 0..255, unit=Uls
    Uls3: category=VALUE, range phys -1..1, unit=Uls
    Uls4: category=VALUE, compu {raw=phys*16384 for phys 0; unit Units/FixdPt}, range phys 0..1, unit=Uls
    Uls5: category=VALUE, range phys -1000000000..1000000000, unit=Uls
    Uls6: category=VALUE, range phys 0..200, unit=Uls
    Uls7: category=VALUE, range phys -25..25, unit=Uls
    Uls8: category=VALUE, range phys -200..200, unit=Uls
    Uls9: category=VALUE, range phys 0.98..1, unit=Uls
    Vel1: category=VALUE, range phys -1350..1350, unit=MotRad/s
    Vel2: category=VALUE, range phys 0..1350, unit=MotRad/s
    Vel3: category=VALUE, range phys -42..42, unit=HwRad/s
    Vel4: category=VALUE, compu {raw=phys*32 for phys 0; unit Units/FixdPt}, range phys 0..1350, unit=MotRad/s
    Vel5: category=VALUE, range phys 0..0.5, unit=HwDeg/s
    Vel6: category=VALUE, compu {phys=raw*512 for raw 0; unit Units/FixdPt}, range phys 0..42, unit=HwRad/s
    Vel7: category=VALUE, compu {phys=raw*16 for raw 0; unit Units/FixdPt}, range phys 0..1350, unit=MotRad/s
    Vel8: category=VALUE, range phys 0..128, unit=MotRad/s
    Vel9: category=VALUE, range phys 0..127, unit=MotRad/s
    Volt1: category=VALUE, range phys 6..26.5, unit=V
    Volt10: category=VALUE, range phys 2.5..4.8, unit=V
    Volt11: category=VALUE, range phys 0.3..2.5, unit=V
    Volt12: category=VALUE, range phys 2.5..3, unit=V
    Volt13: category=VALUE, range phys 2..2.5, unit=V
    Volt14: category=VALUE, range phys 0..4800, unit=V
    Volt15: category=VALUE, range phys 0..48000, unit=V
    Volt16: category=VALUE, range phys 0..1, unit=V
    Volt17: category=VALUE, range phys -26.5..26.5, unit=V
    Volt18: category=VALUE, compu {raw=phys*8192 for phys 0; unit Units/FixdPt}, range phys 0..5, unit=V
    Volt2: category=VALUE, range phys 6..16, unit=V
    Volt3: category=VALUE, range phys 0..5, unit=V
    Volt4: category=VALUE, range phys 0..26.5, unit=V
    Volt5: category=VALUE, range phys 0..16, unit=V
    Volt6: category=VALUE, range phys 0..40, unit=V
    Volt7: category=VALUE, range phys 0.3..4.8, unit=V
    Volt8: category=VALUE, range phys 2.8..3, unit=V
    Volt9: category=VALUE, range phys 2..2.3, unit=V
    VoltGain1: category=VALUE, range phys -1..1, unit=VoltPerVoltNanoSec
    VoltTi1: category=VALUE, range phys 0..1040000, unit=VnS
    VoltTi2: category=VALUE, range phys 233330..1325008, unit=VnS
  6 x application record data type, all with category=STRUCTURE, sw-calibration-access=READ-ONLY:
    HwAgOffsRecAppl1
      application record element OffsTrim: category=VALUE, type=Ag19
      application record element OffsTrimPrfmdSts: category=BOOLEAN, type=Logl1
    HwTqOffsRecAppl1
      application record element OffsTrim: category=VALUE, type=Tq2
      application record element OffsTrimPrfmdSts: category=BOOLEAN, type=Logl1
    MotPrmNomEolRecAppl2
      application record element MotKeNom: category=VALUE, type=MotCon1
      application record element MotRNom: category=VALUE, type=R6
    MotPrmNomEolRecAppl3
      application record element MotBackEmfConNom: category=VALUE, type=MotCon1
      application record element MotRNom: category=VALUE, type=R6
    NvMProxyFltTblApplRec1
      application record element FltSts: category=VALUE, type=Cnt19
      application record element FltPrm: category=VALUE, type=Cnt19
    NvMProxyRtnBufApplRec
      application record element StnRtn: category=VALUE, type=Cnt19
      application record element ReqPen: category=VALUE, type=Cnt19
      application record element ReqRes: category=VALUE, type=Cnt19
  435 x impl type:
    AdrMpgReqTyp1: compu {phys=raw for raw 0, phys=raw for raw 1}, implementation-data-type=uint8, type-emitter=RTE
    AnHwTqScaFacRec1: category=STRUCTURE, sw-calibration-access=READ-ONLY, type-emitter=RTE
      element SnsrSca: implementation-data-type=float32
      element SnsrScaPrfmdSts: implementation-data-type=boolean
    Ary1D_BlkFltTblRec1_5: category=ARRAY, sw-calibration-access=READ-ONLY, type-emitter=RTE
      element Element: array-size=5, array-size-semantics=FIXED-SIZE, implementation-data-type=BlkFltTblRec1
    Ary1D_boolean_4: category=ARRAY, sw-calibration-access=READ-ONLY, type-emitter=RTE
      element Element: array-size=4, array-size-semantics=FIXED-SIZE, implementation-data-type=boolean
    Ary1D_boolean_NvMProxy1: category=ARRAY, sw-calibration-access=READ-ONLY, type-emitter=Platform_Type
      element Element: array-size=65535, array-size-semantics=VARIABLE-SIZE, implementation-data-type=boolean
    Ary1D_CmdRtnBufRec1_NvMProxy1: category=ARRAY, type-emitter=NvMProxy
      element Element: array-size=65535, array-size-semantics=VARIABLE-SIZE, implementation-data-type=CmdRtnBufRec1
    Ary1D_CrcHwStsRec1_4: category=ARRAY, sw-calibration-access=READ-ONLY, type-emitter=RTE
      element Element: array-size=4, array-size-semantics=FIXED-SIZE, implementation-data-type=CrcHwStsRec1
    Ary1D_f32_12: category=ARRAY, sw-calibration-access=READ-ONLY, type-emitter=RTE
      element Element: array-size=12, array-size-semantics=FIXED-SIZE, implementation-data-type=float32
    Ary1D_f32_2: category=ARRAY, sw-calibration-access=READ-ONLY, type-emitter=RTE
      element Element: array-size=2, array-size-semantics=FIXED-SIZE, implementation-data-type=float32
    Ary1D_f32_26: category=ARRAY, sw-calibration-access=READ-ONLY, type-emitter=RTE
      element Element: array-size=26, array-size-semantics=FIXED-SIZE, implementation-data-type=float32
    Ary1D_f32_3: category=ARRAY, sw-calibration-access=READ-ONLY, type-emitter=RTE
      element Element: array-size=3, array-size-semantics=FIXED-SIZE, implementation-data-type=float32
    Ary1D_f32_30: category=ARRAY, sw-calibration-access=READ-ONLY, type-emitter=RTE
      element Element: array-size=30, array-size-semantics=FIXED-SIZE, implementation-data-type=float32
    Ary1D_f32_4: category=ARRAY, sw-calibration-access=READ-ONLY, type-emitter=RTE
      element Element: array-size=4, array-size-semantics=FIXED-SIZE, implementation-data-type=float32
    Ary1D_f32_5: category=ARRAY, sw-calibration-access=READ-ONLY, type-emitter=RTE
      element Element: array-size=5, array-size-semantics=FIXED-SIZE, implementation-data-type=float32
    Ary1D_f32_72: category=ARRAY, sw-calibration-access=READ-ONLY, type-emitter=RTE
      element Element: array-size=72, array-size-semantics=FIXED-SIZE, implementation-data-type=float32
    Ary1D_f32_8: category=ARRAY, sw-calibration-access=READ-ONLY, type-emitter=RTE
      element Element: array-size=8, array-size-semantics=FIXED-SIZE, implementation-data-type=float32
    Ary1D_float32_2: category=ARRAY, sw-calibration-access=READ-ONLY, type-emitter=RTE
      element Element: array-size=2, array-size-semantics=FIXED-SIZE, implementation-data-type=float32
    Ary1D_float32_4: category=ARRAY, sw-calibration-access=READ-ONLY, type-emitter=RTE
      element Element: array-size=4, array-size-semantics=FIXED-SIZE, implementation-data-type=float32
    Ary1D_float32_8: category=ARRAY, sw-calibration-access=READ-ONLY, type-emitter=RTE
      element Element: array-size=8, array-size-semantics=FIXED-SIZE, implementation-data-type=float32
    Ary1D_ImcArbnRxDataSrc2_ImcArbnA: category=ARRAY, sw-calibration-access=READ-ONLY, type-emitter=ImcArbrn
      element Element: array-size=65535, array-size-semantics=VARIABLE-SIZE, implementation-data-type=ImcArbnRxDataSrc2
    Ary1D_ImcArbnRxDataSrc2_ImcArbnB: category=ARRAY, sw-calibration-access=READ-ONLY, type-emitter=ImcArbn
      element Element: array-size=65535, array-size-semantics=VARIABLE-SIZE, implementation-data-type=ImcArbnRxDataSrc2
    Ary1D_ImrArbnRxExtdSts2_ImcArbnA: category=ARRAY, sw-calibration-access=READ-ONLY, type-emitter=ImcArbn
      element Element: array-size=65535, array-size-semantics=VARIABLE-SIZE, implementation-data-type=ImcArbnRxExtdSts2
    Ary1D_logl_ImcArbnA: category=ARRAY, sw-calibration-access=READ-ONLY, type-emitter=ImcArbn
      element Element: array-size=65535, array-size-semantics=VARIABLE-SIZE, implementation-data-type=boolean
    Ary1D_NtcFltInfoRec1_20: category=ARRAY, sw-calibration-access=READ-ONLY, type-emitter=RTE
      element Element: array-size=20, array-size-semantics=FIXED-SIZE, implementation-data-type=NtcFltInfoRec1
    Ary1D_NtcFltInfoRec2_20: category=ARRAY, sw-calibration-access=READ-ONLY, type-emitter=RTE
      element Element: array-size=20, array-size-semantics=FIXED-SIZE, implementation-data-type=NtcFltInfoRec2
    Ary1D_NtcInfoRec1_512: category=ARRAY, sw-calibration-access=READ-ONLY, type-emitter=RTE
      element Element: array-size=512, array-size-semantics=FIXED-SIZE, implementation-data-type=NtcInfoRec1
    Ary1D_NtcInfoRec3_65535: category=ARRAY, sw-calibration-access=READ-ONLY, type-emitter=RTE
      element Element: array-size=512, array-size-semantics=VARIABLE-SIZE, implementation-data-type=NtcInfoRec3
    Ary1D_NtcInfoRec4: category=ARRAY, sw-calibration-access=READ-ONLY, type-emitter=DiagcMgr
      element Element: array-size=65535, array-size-semantics=VARIABLE-SIZE, implementation-data-type=NtcInfoRec4
    Ary1D_NtcInfoRec4_Appl0: category=ARRAY, sw-calibration-access=READ-ONLY, type-emitter=DiagcMgr
      element Element: array-size=65535, array-size-semantics=VARIABLE-SIZE, implementation-data-type=NtcInfoRec4
    Ary1D_NtcInfoRec4_Appl1: category=ARRAY, sw-calibration-access=READ-ONLY, type-emitter=DiagcMgr
      element Element: array-size=65535, array-size-semantics=VARIABLE-SIZE, implementation-data-type=NtcInfoRec4
    Ary1D_NtcInfoRec4_Appl10: category=ARRAY, sw-calibration-access=READ-ONLY, type-emitter=DiagcMgr
      element Element: array-size=65535, array-size-semantics=VARIABLE-SIZE, implementation-data-type=NtcInfoRec4
    Ary1D_NtcInfoRec4_Appl2: category=ARRAY, sw-calibration-access=READ-ONLY, type-emitter=DiagcMgr
      element Element: array-size=65535, array-size-semantics=VARIABLE-SIZE, implementation-data-type=NtcInfoRec4
    Ary1D_NtcInfoRec4_Appl3: category=ARRAY, sw-calibration-access=READ-ONLY, type-emitter=DiagcMgr
      element Element: array-size=65535, array-size-semantics=VARIABLE-SIZE, implementation-data-type=NtcInfoRec4
    Ary1D_NtcInfoRec4_Appl4: category=ARRAY, sw-calibration-access=READ-ONLY, type-emitter=DiagcMgr
      element Element: array-size=65535, array-size-semantics=VARIABLE-SIZE, implementation-data-type=NtcInfoRec4
    Ary1D_NtcInfoRec4_Appl5: category=ARRAY, sw-calibration-access=READ-ONLY, type-emitter=DiagcMgr
      element Element: array-size=65535, array-size-semantics=VARIABLE-SIZE, implementation-data-type=NtcInfoRec4
    Ary1D_NtcInfoRec4_Appl6: category=ARRAY, sw-calibration-access=READ-ONLY, type-emitter=DiagcMgr
      element Element: array-size=65535, array-size-semantics=VARIABLE-SIZE, implementation-data-type=NtcInfoRec4
    Ary1D_NtcInfoRec4_Appl7: category=ARRAY, sw-calibration-access=READ-ONLY, type-emitter=DiagcMgr
      element Element: array-size=65535, array-size-semantics=VARIABLE-SIZE, implementation-data-type=NtcInfoRec4
    Ary1D_NtcInfoRec4_Appl8: category=ARRAY, sw-calibration-access=READ-ONLY, type-emitter=DiagcMgr
      element Element: array-size=65535, array-size-semantics=VARIABLE-SIZE, implementation-data-type=NtcInfoRec4
    Ary1D_NtcInfoRec4_Appl9: category=ARRAY, sw-calibration-access=READ-ONLY, type-emitter=DiagcMgr
      element Element: array-size=65535, array-size-semantics=VARIABLE-SIZE, implementation-data-type=NtcInfoRec4
    Ary1D_NtcInfoRec4_DiagcMgr: category=ARRAY, type-emitter=DiagcMgr
      element Element: array-size=65535, array-size-semantics=VARIABLE-SIZE, implementation-data-type=NtcInfoRec4
    Ary1D_NtcInfoRec4_DiagcMgrProxyAppl0: category=ARRAY, type-emitter=DiagcMgr
      element Element: array-size=65535, array-size-semantics=VARIABLE-SIZE, implementation-data-type=NtcInfoRec4
    Ary1D_NtcInfoRec4_DiagcMgrProxyAppl1: category=ARRAY, type-emitter=DiagcMgr
      element Element: array-size=65535, array-size-semantics=VARIABLE-SIZE, implementation-data-type=NtcInfoRec4
    Ary1D_NtcInfoRec4_DiagcMgrProxyAppl10: category=ARRAY, type-emitter=DiagcMgr
      element Element: array-size=65535, array-size-semantics=VARIABLE-SIZE, implementation-data-type=NtcInfoRec4
    Ary1D_NtcInfoRec4_DiagcMgrProxyAppl2: category=ARRAY, type-emitter=DiagcMgr
      element Element: array-size=65535, array-size-semantics=VARIABLE-SIZE, implementation-data-type=NtcInfoRec4
    Ary1D_NtcInfoRec4_DiagcMgrProxyAppl3: category=ARRAY, type-emitter=DiagcMgr
      element Element: array-size=65535, array-size-semantics=VARIABLE-SIZE, implementation-data-type=NtcInfoRec4
    Ary1D_NtcInfoRec4_DiagcMgrProxyAppl4: category=ARRAY, type-emitter=DiagcMgr
      element Element: array-size=65535, array-size-semantics=VARIABLE-SIZE, implementation-data-type=NtcInfoRec4
    Ary1D_NtcInfoRec4_DiagcMgrProxyAppl5: category=ARRAY, type-emitter=DiagcMgr
      element Element: array-size=65535, array-size-semantics=VARIABLE-SIZE, implementation-data-type=NtcInfoRec4
    Ary1D_NtcInfoRec4_DiagcMgrProxyAppl6: category=ARRAY, type-emitter=DiagcMgr
      element Element: array-size=65535, array-size-semantics=VARIABLE-SIZE, implementation-data-type=NtcInfoRec4
    Ary1D_NtcInfoRec4_DiagcMgrProxyAppl7: category=ARRAY, type-emitter=DiagcMgr
      element Element: array-size=65535, array-size-semantics=VARIABLE-SIZE, implementation-data-type=NtcInfoRec4
    Ary1D_NtcInfoRec4_DiagcMgrProxyAppl8: category=ARRAY, type-emitter=DiagcMgr
      element Element: array-size=65535, array-size-semantics=VARIABLE-SIZE, implementation-data-type=NtcInfoRec4
    Ary1D_NtcInfoRec4_DiagcMgrProxyAppl9: category=ARRAY, type-emitter=DiagcMgr
      element Element: array-size=65535, array-size-semantics=VARIABLE-SIZE, implementation-data-type=NtcInfoRec4
    Ary1D_OnlineCalPageInfoRec1_2: category=ARRAY, sw-calibration-access=READ-ONLY, type-emitter=TunSelnMngt
      element Element: array-size=2, array-size-semantics=FIXED-SIZE, implementation-data-type=OnlineCalPageInfoRec1
    Ary1D_OnlineCalSegInfoRec1_TunSelnMngt1: category=ARRAY, sw-calibration-access=READ-ONLY, type-emitter=TunSelnMngt
      element Element: array-size=65535, array-size-semantics=VARIABLE-SIZE, implementation-data-type=OnlineCalSegInfoRec1
    Ary1D_ReadFltInfoRec1_20: category=ARRAY, sw-calibration-access=READ-ONLY, type-emitter=RTE
      element Element: array-size=20, array-size-semantics=FIXED-SIZE, implementation-data-type=ReadFltInfoRec1
    Ary1D_s10p5_8: category=ARRAY, sw-calibration-access=READ-ONLY, type-emitter=RTE
      element Element: array-size=8, array-size-semantics=FIXED-SIZE, implementation-data-type=s10p5
    Ary1D_s11p4_11: category=ARRAY, sw-calibration-access=READ-ONLY, type-emitter=RTE
      element Element: array-size=11, array-size-semantics=FIXED-SIZE, implementation-data-type=s11p4
    Ary1D_s11p4_14: category=ARRAY, sw-calibration-access=READ-ONLY, type-emitter=RTE
      element Element: array-size=14, array-size-semantics=FIXED-SIZE, implementation-data-type=s11p4
    Ary1D_s11p4_5: category=ARRAY, sw-calibration-access=READ-ONLY, type-emitter=RTE
      element Element: array-size=5, array-size-semantics=FIXED-SIZE, implementation-data-type=s11p4
    Ary1D_s14p1_8: category=ARRAY, sw-calibration-access=READ-ONLY, type-emitter=RTE
      element Element: array-size=8, array-size-semantics=FIXED-SIZE, implementation-data-type=s14p1
    Ary1D_s15p0_4: category=ARRAY, sw-calibration-access=READ-ONLY, type-emitter=RTE
      element Element: array-size=4, array-size-semantics=FIXED-SIZE, implementation-data-type=s15p0
    Ary1D_s15p0_5: category=ARRAY, sw-calibration-access=READ-ONLY, type-emitter=RTE
      element Element: array-size=5, array-size-semantics=FIXED-SIZE, implementation-data-type=s15p0
    Ary1D_s16_22: category=ARRAY, sw-calibration-access=READ-ONLY, type-emitter=RTE
      element Element: array-size=22, array-size-semantics=FIXED-SIZE, implementation-data-type=sint16
    Ary1D_s16_Appl0: category=ARRAY, sw-calibration-access=READ-ONLY, type-emitter=DiagcMgr
      element Element: array-size=512, array-size-semantics=FIXED-SIZE, implementation-data-type=sint16
    Ary1D_s16_Appl1: category=ARRAY, sw-calibration-access=READ-ONLY, type-emitter=DiagcMgr
      element Element: array-size=512, array-size-semantics=FIXED-SIZE, implementation-data-type=sint16
    Ary1D_s16_Appl10: category=ARRAY, sw-calibration-access=READ-ONLY, type-emitter=DiagcMgr
      element Element: array-size=512, array-size-semantics=FIXED-SIZE, implementation-data-type=sint16
    Ary1D_s16_Appl2: category=ARRAY, sw-calibration-access=READ-ONLY, type-emitter=DiagcMgr
      element Element: array-size=512, array-size-semantics=FIXED-SIZE, implementation-data-type=sint16
    Ary1D_s16_Appl3: category=ARRAY, sw-calibration-access=READ-ONLY, type-emitter=DiagcMgr
      element Element: array-size=512, array-size-semantics=FIXED-SIZE, implementation-data-type=sint16
    Ary1D_s16_Appl4: category=ARRAY, sw-calibration-access=READ-ONLY, type-emitter=DiagcMgr
      element Element: array-size=512, array-size-semantics=FIXED-SIZE, implementation-data-type=sint16
    Ary1D_s16_Appl5: category=ARRAY, sw-calibration-access=READ-ONLY, type-emitter=DiagcMgr
      element Element: array-size=512, array-size-semantics=FIXED-SIZE, implementation-data-type=sint16
    Ary1D_s16_Appl6: category=ARRAY, sw-calibration-access=READ-ONLY, type-emitter=DiagcMgr
      element Element: array-size=512, array-size-semantics=FIXED-SIZE, implementation-data-type=sint16
    Ary1D_s16_Appl7: category=ARRAY, sw-calibration-access=READ-ONLY, type-emitter=DiagcMgr
      element Element: array-size=512, array-size-semantics=FIXED-SIZE, implementation-data-type=sint16
    Ary1D_s16_Appl8: category=ARRAY, sw-calibration-access=READ-ONLY, type-emitter=DiagcMgr
      element Element: array-size=512, array-size-semantics=FIXED-SIZE, implementation-data-type=sint16
    Ary1D_s16_Appl9: category=ARRAY, sw-calibration-access=READ-ONLY, type-emitter=DiagcMgr
      element Element: array-size=512, array-size-semantics=FIXED-SIZE, implementation-data-type=sint16
    Ary1D_s16_DiagcMgrProxyAppl0: category=ARRAY, type-emitter=DiagcMgr
      element Element: array-size=65535, array-size-semantics=VARIABLE-SIZE, implementation-data-type=sint16
    Ary1D_s16_DiagcMgrProxyAppl1: category=ARRAY, type-emitter=DiagcMgr
      element Element: array-size=65535, array-size-semantics=VARIABLE-SIZE, implementation-data-type=sint16
    Ary1D_s16_DiagcMgrProxyAppl10: category=ARRAY, type-emitter=DiagcMgr
      element Element: array-size=65535, array-size-semantics=VARIABLE-SIZE, implementation-data-type=sint16
    Ary1D_s16_DiagcMgrProxyAppl2: category=ARRAY, type-emitter=DiagcMgr
      element Element: array-size=65535, array-size-semantics=VARIABLE-SIZE, implementation-data-type=sint16
    Ary1D_s16_DiagcMgrProxyAppl3: category=ARRAY, type-emitter=DiagcMgr
      element Element: array-size=65535, array-size-semantics=VARIABLE-SIZE, implementation-data-type=sint16
    Ary1D_s16_DiagcMgrProxyAppl4: category=ARRAY, type-emitter=DiagcMgr
      element Element: array-size=65535, array-size-semantics=VARIABLE-SIZE, implementation-data-type=sint16
    Ary1D_s16_DiagcMgrProxyAppl5: category=ARRAY, type-emitter=DiagcMgr
      element Element: array-size=65535, array-size-semantics=VARIABLE-SIZE, implementation-data-type=sint16
    Ary1D_s16_DiagcMgrProxyAppl6: category=ARRAY, type-emitter=DiagcMgr
      element Element: array-size=65535, array-size-semantics=VARIABLE-SIZE, implementation-data-type=sint16
    Ary1D_s16_DiagcMgrProxyAppl7: category=ARRAY, type-emitter=DiagcMgr
      element Element: array-size=65535, array-size-semantics=VARIABLE-SIZE, implementation-data-type=sint16
    Ary1D_s16_DiagcMgrProxyAppl8: category=ARRAY, type-emitter=DiagcMgr
      element Element: array-size=65535, array-size-semantics=VARIABLE-SIZE, implementation-data-type=sint16
    Ary1D_s16_DiagcMgrProxyAppl9: category=ARRAY, type-emitter=DiagcMgr
      element Element: array-size=65535, array-size-semantics=VARIABLE-SIZE, implementation-data-type=sint16
    Ary1D_s1p14_12: category=ARRAY, sw-calibration-access=READ-ONLY, type-emitter=RTE
      element Element: array-size=12, array-size-semantics=FIXED-SIZE, implementation-data-type=s1p14
    Ary1D_s1p14_128: category=ARRAY, sw-calibration-access=READ-ONLY, type-emitter=RTE
      element Element: array-size=128, array-size-semantics=FIXED-SIZE, implementation-data-type=s1p14
    Ary1D_s1p14_512: category=ARRAY, sw-calibration-access=READ-ONLY, type-emitter=RTE
      element Element: array-size=512, array-size-semantics=FIXED-SIZE, implementation-data-type=s1p14
    Ary1D_s2p13_1024: category=ARRAY, sw-calibration-access=READ-ONLY, type-emitter=RTE
      element Element: array-size=1024, array-size-semantics=FIXED-SIZE, implementation-data-type=s2p13
    Ary1D_s2p13_1025: category=ARRAY, sw-calibration-access=READ-ONLY, type-emitter=RTE
      element Element: array-size=1025, array-size-semantics=FIXED-SIZE, implementation-data-type=s2p13
    Ary1D_s4p11_11: category=ARRAY, sw-calibration-access=READ-ONLY, type-emitter=RTE
      element Element: array-size=11, array-size-semantics=FIXED-SIZE, implementation-data-type=s4p11
    Ary1D_s4p11_20: category=ARRAY, sw-calibration-access=READ-ONLY, type-emitter=RTE
      element Element: array-size=20, array-size-semantics=FIXED-SIZE, implementation-data-type=s4p11
    Ary1D_s4p11_5: category=ARRAY, sw-calibration-access=READ-ONLY, type-emitter=RTE
      element Element: array-size=5, array-size-semantics=FIXED-SIZE, implementation-data-type=s4p11
    Ary1D_s4p11_8: category=ARRAY, sw-calibration-access=READ-ONLY, type-emitter=RTE
      element Element: array-size=8, array-size-semantics=FIXED-SIZE, implementation-data-type=s4p11
    Ary1D_s7p8_11: category=ARRAY, sw-calibration-access=READ-ONLY, type-emitter=RTE
      element Element: array-size=11, array-size-semantics=FIXED-SIZE, implementation-data-type=s7p8
    Ary1D_s7p8_12: category=ARRAY, sw-calibration-access=READ-ONLY, type-emitter=RTE
      element Element: array-size=12, array-size-semantics=FIXED-SIZE, implementation-data-type=s7p8
    Ary1D_s7p8_20: category=ARRAY, sw-calibration-access=READ-ONLY, type-emitter=RTE
      element Element: array-size=20, array-size-semantics=FIXED-SIZE, implementation-data-type=s7p8
    Ary1D_s7p8_5: category=ARRAY, sw-calibration-access=READ-ONLY, type-emitter=RTE
      element Element: array-size=5, array-size-semantics=FIXED-SIZE, implementation-data-type=s7p8
    Ary1D_s7p8_6: category=ARRAY, sw-calibration-access=READ-ONLY, type-emitter=RTE
      element Element: array-size=6, array-size-semantics=FIXED-SIZE, implementation-data-type=s7p8
    Ary1D_s8p7_14: category=ARRAY, sw-calibration-access=READ-ONLY, type-emitter=RTE
      element Element: array-size=14, array-size-semantics=FIXED-SIZE, implementation-data-type=s8p7
    Ary1D_s8p7_3: category=ARRAY, sw-calibration-access=READ-ONLY, type-emitter=RTE
      element Element: array-size=3, array-size-semantics=FIXED-SIZE, implementation-data-type=s8p7
    Ary1D_sint16_22: category=ARRAY, sw-calibration-access=READ-ONLY, type-emitter=RTE
      element Element: array-size=22, array-size-semantics=FIXED-SIZE, implementation-data-type=sint16
    Ary1D_sm5p12_128: category=ARRAY, sw-calibration-access=READ-ONLY, type-emitter=RTE
      element Element: array-size=128, array-size-semantics=FIXED-SIZE, implementation-data-type=sm5p12
    Ary1D_SnpshtDataRec1_8: category=ARRAY, sw-calibration-access=READ-ONLY, type-emitter=RTE
      element Element: array-size=8, array-size-semantics=FIXED-SIZE, implementation-data-type=SnpshtDataRec1
    Ary1D_u08_14: category=ARRAY, sw-calibration-access=READ-ONLY, type-emitter=RTE
      element Element: array-size=14, array-size-semantics=FIXED-SIZE, implementation-data-type=uint8
    Ary1D_u08_22: category=ARRAY, sw-calibration-access=READ-ONLY, type-emitter=RTE
      element Element: array-size=22, array-size-semantics=FIXED-SIZE, implementation-data-type=uint8
    Ary1D_u08_48: category=ARRAY, sw-calibration-access=READ-ONLY, type-emitter=RTE
      element Element: array-size=48, array-size-semantics=FIXED-SIZE, implementation-data-type=uint8
    Ary1D_u08_6: category=ARRAY, sw-calibration-access=READ-ONLY, type-emitter=RTE
      element Element: array-size=6, array-size-semantics=FIXED-SIZE, implementation-data-type=uint8
    Ary1D_u08_DiagcMgr1: category=ARRAY, type-emitter=DiagcMgr
      element Element: array-size=65535, array-size-semantics=VARIABLE-SIZE, implementation-data-type=uint8
    Ary1D_u0p16_10: category=ARRAY, sw-calibration-access=READ-ONLY, type-emitter=RTE
      element Element: array-size=10, array-size-semantics=FIXED-SIZE, implementation-data-type=u0p16
    Ary1D_u0p16_2: category=ARRAY, sw-calibration-access=READ-ONLY, type-emitter=RTE
      element Element: array-size=2, array-size-semantics=FIXED-SIZE, implementation-data-type=u0p16
    Ary1D_u0p16_3: category=ARRAY, sw-calibration-access=READ-ONLY, type-emitter=RTE
      element Element: array-size=3, array-size-semantics=FIXED-SIZE, implementation-data-type=u0p16
    Ary1D_u0p16_8: category=ARRAY, sw-calibration-access=READ-ONLY, type-emitter=RTE
      element Element: array-size=8, array-size-semantics=FIXED-SIZE, implementation-data-type=u0p16
    Ary1D_u10p6_12: category=ARRAY, sw-calibration-access=READ-ONLY, type-emitter=RTE
      element Element: array-size=12, array-size-semantics=FIXED-SIZE, implementation-data-type=u10p6
    Ary1D_u10p6_13: category=ARRAY, sw-calibration-access=READ-ONLY, type-emitter=RTE
      element Element: array-size=13, array-size-semantics=FIXED-SIZE, implementation-data-type=u10p6
    Ary1D_u10p6_3: category=ARRAY, sw-calibration-access=READ-ONLY, type-emitter=RTE
      element Element: array-size=3, array-size-semantics=FIXED-SIZE, implementation-data-type=u10p6
    Ary1D_u10p6_4: category=ARRAY, sw-calibration-access=READ-ONLY, type-emitter=RTE
      element Element: array-size=4, array-size-semantics=FIXED-SIZE, implementation-data-type=u10p6
    Ary1D_u10p6_5: category=ARRAY, sw-calibration-access=READ-ONLY, type-emitter=RTE
      element Element: array-size=5, array-size-semantics=FIXED-SIZE, implementation-data-type=u10p6
    Ary1D_u10p6_7: category=ARRAY, sw-calibration-access=READ-ONLY, type-emitter=RTE
      element Element: array-size=7, array-size-semantics=FIXED-SIZE, implementation-data-type=u10p6
    Ary1D_u10p6_8: category=ARRAY, sw-calibration-access=READ-ONLY, type-emitter=RTE
      element Element: array-size=8, array-size-semantics=FIXED-SIZE, implementation-data-type=u10p6
    Ary1D_u10p6_9: category=ARRAY, sw-calibration-access=READ-ONLY, type-emitter=RTE
      element Element: array-size=9, array-size-semantics=FIXED-SIZE, implementation-data-type=u10p6
    Ary1D_u11p5_10: category=ARRAY, sw-calibration-access=READ-ONLY, type-emitter=RTE
      element Element: array-size=10, array-size-semantics=FIXED-SIZE, implementation-data-type=u11p5
    Ary1D_u11p5_11: category=ARRAY, sw-calibration-access=READ-ONLY, type-emitter=RTE
      element Element: array-size=11, array-size-semantics=FIXED-SIZE, implementation-data-type=u11p5
    Ary1D_u11p5_13: category=ARRAY, sw-calibration-access=READ-ONLY, type-emitter=RTE
      element Element: array-size=13, array-size-semantics=FIXED-SIZE, implementation-data-type=u11p5
    Ary1D_u11p5_4: category=ARRAY, sw-calibration-access=READ-ONLY, type-emitter=RTE
      element Element: array-size=4, array-size-semantics=FIXED-SIZE, implementation-data-type=u11p5
    Ary1D_u11p5_6: category=ARRAY, sw-calibration-access=READ-ONLY, type-emitter=RTE
      element Element: array-size=6, array-size-semantics=FIXED-SIZE, implementation-data-type=u11p5
    Ary1D_u11p5_8: category=ARRAY, sw-calibration-access=READ-ONLY, type-emitter=RTE
      element Element: array-size=8, array-size-semantics=FIXED-SIZE, implementation-data-type=u11p5
    Ary1D_u12p4_12: category=ARRAY, sw-calibration-access=READ-ONLY, type-emitter=RTE
      element Element: array-size=12, array-size-semantics=FIXED-SIZE, implementation-data-type=u12p4
    Ary1D_u12p4_13: category=ARRAY, sw-calibration-access=READ-ONLY, type-emitter=RTE
      element Element: array-size=13, array-size-semantics=FIXED-SIZE, implementation-data-type=u12p4
    Ary1D_u12p4_16: category=ARRAY, sw-calibration-access=READ-ONLY, type-emitter=RTE
      element Element: array-size=16, array-size-semantics=FIXED-SIZE, implementation-data-type=u12p4
    Ary1D_u12p4_2: category=ARRAY, sw-calibration-access=READ-ONLY, type-emitter=RTE
      element Element: array-size=2, array-size-semantics=FIXED-SIZE, implementation-data-type=u12p4
    Ary1D_u12p4_4: category=ARRAY, sw-calibration-access=READ-ONLY, type-emitter=RTE
      element Element: array-size=4, array-size-semantics=FIXED-SIZE, implementation-data-type=u12p4
    Ary1D_u12p4_7: category=ARRAY, sw-calibration-access=READ-ONLY, type-emitter=RTE
      element Element: array-size=7, array-size-semantics=FIXED-SIZE, implementation-data-type=u12p4
    Ary1D_u12p4_9: category=ARRAY, sw-calibration-access=READ-ONLY, type-emitter=RTE
      element Element: array-size=9, array-size-semantics=FIXED-SIZE, implementation-data-type=u12p4
    Ary1D_u13p3_2: category=ARRAY, sw-calibration-access=READ-ONLY, type-emitter=RTE
      element Element: array-size=2, array-size-semantics=FIXED-SIZE, implementation-data-type=u13p3
    Ary1D_u13p3_6: category=ARRAY, sw-calibration-access=READ-ONLY, type-emitter=RTE
      element Element: array-size=6, array-size-semantics=FIXED-SIZE, implementation-data-type=u13p3
    Ary1D_u16_257: category=ARRAY, sw-calibration-access=READ-ONLY, type-emitter=RTE
      element Element: array-size=257, array-size-semantics=FIXED-SIZE, implementation-data-type=uint16
    Ary1D_u16_3: category=ARRAY, sw-calibration-access=READ-ONLY, type-emitter=RTE
      element Element: array-size=3, array-size-semantics=FIXED-SIZE, implementation-data-type=uint16
    Ary1D_u16p0_2: category=ARRAY, sw-calibration-access=READ-ONLY, type-emitter=RTE
      element Element: array-size=2, array-size-semantics=FIXED-SIZE, implementation-data-type=u16p0
    Ary1D_u16p0_20: category=ARRAY, sw-calibration-access=READ-ONLY, type-emitter=RTE
      element Element: array-size=20, array-size-semantics=FIXED-SIZE, implementation-data-type=u16p0
    Ary1D_u16p0_8: category=ARRAY, sw-calibration-access=READ-ONLY, type-emitter=RTE
      element Element: array-size=8, array-size-semantics=FIXED-SIZE, implementation-data-type=u16p0
    Ary1D_u1p15_10: category=ARRAY, sw-calibration-access=READ-ONLY, type-emitter=RTE
      element Element: array-size=10, array-size-semantics=FIXED-SIZE, implementation-data-type=u1p15
    Ary1D_u1p15_11: category=ARRAY, sw-calibration-access=READ-ONLY, type-emitter=RTE
      element Element: array-size=11, array-size-semantics=FIXED-SIZE, implementation-data-type=u1p15
    Ary1D_u1p15_12: category=ARRAY, sw-calibration-access=READ-ONLY, type-emitter=RTE
      element Element: array-size=12, array-size-semantics=FIXED-SIZE, implementation-data-type=u1p15
    Ary1D_u1p15_2: category=ARRAY, sw-calibration-access=READ-ONLY, type-emitter=RTE
      element Element: array-size=2, array-size-semantics=FIXED-SIZE, implementation-data-type=u1p15
    Ary1D_u1p15_4: category=ARRAY, sw-calibration-access=READ-ONLY, type-emitter=RTE
      element Element: array-size=4, array-size-semantics=FIXED-SIZE, implementation-data-type=u1p15
    Ary1D_u1p15_5: category=ARRAY, sw-calibration-access=READ-ONLY, type-emitter=RTE
      element Element: array-size=5, array-size-semantics=FIXED-SIZE, implementation-data-type=u1p15
    Ary1D_u1p15_6: category=ARRAY, sw-calibration-access=READ-ONLY, type-emitter=RTE
      element Element: array-size=6, array-size-semantics=FIXED-SIZE, implementation-data-type=u1p15
    Ary1D_u2p14_10: category=ARRAY, sw-calibration-access=READ-ONLY, type-emitter=RTE
      element Element: array-size=10, array-size-semantics=FIXED-SIZE, implementation-data-type=u2p14
    Ary1D_u2p14_12: category=ARRAY, sw-calibration-access=READ-ONLY, type-emitter=RTE
      element Element: array-size=12, array-size-semantics=FIXED-SIZE, implementation-data-type=u2p14
    Ary1D_u2p14_16: category=ARRAY, sw-calibration-access=READ-ONLY, type-emitter=RTE
      element Element: array-size=16, array-size-semantics=FIXED-SIZE, implementation-data-type=u2p14
    Ary1D_u2p14_2: category=ARRAY, sw-calibration-access=READ-ONLY, type-emitter=RTE
      element Element: array-size=2, array-size-semantics=FIXED-SIZE, implementation-data-type=u2p14
    Ary1D_u2p14_3: category=ARRAY, sw-calibration-access=READ-ONLY, type-emitter=RTE
      element Element: array-size=3, array-size-semantics=FIXED-SIZE, implementation-data-type=u2p14
    Ary1D_u2p14_4: category=ARRAY, sw-calibration-access=READ-ONLY, type-emitter=RTE
      element Element: array-size=4, array-size-semantics=FIXED-SIZE, implementation-data-type=u2p14
    Ary1D_u2p14_5: category=ARRAY, sw-calibration-access=READ-ONLY, type-emitter=RTE
      element Element: array-size=5, array-size-semantics=FIXED-SIZE, implementation-data-type=u2p14
    Ary1D_u2p14_6: category=ARRAY, sw-calibration-access=READ-ONLY, type-emitter=RTE
      element Element: array-size=6, array-size-semantics=FIXED-SIZE, implementation-data-type=u2p14
    Ary1D_u2p14_7: category=ARRAY, sw-calibration-access=READ-ONLY, type-emitter=RTE
      element Element: array-size=7, array-size-semantics=FIXED-SIZE, implementation-data-type=u2p14
    Ary1D_u2p14_8: category=ARRAY, sw-calibration-access=READ-ONLY, type-emitter=RTE
      element Element: array-size=8, array-size-semantics=FIXED-SIZE, implementation-data-type=u2p14
    Ary1D_u2p14_9: category=ARRAY, sw-calibration-access=READ-ONLY, type-emitter=RTE
      element Element: array-size=9, array-size-semantics=FIXED-SIZE, implementation-data-type=u2p14
    Ary1D_u32_10: category=ARRAY, sw-calibration-access=READ-ONLY, type-emitter=RTE
      element Element: array-size=10, array-size-semantics=FIXED-SIZE, implementation-data-type=uint32
    Ary1D_u32_2: category=ARRAY, sw-calibration-access=READ-ONLY, type-emitter=RTE
      element Element: array-size=2, array-size-semantics=FIXED-SIZE, implementation-data-type=uint32
    Ary1D_u32_40: category=ARRAY, sw-calibration-access=READ-ONLY, type-emitter=RTE
      element Element: array-size=40, array-size-semantics=FIXED-SIZE, implementation-data-type=uint32
    Ary1D_u32_50: category=ARRAY, sw-calibration-access=READ-ONLY, type-emitter=StHlthSigStc
      element Element: array-size=50, array-size-semantics=FIXED-SIZE, implementation-data-type=uint32
    Ary1D_u32_512: category=ARRAY, sw-calibration-access=READ-ONLY, type-emitter=RTE
      element Element: array-size=512, array-size-semantics=FIXED-SIZE, implementation-data-type=uint32
    Ary1D_u32_8: category=ARRAY, sw-calibration-access=READ-ONLY, type-emitter=RTE
      element Element: array-size=8, array-size-semantics=FIXED-SIZE, implementation-data-type=uint32
    Ary1D_u32_ImcArbnA: category=ARRAY, sw-calibration-access=READ-ONLY, type-emitter=ImcArbn
      element Element: array-size=65535, array-size-semantics=VARIABLE-SIZE, implementation-data-type=uint32
    Ary1D_u32_StHlthSigStc1: category=ARRAY, type-emitter=StHlthSigStc
      element Element: array-size=65535, array-size-semantics=VARIABLE-SIZE, implementation-data-type=uint32
    Ary1D_u3p13_10: category=ARRAY, sw-calibration-access=READ-ONLY, type-emitter=RTE
      element Element: array-size=10, array-size-semantics=FIXED-SIZE, implementation-data-type=u3p13
    Ary1D_u3p13_13: category=ARRAY, sw-calibration-access=READ-ONLY, type-emitter=RTE
      element Element: array-size=13, array-size-semantics=FIXED-SIZE, implementation-data-type=u3p13
    Ary1D_u3p13_5: category=ARRAY, sw-calibration-access=READ-ONLY, type-emitter=RTE
      element Element: array-size=5, array-size-semantics=FIXED-SIZE, implementation-data-type=u3p13
    Ary1D_u3p13_8: category=ARRAY, sw-calibration-access=READ-ONLY, type-emitter=RTE
      element Element: array-size=8, array-size-semantics=FIXED-SIZE, implementation-data-type=u3p13
    Ary1D_u4p12_10: category=ARRAY, sw-calibration-access=READ-ONLY, type-emitter=RTE
      element Element: array-size=10, array-size-semantics=FIXED-SIZE, implementation-data-type=u4p12
    Ary1D_u4p12_11: category=ARRAY, sw-calibration-access=READ-ONLY, type-emitter=RTE
      element Element: array-size=11, array-size-semantics=FIXED-SIZE, implementation-data-type=u4p12
    Ary1D_u4p12_12: category=ARRAY, sw-calibration-access=READ-ONLY, type-emitter=RTE
      element Element: array-size=12, array-size-semantics=FIXED-SIZE, implementation-data-type=u4p12
    Ary1D_u4p12_13: category=ARRAY, sw-calibration-access=READ-ONLY, type-emitter=RTE
      element Element: array-size=13, array-size-semantics=FIXED-SIZE, implementation-data-type=u4p12
    Ary1D_u4p12_14: category=ARRAY, sw-calibration-access=READ-ONLY, type-emitter=RTE
      element Element: array-size=14, array-size-semantics=FIXED-SIZE, implementation-data-type=u4p12
    Ary1D_u4p12_2: category=ARRAY, sw-calibration-access=READ-ONLY, type-emitter=RTE
      element Element: array-size=2, array-size-semantics=FIXED-SIZE, implementation-data-type=u4p12
    Ary1D_u4p12_3: category=ARRAY, sw-calibration-access=READ-ONLY, type-emitter=RTE
      element Element: array-size=3, array-size-semantics=FIXED-SIZE, implementation-data-type=u4p12
    Ary1D_u4p12_4: category=ARRAY, sw-calibration-access=READ-ONLY, type-emitter=RTE
      element Element: array-size=4, array-size-semantics=FIXED-SIZE, implementation-data-type=u4p12
    Ary1D_u4p12_5: category=ARRAY, sw-calibration-access=READ-ONLY, type-emitter=RTE
      element Element: array-size=5, array-size-semantics=FIXED-SIZE, implementation-data-type=u4p12
    Ary1D_u4p12_6: category=ARRAY, sw-calibration-access=READ-ONLY, type-emitter=RTE
      element Element: array-size=6, array-size-semantics=FIXED-SIZE, implementation-data-type=u4p12
    Ary1D_u4p12_8: category=ARRAY, sw-calibration-access=READ-ONLY, type-emitter=RTE
      element Element: array-size=8, array-size-semantics=FIXED-SIZE, implementation-data-type=u4p12
    Ary1D_u5p11_10: category=ARRAY, sw-calibration-access=READ-ONLY, type-emitter=RTE
      element Element: array-size=10, array-size-semantics=FIXED-SIZE, implementation-data-type=u5p11
    Ary1D_u5p11_11: category=ARRAY, sw-calibration-access=READ-ONLY, type-emitter=RTE
      element Element: array-size=11, array-size-semantics=FIXED-SIZE, implementation-data-type=u5p11
    Ary1D_u5p11_13: category=ARRAY, sw-calibration-access=READ-ONLY, type-emitter=RTE
      element Element: array-size=13, array-size-semantics=FIXED-SIZE, implementation-data-type=u5p11
    Ary1D_u5p11_14: category=ARRAY, sw-calibration-access=READ-ONLY, type-emitter=RTE
      element Element: array-size=14, array-size-semantics=FIXED-SIZE, implementation-data-type=u5p11
    Ary1D_u5p11_16: category=ARRAY, sw-calibration-access=READ-ONLY, type-emitter=RTE
      element Element: array-size=16, array-size-semantics=FIXED-SIZE, implementation-data-type=u5p11
    Ary1D_u5p11_17: category=ARRAY, sw-calibration-access=READ-ONLY, type-emitter=RTE
      element Element: array-size=17, array-size-semantics=FIXED-SIZE, implementation-data-type=u5p11
    Ary1D_u5p11_5: category=ARRAY, sw-calibration-access=READ-ONLY, type-emitter=RTE
      element Element: array-size=5, array-size-semantics=FIXED-SIZE, implementation-data-type=u5p11
    Ary1D_u5p11_6: category=ARRAY, sw-calibration-access=READ-ONLY, type-emitter=RTE
      element Element: array-size=6, array-size-semantics=FIXED-SIZE, implementation-data-type=u5p11
    Ary1D_u5p11_8: category=ARRAY, sw-calibration-access=READ-ONLY, type-emitter=RTE
      element Element: array-size=8, array-size-semantics=FIXED-SIZE, implementation-data-type=u5p11
    Ary1D_u6p10_10: category=ARRAY, sw-calibration-access=READ-ONLY, type-emitter=RTE
      element Element: array-size=10, array-size-semantics=FIXED-SIZE, implementation-data-type=u6p10
    Ary1D_u6p10_17: category=ARRAY, sw-calibration-access=READ-ONLY, type-emitter=RTE
      element Element: array-size=17, array-size-semantics=FIXED-SIZE, implementation-data-type=u6p10
    Ary1D_u6p10_6: category=ARRAY, sw-calibration-access=READ-ONLY, type-emitter=RTE
      element Element: array-size=6, array-size-semantics=FIXED-SIZE, implementation-data-type=u6p10
    Ary1D_u6p10_9: category=ARRAY, sw-calibration-access=READ-ONLY, type-emitter=RTE
      element Element: array-size=9, array-size-semantics=FIXED-SIZE, implementation-data-type=u6p10
    Ary1D_u7p9_12: category=ARRAY, sw-calibration-access=READ-ONLY, type-emitter=RTE
      element Element: array-size=12, array-size-semantics=FIXED-SIZE, implementation-data-type=u7p9
    Ary1D_u7p9_3: category=ARRAY, sw-calibration-access=READ-ONLY, type-emitter=RTE
      element Element: array-size=3, array-size-semantics=FIXED-SIZE, implementation-data-type=u7p9
    Ary1D_u7p9_4: category=ARRAY, sw-calibration-access=READ-ONLY, type-emitter=RTE
      element Element: array-size=4, array-size-semantics=FIXED-SIZE, implementation-data-type=u7p9
    Ary1D_u7p9_6: category=ARRAY, sw-calibration-access=READ-ONLY, type-emitter=RTE
      element Element: array-size=6, array-size-semantics=FIXED-SIZE, implementation-data-type=u7p9
    Ary1D_u8_10: category=ARRAY, sw-calibration-access=READ-ONLY, type-emitter=RTE
      element Element: array-size=10, array-size-semantics=FIXED-SIZE, implementation-data-type=uint8
    Ary1D_u8_12: category=ARRAY, sw-calibration-access=READ-ONLY, type-emitter=RTE
      element Element: array-size=12, array-size-semantics=FIXED-SIZE, implementation-data-type=uint8
    Ary1D_u8_14: category=ARRAY, sw-calibration-access=READ-ONLY, type-emitter=RTE
      element Element: array-size=14, array-size-semantics=FIXED-SIZE, implementation-data-type=uint8
    Ary1D_u8_16: category=ARRAY, sw-calibration-access=READ-ONLY, type-emitter=RTE
      element Element: array-size=16, array-size-semantics=FIXED-SIZE, implementation-data-type=uint8
    Ary1D_u8_17: category=ARRAY, sw-calibration-access=READ-ONLY, type-emitter=RTE
      element Element: array-size=17, array-size-semantics=FIXED-SIZE, implementation-data-type=uint8
    Ary1D_u8_2: category=ARRAY, sw-calibration-access=READ-ONLY, type-emitter=RTE
      element Element: array-size=2, array-size-semantics=FIXED-SIZE, implementation-data-type=uint8
    Ary1D_u8_20: category=ARRAY, sw-calibration-access=READ-ONLY, type-emitter=RTE
      element Element: array-size=20, array-size-semantics=FIXED-SIZE, implementation-data-type=uint8
    Ary1D_u8_22: category=ARRAY, sw-calibration-access=READ-ONLY, type-emitter=RTE
      element Element: array-size=22, array-size-semantics=FIXED-SIZE, implementation-data-type=uint8
    Ary1D_u8_225: category=ARRAY, sw-calibration-access=READ-ONLY, type-emitter=RTE
      element Element: array-size=225, array-size-semantics=FIXED-SIZE, implementation-data-type=uint8
    Ary1D_u8_255: category=ARRAY, sw-calibration-access=READ-ONLY, type-emitter=StHlthSigStc
      element Element: array-size=255, array-size-semantics=FIXED-SIZE, implementation-data-type=uint8
    Ary1D_u8_3: category=ARRAY, sw-calibration-access=READ-ONLY, type-emitter=RTE
      element Element: array-size=3, array-size-semantics=FIXED-SIZE, implementation-data-type=uint8
    Ary1D_u8_4: category=ARRAY, sw-calibration-access=READ-ONLY, type-emitter=RTE
      element Element: array-size=4, array-size-semantics=FIXED-SIZE, implementation-data-type=uint8
    Ary1D_u8_40: category=ARRAY, sw-calibration-access=READ-ONLY, type-emitter=RTE
      element Element: array-size=40, array-size-semantics=FIXED-SIZE, implementation-data-type=uint8
    Ary1D_u8_48: category=ARRAY, sw-calibration-access=READ-ONLY, type-emitter=RTE
      element Element: array-size=48, array-size-semantics=FIXED-SIZE, implementation-data-type=uint8
    Ary1D_u8_5: category=ARRAY, sw-calibration-access=READ-ONLY, type-emitter=RTE
      element Element: array-size=5, array-size-semantics=FIXED-SIZE, implementation-data-type=uint8
    Ary1D_u8_520: category=ARRAY, sw-calibration-access=READ-ONLY, type-emitter=RTE
      element Element: array-size=520, array-size-semantics=FIXED-SIZE, implementation-data-type=uint8
    Ary1D_u8_6: category=ARRAY, sw-calibration-access=READ-ONLY, type-emitter=RTE
      element Element: array-size=6, array-size-semantics=FIXED-SIZE, implementation-data-type=uint8
    Ary1D_u8_7: category=ARRAY, sw-calibration-access=READ-ONLY, type-emitter=RTE
      element Element: array-size=7, array-size-semantics=FIXED-SIZE, implementation-data-type=uint8
    Ary1D_u8_8: category=ARRAY, sw-calibration-access=READ-ONLY, type-emitter=RTE
      element Element: array-size=8, array-size-semantics=FIXED-SIZE, implementation-data-type=uint8
    Ary1D_u8_822: category=ARRAY, sw-calibration-access=READ-ONLY, type-emitter=RTE
      element Element: array-size=822, array-size-semantics=FIXED-SIZE, implementation-data-type=uint8
    Ary1D_u8_9: category=ARRAY, sw-calibration-access=READ-ONLY, type-emitter=RTE
      element Element: array-size=9, array-size-semantics=FIXED-SIZE, implementation-data-type=uint8
    Ary1D_u8_CmnMfgSrvIf: category=ARRAY, type-emitter=CmnMfgSrvIf
      element Element: array-size=65535, array-size-semantics=FIXED-SIZE, implementation-data-type=uint8
    Ary1D_u8_ImcArbnA: category=ARRAY, sw-calibration-access=READ-ONLY, type-emitter=ImcArbn
      element Element: array-size=8, array-size-semantics=FIXED-SIZE, implementation-data-type=uint8
    Ary1D_u8_ImcArbnB: category=ARRAY, sw-calibration-access=READ-ONLY, type-emitter=ImcArbn
      element Element: array-size=65535, array-size-semantics=VARIABLE-SIZE, implementation-data-type=uint8
    Ary1D_u8_Sci30CfgAndUseA: category=ARRAY, sw-calibration-access=READ-ONLY, type-emitter=ImcArbn
      element Element: array-size=8, array-size-semantics=FIXED-SIZE, implementation-data-type=uint8
    Ary1D_u8_StHlthSigStc1: category=ARRAY, type-emitter=StHlthSigStc
      element Element: array-size=65535, array-size-semantics=VARIABLE-SIZE, implementation-data-type=uint8
    Ary1D_u8p8_10: category=ARRAY, sw-calibration-access=READ-ONLY, type-emitter=RTE
      element Element: array-size=10, array-size-semantics=FIXED-SIZE, implementation-data-type=u8p8
    Ary1D_u8p8_11: category=ARRAY, sw-calibration-access=READ-ONLY, type-emitter=RTE
      element Element: array-size=11, array-size-semantics=FIXED-SIZE, implementation-data-type=u8p8
    Ary1D_u8p8_14: category=ARRAY, sw-calibration-access=READ-ONLY, type-emitter=RTE
      element Element: array-size=14, array-size-semantics=FIXED-SIZE, implementation-data-type=u8p8
    Ary1D_u8p8_2: category=ARRAY, sw-calibration-access=READ-ONLY, type-emitter=RTE
      element Element: array-size=2, array-size-semantics=FIXED-SIZE, implementation-data-type=u8p8
    Ary1D_u8p8_20: category=ARRAY, sw-calibration-access=READ-ONLY, type-emitter=RTE
      element Element: array-size=20, array-size-semantics=FIXED-SIZE, implementation-data-type=u8p8
    Ary1D_u8p8_3: category=ARRAY, sw-calibration-access=READ-ONLY, type-emitter=RTE
      element Element: array-size=3, array-size-semantics=FIXED-SIZE, implementation-data-type=u8p8
    Ary1D_u8p8_4: category=ARRAY, sw-calibration-access=READ-ONLY, type-emitter=RTE
      element Element: array-size=4, array-size-semantics=FIXED-SIZE, implementation-data-type=u8p8
    Ary1D_u8p8_5: category=ARRAY, sw-calibration-access=READ-ONLY, type-emitter=RTE
      element Element: array-size=5, array-size-semantics=FIXED-SIZE, implementation-data-type=u8p8
    Ary1D_u8p8_6: category=ARRAY, sw-calibration-access=READ-ONLY, type-emitter=RTE
      element Element: array-size=6, array-size-semantics=FIXED-SIZE, implementation-data-type=u8p8
    Ary1D_u8p8_7: category=ARRAY, sw-calibration-access=READ-ONLY, type-emitter=RTE
      element Element: array-size=7, array-size-semantics=FIXED-SIZE, implementation-data-type=u8p8
    Ary1D_u8p8_8: category=ARRAY, sw-calibration-access=READ-ONLY, type-emitter=RTE
      element Element: array-size=8, array-size-semantics=FIXED-SIZE, implementation-data-type=u8p8
    Ary1D_u9p7_10: category=ARRAY, sw-calibration-access=READ-ONLY, type-emitter=RTE
      element Element: array-size=10, array-size-semantics=FIXED-SIZE, implementation-data-type=u9p7
    Ary1D_u9p7_12: category=ARRAY, sw-calibration-access=READ-ONLY, type-emitter=RTE
      element Element: array-size=12, array-size-semantics=FIXED-SIZE, implementation-data-type=u9p7
    Ary1D_u9p7_16: category=ARRAY, sw-calibration-access=READ-ONLY, type-emitter=RTE
      element Element: array-size=16, array-size-semantics=FIXED-SIZE, implementation-data-type=u9p7
    Ary1D_u9p7_2: category=ARRAY, sw-calibration-access=READ-ONLY, type-emitter=RTE
      element Element: array-size=2, array-size-semantics=FIXED-SIZE, implementation-data-type=u9p7
    Ary1D_u9p7_3: category=ARRAY, sw-calibration-access=READ-ONLY, type-emitter=RTE
      element Element: array-size=3, array-size-semantics=FIXED-SIZE, implementation-data-type=u9p7
    Ary1D_u9p7_4: category=ARRAY, sw-calibration-access=READ-ONLY, type-emitter=RTE
      element Element: array-size=4, array-size-semantics=FIXED-SIZE, implementation-data-type=u9p7
    Ary1D_u9p7_5: category=ARRAY, sw-calibration-access=READ-ONLY, type-emitter=RTE
      element Element: array-size=5, array-size-semantics=FIXED-SIZE, implementation-data-type=u9p7
    Ary1D_u9p7_6: category=ARRAY, sw-calibration-access=READ-ONLY, type-emitter=RTE
      element Element: array-size=6, array-size-semantics=FIXED-SIZE, implementation-data-type=u9p7
    Ary1D_u9p7_7: category=ARRAY, sw-calibration-access=READ-ONLY, type-emitter=RTE
      element Element: array-size=7, array-size-semantics=FIXED-SIZE, implementation-data-type=u9p7
    Ary1D_u9p7_8: category=ARRAY, sw-calibration-access=READ-ONLY, type-emitter=RTE
      element Element: array-size=8, array-size-semantics=FIXED-SIZE, implementation-data-type=u9p7
    Ary1D_u9p7_9: category=ARRAY, sw-calibration-access=READ-ONLY, type-emitter=RTE
      element Element: array-size=9, array-size-semantics=FIXED-SIZE, implementation-data-type=u9p7
    Ary1D_uint16_3: category=ARRAY, sw-calibration-access=READ-ONLY, type-emitter=RTE
      element Element: array-size=3, array-size-semantics=FIXED-SIZE, implementation-data-type=uint16
    Ary1D_uint32_512: category=ARRAY, sw-calibration-access=READ-ONLY, type-emitter=RTE
      element Element: array-size=512, array-size-semantics=FIXED-SIZE, implementation-data-type=uint32
    Ary1D_uint8_14: category=ARRAY, sw-calibration-access=READ-ONLY, type-emitter=RTE
      element Element: array-size=14, array-size-semantics=FIXED-SIZE, implementation-data-type=uint8
    Ary1D_uint8_22: category=ARRAY, sw-calibration-access=READ-ONLY, type-emitter=RTE
      element Element: array-size=22, array-size-semantics=FIXED-SIZE, implementation-data-type=uint8
    Ary1D_uint8_48: category=ARRAY, sw-calibration-access=READ-ONLY, type-emitter=RTE
      element Element: array-size=48, array-size-semantics=FIXED-SIZE, implementation-data-type=uint8
    Ary1D_uint8_6: category=ARRAY, sw-calibration-access=READ-ONLY, type-emitter=RTE
      element Element: array-size=6, array-size-semantics=FIXED-SIZE, implementation-data-type=uint8
    Ary2D_f32_3_3: category=ARRAY, sw-calibration-access=READ-ONLY, type-emitter=RTE
      element Element: array-size=3, array-size-semantics=FIXED-SIZE, implementation-data-type=Ary1D_f32_3
    Ary2D_f32_4_2: category=ARRAY, sw-calibration-access=READ-ONLY, type-emitter=RTE
      element Element: array-size=4, array-size-semantics=FIXED-SIZE, implementation-data-type=Ary1D_f32_2
    Ary2D_f32_4_5: category=ARRAY, sw-calibration-access=READ-ONLY, type-emitter=RTE
      element Element: array-size=4, array-size-semantics=FIXED-SIZE, implementation-data-type=Ary1D_f32_5
    Ary2D_f32_5_4: category=ARRAY, sw-calibration-access=READ-ONLY, type-emitter=RTE
      element Element: array-size=5, array-size-semantics=FIXED-SIZE, implementation-data-type=Ary1D_f32_4
    Ary2D_f32_5_5: category=ARRAY, sw-calibration-access=READ-ONLY, type-emitter=RTE
      element Element: array-size=5, array-size-semantics=FIXED-SIZE, implementation-data-type=Ary1D_f32_5
    Ary2D_f32_8_4: category=ARRAY, sw-calibration-access=READ-ONLY, type-emitter=RTE
      element Element: array-size=8, array-size-semantics=FIXED-SIZE, implementation-data-type=Ary1D_f32_4
    Ary2D_float32_4_2: category=ARRAY, sw-calibration-access=READ-ONLY, type-emitter=RTE
      element Element: array-size=4, array-size-semantics=FIXED-SIZE, implementation-data-type=Ary1D_float32_2
    Ary2D_float32_8_4: category=ARRAY, sw-calibration-access=READ-ONLY, type-emitter=RTE
      element Element: array-size=8, array-size-semantics=FIXED-SIZE, implementation-data-type=Ary1D_float32_4
    Ary2D_s11p4_1_5: category=ARRAY, sw-calibration-access=READ-ONLY, type-emitter=RTE
      element Element: array-size=1, array-size-semantics=FIXED-SIZE, implementation-data-type=Ary1D_s11p4_5
    Ary2D_s1p14_10_12: category=ARRAY, sw-calibration-access=READ-ONLY, type-emitter=RTE
      element Element: array-size=10, array-size-semantics=FIXED-SIZE, implementation-data-type=Ary1D_s1p14_12
    Ary2D_s4p11_11_8: category=ARRAY, sw-calibration-access=READ-ONLY, type-emitter=RTE
      element Element: array-size=11, array-size-semantics=FIXED-SIZE, implementation-data-type=Ary1D_s4p11_8
    Ary2D_s4p11_12_11: category=ARRAY, sw-calibration-access=READ-ONLY, type-emitter=RTE
      element Element: array-size=12, array-size-semantics=FIXED-SIZE, implementation-data-type=Ary1D_s4p11_11
    Ary2D_s4p11_12_20: category=ARRAY, sw-calibration-access=READ-ONLY, type-emitter=RTE
      element Element: array-size=12, array-size-semantics=FIXED-SIZE, implementation-data-type=Ary1D_s4p11_20
    Ary2D_s4p11_8_11: category=ARRAY, sw-calibration-access=READ-ONLY, type-emitter=RTE
      element Element: array-size=8, array-size-semantics=FIXED-SIZE, implementation-data-type=Ary1D_s4p11_11
    Ary2D_s7p8_11_12: category=ARRAY, sw-calibration-access=READ-ONLY, type-emitter=RTE
      element Element: array-size=11, array-size-semantics=FIXED-SIZE, implementation-data-type=Ary1D_s7p8_12
    Ary2D_s7p8_12_11: category=ARRAY, sw-calibration-access=READ-ONLY, type-emitter=RTE
      element Element: array-size=12, array-size-semantics=FIXED-SIZE, implementation-data-type=Ary1D_s7p8_11
    Ary2D_s7p8_3_5: category=ARRAY, sw-calibration-access=READ-ONLY, type-emitter=RTE
      element Element: array-size=3, array-size-semantics=FIXED-SIZE, implementation-data-type=Ary1D_s7p8_5
    Ary2D_s7p8_3_6: category=ARRAY, sw-calibration-access=READ-ONLY, type-emitter=RTE
      element Element: array-size=3, array-size-semantics=FIXED-SIZE, implementation-data-type=Ary1D_s7p8_6
    Ary2D_s7p8_4_5: category=ARRAY, sw-calibration-access=READ-ONLY, type-emitter=RTE
      element Element: array-size=4, array-size-semantics=FIXED-SIZE, implementation-data-type=Ary1D_s7p8_5
    Ary2D_s7p8_9_5: category=ARRAY, sw-calibration-access=READ-ONLY, type-emitter=RTE
      element Element: array-size=9, array-size-semantics=FIXED-SIZE, implementation-data-type=Ary1D_s7p8_5
    Ary2D_s7p8_9_6: category=ARRAY, sw-calibration-access=READ-ONLY, type-emitter=RTE
      element Element: array-size=9, array-size-semantics=FIXED-SIZE, implementation-data-type=Ary1D_s7p8_6
    Ary2D_u0p16_20_8: category=ARRAY, sw-calibration-access=READ-ONLY, type-emitter=RTE
      element Element: array-size=20, array-size-semantics=FIXED-SIZE, implementation-data-type=Ary1D_u0p16_8
    Ary2D_u0p16_4_2: category=ARRAY, sw-calibration-access=READ-ONLY, type-emitter=RTE
      element Element: array-size=4, array-size-semantics=FIXED-SIZE, implementation-data-type=Ary1D_u0p16_2
    Ary2D_u10p6_1_5: category=ARRAY, sw-calibration-access=READ-ONLY, type-emitter=RTE
      element Element: array-size=1, array-size-semantics=FIXED-SIZE, implementation-data-type=Ary1D_u10p6_5
    Ary2D_u10p6_1_8: category=ARRAY, sw-calibration-access=READ-ONLY, type-emitter=RTE
      element Element: array-size=1, array-size-semantics=FIXED-SIZE, implementation-data-type=Ary1D_u10p6_8
    Ary2D_u10p6_3_7: category=ARRAY, sw-calibration-access=READ-ONLY, type-emitter=RTE
      element Element: array-size=3, array-size-semantics=FIXED-SIZE, implementation-data-type=Ary1D_u10p6_7
    Ary2D_u10p6_8_12: category=ARRAY, sw-calibration-access=READ-ONLY, type-emitter=RTE
      element Element: array-size=8, array-size-semantics=FIXED-SIZE, implementation-data-type=Ary1D_u10p6_12
    Ary2D_u10p6_8_9: category=ARRAY, sw-calibration-access=READ-ONLY, type-emitter=RTE
      element Element: array-size=8, array-size-semantics=FIXED-SIZE, implementation-data-type=Ary1D_u10p6_9
    Ary2D_u12p4_12_13: category=ARRAY, sw-calibration-access=READ-ONLY, type-emitter=RTE
      element Element: array-size=12, array-size-semantics=FIXED-SIZE, implementation-data-type=Ary1D_u12p4_13
    Ary2D_u12p4_4_2: category=ARRAY, sw-calibration-access=READ-ONLY, type-emitter=RTE
      element Element: array-size=4, array-size-semantics=FIXED-SIZE, implementation-data-type=Ary1D_u12p4_2
    Ary2D_u12p4_5_4: category=ARRAY, sw-calibration-access=READ-ONLY, type-emitter=RTE
      element Element: array-size=5, array-size-semantics=FIXED-SIZE, implementation-data-type=Ary1D_u12p4_4
    Ary2D_u12p4_8_12: category=ARRAY, sw-calibration-access=READ-ONLY, type-emitter=RTE
      element Element: array-size=8, array-size-semantics=FIXED-SIZE, implementation-data-type=Ary1D_u12p4_12
    Ary2D_u12p4_9_16: category=ARRAY, sw-calibration-access=READ-ONLY, type-emitter=RTE
      element Element: array-size=9, array-size-semantics=FIXED-SIZE, implementation-data-type=Ary1D_u12p4_16
    Ary2D_u16_8_3: category=ARRAY, sw-calibration-access=READ-ONLY, type-emitter=RTE
      element Element: array-size=8, array-size-semantics=FIXED-SIZE, implementation-data-type=Ary1D_u16_3
    Ary2D_u1p15_1_5: category=ARRAY, sw-calibration-access=READ-ONLY, type-emitter=RTE
      element Element: array-size=1, array-size-semantics=FIXED-SIZE, implementation-data-type=Ary1D_u1p15_5
    Ary2D_u1p15_12_5: category=ARRAY, sw-calibration-access=READ-ONLY, type-emitter=RTE
      element Element: array-size=12, array-size-semantics=FIXED-SIZE, implementation-data-type=Ary1D_u1p15_5
    Ary2D_u1p15_5_4: category=ARRAY, sw-calibration-access=READ-ONLY, type-emitter=RTE
      element Element: array-size=5, array-size-semantics=FIXED-SIZE, implementation-data-type=Ary1D_u1p15_4
    Ary2D_u1p15_8_4: category=ARRAY, sw-calibration-access=READ-ONLY, type-emitter=RTE
      element Element: array-size=8, array-size-semantics=FIXED-SIZE, implementation-data-type=Ary1D_u1p15_4
    Ary2D_u2p14_1_4: category=ARRAY, sw-calibration-access=READ-ONLY, type-emitter=RTE
      element Element: array-size=1, array-size-semantics=FIXED-SIZE, implementation-data-type=Ary1D_u2p14_4
    Ary2D_u2p14_12_5: category=ARRAY, sw-calibration-access=READ-ONLY, type-emitter=RTE
      element Element: array-size=12, array-size-semantics=FIXED-SIZE, implementation-data-type=Ary1D_u2p14_5
    Ary2D_u2p14_5_10: category=ARRAY, sw-calibration-access=READ-ONLY, type-emitter=RTE
      element Element: array-size=5, array-size-semantics=FIXED-SIZE, implementation-data-type=Ary1D_u2p14_10
    Ary2D_u2p14_5_8: category=ARRAY, sw-calibration-access=READ-ONLY, type-emitter=RTE
      element Element: array-size=5, array-size-semantics=FIXED-SIZE, implementation-data-type=Ary1D_u2p14_8
    Ary2D_u2p14_6_5: category=ARRAY, sw-calibration-access=READ-ONLY, type-emitter=RTE
      element Element: array-size=6, array-size-semantics=FIXED-SIZE, implementation-data-type=Ary1D_u2p14_5
    Ary2D_u2p14_6_7: category=ARRAY, sw-calibration-access=READ-ONLY, type-emitter=RTE
      element Element: array-size=6, array-size-semantics=FIXED-SIZE, implementation-data-type=Ary1D_u2p14_7
    Ary2D_u2p14_7_6: category=ARRAY, sw-calibration-access=READ-ONLY, type-emitter=RTE
      element Element: array-size=7, array-size-semantics=FIXED-SIZE, implementation-data-type=Ary1D_u2p14_6
    Ary2D_u2p14_7_8: category=ARRAY, sw-calibration-access=READ-ONLY, type-emitter=RTE
      element Element: array-size=7, array-size-semantics=FIXED-SIZE, implementation-data-type=Ary1D_u2p14_8
    Ary2D_u3p13_12_13: category=ARRAY, sw-calibration-access=READ-ONLY, type-emitter=RTE
      element Element: array-size=12, array-size-semantics=FIXED-SIZE, implementation-data-type=Ary1D_u3p13_13
    Ary2D_u3p13_20_8: category=ARRAY, sw-calibration-access=READ-ONLY, type-emitter=RTE
      element Element: array-size=20, array-size-semantics=FIXED-SIZE, implementation-data-type=Ary1D_u3p13_8
    Ary2D_u4p12_1_8: category=ARRAY, sw-calibration-access=READ-ONLY, type-emitter=RTE
      element Element: array-size=1, array-size-semantics=FIXED-SIZE, implementation-data-type=Ary1D_u4p12_8
    Ary2D_u4p12_12_5: category=ARRAY, sw-calibration-access=READ-ONLY, type-emitter=RTE
      element Element: array-size=12, array-size-semantics=FIXED-SIZE, implementation-data-type=Ary1D_u4p12_5
    Ary2D_u4p12_12_8: category=ARRAY, sw-calibration-access=READ-ONLY, type-emitter=RTE
      element Element: array-size=12, array-size-semantics=FIXED-SIZE, implementation-data-type=Ary1D_u4p12_8
    Ary2D_u4p12_13_3: category=ARRAY, sw-calibration-access=READ-ONLY, type-emitter=RTE
      element Element: array-size=13, array-size-semantics=FIXED-SIZE, implementation-data-type=Ary1D_u4p12_3
    Ary2D_u4p12_3_13: category=ARRAY, sw-calibration-access=READ-ONLY, type-emitter=RTE
      element Element: array-size=3, array-size-semantics=FIXED-SIZE, implementation-data-type=Ary1D_u4p12_13
    Ary2D_u5p11_12_13: category=ARRAY, sw-calibration-access=READ-ONLY, type-emitter=RTE
      element Element: array-size=12, array-size-semantics=FIXED-SIZE, implementation-data-type=Ary1D_u5p11_13
    Ary2D_u5p11_12_5: category=ARRAY, sw-calibration-access=READ-ONLY, type-emitter=RTE
      element Element: array-size=12, array-size-semantics=FIXED-SIZE, implementation-data-type=Ary1D_u5p11_5
    Ary2D_u5p11_9_16: category=ARRAY, sw-calibration-access=READ-ONLY, type-emitter=RTE
      element Element: array-size=9, array-size-semantics=FIXED-SIZE, implementation-data-type=Ary1D_u5p11_16
    Ary2D_u6p10_5_9: category=ARRAY, sw-calibration-access=READ-ONLY, type-emitter=RTE
      element Element: array-size=5, array-size-semantics=FIXED-SIZE, implementation-data-type=Ary1D_u6p10_9
    Ary2D_u6p10_8_9: category=ARRAY, sw-calibration-access=READ-ONLY, type-emitter=RTE
      element Element: array-size=8, array-size-semantics=FIXED-SIZE, implementation-data-type=Ary1D_u6p10_9
    Ary2D_u7p9_8_4: category=ARRAY, sw-calibration-access=READ-ONLY, type-emitter=RTE
      element Element: array-size=8, array-size-semantics=FIXED-SIZE, implementation-data-type=Ary1D_u7p9_4
    Ary2D_u7p9_9_4: category=ARRAY, sw-calibration-access=READ-ONLY, type-emitter=RTE
      element Element: array-size=9, array-size-semantics=FIXED-SIZE, implementation-data-type=Ary1D_u7p9_4
    Ary2D_u8_2_2: category=ARRAY, sw-calibration-access=READ-ONLY, type-emitter=RTE
      element Element: array-size=2, array-size-semantics=FIXED-SIZE, implementation-data-type=Ary1D_u8_2
    Ary2D_u8_ImcArbnA: category=ARRAY, sw-calibration-access=READ-ONLY, type-emitter=ImcArbr
      element Element: array-size=65535, array-size-semantics=VARIABLE-SIZE, implementation-data-type=Ary1D_u8_ImcArbnA
    Ary2D_u8_Sci30CfgAndUseA: category=ARRAY, sw-calibration-access=READ-ONLY, type-emitter=Sci30CfgAndUse
      element Element: array-size=65535, array-size-semantics=VARIABLE-SIZE, implementation-data-type=Ary1D_u8_Sci30CfgAndUseA
    Ary2D_u8_Sci30CfgAndUseB: category=ARRAY, sw-calibration-access=READ-ONLY, type-emitter=Sci30CfgAndUse
      element Element: array-size=65535, array-size-semantics=VARIABLE-SIZE, implementation-data-type=Ary1D_u8_Sci30CfgAndUseA
    Ary2D_u8_Sci30CfgAndUseC: category=ARRAY, sw-calibration-access=READ-ONLY, type-emitter=Sci30CfgAndUse
      element Element: array-size=65535, array-size-semantics=VARIABLE-SIZE, implementation-data-type=Ary1D_u8_Sci30CfgAndUseA
    Ary2D_u8p8_12_20: category=ARRAY, sw-calibration-access=READ-ONLY, type-emitter=RTE
      element Element: array-size=12, array-size-semantics=FIXED-SIZE, implementation-data-type=Ary1D_u8p8_20
    Ary2D_u8p8_3_5: category=ARRAY, sw-calibration-access=READ-ONLY, type-emitter=RTE
      element Element: array-size=3, array-size-semantics=FIXED-SIZE, implementation-data-type=Ary1D_u8p8_5
    Ary2D_u8p8_3_6: category=ARRAY, sw-calibration-access=READ-ONLY, type-emitter=RTE
      element Element: array-size=3, array-size-semantics=FIXED-SIZE, implementation-data-type=Ary1D_u8p8_6
    Ary2D_u8p8_5_10: category=ARRAY, sw-calibration-access=READ-ONLY, type-emitter=RTE
      element Element: array-size=5, array-size-semantics=FIXED-SIZE, implementation-data-type=Ary1D_u8p8_10
    Ary2D_u8p8_5_8: category=ARRAY, sw-calibration-access=READ-ONLY, type-emitter=RTE
      element Element: array-size=5, array-size-semantics=FIXED-SIZE, implementation-data-type=Ary1D_u8p8_8
    Ary2D_u8p8_6_5: category=ARRAY, sw-calibration-access=READ-ONLY, type-emitter=RTE
      element Element: array-size=6, array-size-semantics=FIXED-SIZE, implementation-data-type=Ary1D_u8p8_5
    Ary2D_u8p8_9_4: category=ARRAY, sw-calibration-access=READ-ONLY, type-emitter=RTE
      element Element: array-size=9, array-size-semantics=FIXED-SIZE, implementation-data-type=Ary1D_u8p8_4
    Ary2D_u8p8_9_5: category=ARRAY, sw-calibration-access=READ-ONLY, type-emitter=RTE
      element Element: array-size=9, array-size-semantics=FIXED-SIZE, implementation-data-type=Ary1D_u8p8_5
    Ary2D_u8p8_9_6: category=ARRAY, sw-calibration-access=READ-ONLY, type-emitter=RTE
      element Element: array-size=9, array-size-semantics=FIXED-SIZE, implementation-data-type=Ary1D_u8p8_6
    Ary2D_u8p8_9_8: category=ARRAY, sw-calibration-access=READ-ONLY, type-emitter=RTE
      element Element: array-size=9, array-size-semantics=FIXED-SIZE, implementation-data-type=Ary1D_u8p8_8
    Ary2D_uint16_8_3: category=ARRAY, sw-calibration-access=READ-ONLY, type-emitter=RTE
      element Element: array-size=8, array-size-semantics=FIXED-SIZE, implementation-data-type=Ary1D_uint16_3
    BattSwdVltgCorrlnSts1: compu {0=BSVCS_NOFLT, 1=BSVCS_BATTVLTGSWD2FLT, 2=BSVCS_BATTVLTGSWD1FLT, 3=BSVCS_BATTVLTGFLT, 4=BSVCS_NOCORRLN}, implementation-data-type=uint8, type-emitter=RTE
    BlkFltTblRec1: category=STRUCTURE, sw-calibration-access=READ-ONLY, type-emitter=RTE
      element Sts: implementation-data-type=NtcSts1
      element Prm: implementation-data-type=uint8
    CalCopySts1: compu {0=CALCOPYSTS_NOTRDY, 1=CALCOPYSTS_COPYPNDING, 2=CALCOPYSTS_COPYCMPL, 3=CALCOPYSTS_PROCERR}, implementation-data-type=uint8, type-emitter=RTE
    CmdRtnBufRec1: category=STRUCTURE, sw-calibration-access=READ-ONLY, type-emitter=NvMProxy
      element StdRtn: implementation-data-type=uint8
      element ReqPen: implementation-data-type=uint8
      element ReqRes: implementation-data-type=uint8
    CrcHwResvCfg1: compu {0=CRCHWRESVCFG_32BITCRC32BITWIDTH, 1=CRCHWRESVCFG_32BITCRC16BITWIDTH, 2=CRCHWRESVCFG_32BITCRC8BITWIDTH, 3=CRCHWRESVCFG_16BITCRC16BITWIDTH, 4=CRCHWRESVCFG_16BITCRC8BITWIDTH, 5=CRCHWRESVCFG_8BITCRC, 6=CRCHWRESVCFG_8BITCRCH2F}, implementation-data-type=uint8, type-emitter=RTE
    CrcHwResvMod1: compu {0=CRCHWRESVMOD_RELS, 1=CRCHWRESVMOD_RESV}, implementation-data-type=uint8, type-emitter=RTE
    CrcHwSts1: compu {0=CRCHWSTS_NOTAVL, 1=CRCHWSTS_AVL, 2=CRCHWSTS_BUSY, 3=CRCHWSTS_NOTENAD, 4=CRCHWSTS_RESV, 255=CRCHWSTS_IDXINVLD}, implementation-data-type=uint8, type-emitter=RTE
    CrcHwStsRec1: category=STRUCTURE, sw-calibration-access=READ-ONLY, type-emitter=RTE
      element TaskId: implementation-data-type=uint16
      element CrcHwSts: implementation-data-type=CrcHwSts1
    CurrMeasEolGainCalRec1: category=STRUCTURE, sw-calibration-access=READ-ONLY, type-emitter=RTE
      6 x element, all with category=TYPE_REFERENCE, implementation-data-type=float32:
        CurrMeasMotCurrEolGainA
        CurrMeasMotCurrEolGainB
        CurrMeasMotCurrEolGainC
        CurrMeasMotCurrEolGainD
        CurrMeasMotCurrEolGainE
        CurrMeasMotCurrEolGainF
      symbol props CurrMeasEolGainCalRec1
    CurrMeasEolOffsCalRec1: category=STRUCTURE, sw-calibration-access=READ-ONLY, type-emitter=RTE
      13 x element, all with category=TYPE_REFERENCE, implementation-data-type=float32:
        CurrMeasEolOffsHiBrdgVltg
        CurrMeasMotCurrEolOffsDifA
        CurrMeasMotCurrEolOffsDifB
        CurrMeasMotCurrEolOffsDifC
        CurrMeasMotCurrEolOffsDifD
        CurrMeasMotCurrEolOffsDifE
        CurrMeasMotCurrEolOffsDifF
        CurrMeasMotCurrOffsLoAvrgA
        CurrMeasMotCurrOffsLoAvrgB
        CurrMeasMotCurrOffsLoAvrgC
        CurrMeasMotCurrOffsLoAvrgD
        CurrMeasMotCurrOffsLoAvrgE
        CurrMeasMotCurrOffsLoAvrgF
      symbol props CurrMeasEolOffsCalRec1
    CurrMeasEolOffsGainCalRec1: category=STRUCTURE, sw-calibration-access=READ-ONLY, type-emitter=RTE
      6 x element, all with category=TYPE_REFERENCE, implementation-data-type=float32:
        CurrMeasMotCurrOffsZeroAvrgA
        CurrMeasMotCurrOffsZeroAvrgB
        CurrMeasMotCurrOffsZeroAvrgC
        CurrMeasMotCurrEolGainA
        CurrMeasMotCurrEolGainB
        CurrMeasMotCurrEolGainC
      symbol props CurrMeasEolOffsGainCalRec1
    DiagcDataRec1: category=STRUCTURE, sw-calibration-access=READ-ONLY, type-emitter=RTE
      element DiagcSts: implementation-data-type=uint16
      element ActvRampRate: implementation-data-type=float32
      element ActvMotTqCmdSca: implementation-data-type=float32
    DutyCycThermProtnFilStValRec1: category=STRUCTURE, sw-calibration-access=READ-ONLY, type-emitter=RTE
      4 x element, all with category=TYPE_REFERENCE, implementation-data-type=uint8:
        Fil{3..6}StVal
      symbol props DutyCycThermProtnFilStValRec1
    EgyModSt1: compu {0=EGYMODST_NORM, 1=EGYMODST_PRDN, 2=EGYMODST_TRANSPT, 3=EGYMODST_FLS}, implementation-data-type=uint8, type-emitter=RTE
    EOLGainOffs1: category=STRUCTURE, sw-calibration-access=READ-ONLY, type-emitter=RTE
      19 x element, all with category=TYPE_REFERENCE, implementation-data-type=float32:
        CurrMeasEolOffsHiBrdgVltg
        CurrMeasMotCurrEolGainA
        CurrMeasMotCurrEolGainB
        CurrMeasMotCurrEolGainC
        CurrMeasMotCurrEolGainD
        CurrMeasMotCurrEolGainE
        CurrMeasMotCurrEolGainF
        CurrMeasMotCurrEolOffsDifA
        CurrMeasMotCurrEolOffsDifB
        CurrMeasMotCurrEolOffsDifC
        CurrMeasMotCurrEolOffsDifD
        CurrMeasMotCurrEolOffsDifE
        CurrMeasMotCurrEolOffsDifF
        CurrMeasMotCurrOffsLoAvrgA
        CurrMeasMotCurrOffsLoAvrgB
        CurrMeasMotCurrOffsLoAvrgC
        CurrMeasMotCurrOffsLoAvrgD
        CurrMeasMotCurrOffsLoAvrgE
        CurrMeasMotCurrOffsLoAvrgF
      symbol props EOLGainOffs1
    EotNvmDataRec1: category=STRUCTURE, sw-calibration-access=READ-ONLY, type-emitter=RTE
      4 x element, all with category=TYPE_REFERENCE:
        CwEot: implementation-data-type=float32
        CcwEot: implementation-data-type=float32
        CwEotDetd: implementation-data-type=boolean
        CcwEotDetd: implementation-data-type=boolean
      symbol props EotNvmDataRec1
    FilHpRec1: category=STRUCTURE, sw-calibration-access=READ-ONLY, type-emitter=NxtrFil
      element FilLpRec: implementation-data-type=FilLpRec1
      element CorrnFac: implementation-data-type=float32
    FilLpRec1: category=STRUCTURE, sw-calibration-access=READ-ONLY, type-emitter=NxtrFil
      element FilSt: implementation-data-type=float32
      element FilGain: implementation-data-type=float32
      symbol props FilLpRec1
    FilNotchGainRec1: category=STRUCTURE, sw-calibration-access=READ-ONLY
      5 x element, all with category=TYPE_REFERENCE, implementation-data-type=float32:
        FilGainB{0..2}
        FilGainA1
        FilGainA2
    FilNotchStRec1: category=STRUCTURE, sw-calibration-access=READ-ONLY, type-emitter=RTE
      element FilSt1: implementation-data-type=float32
      element FilSt2: implementation-data-type=float32
    GetSegMod1: compu {0=GETSEGMOD_ADRINFO, 1=GETSEGMOD_STDINFO, 2=GETSEGMOD_ADRMPG}, implementation-data-type=uint8, type-emitter=RTE
    GmFctDiArbnSts1: compu {0=GMFCTDIARBNSTS_WAIT, 1=GMFCTDIARBNSTS_INPROC, 2=GMFCTDIARBNSTS_PASSD, 3=GMFCTDIARBNSTS_SWBASDMTGTNFAIL, 4=GMFCTDIARBNSTS_TIMEOUTFAIL}, implementation-data-type=uint8, type-emitter=RTE
    GmSysPwrMod1: compu {0=GMSYSPWRMOD_OFF, 1=GMSYSPWRMOD_ACSY, 2=GMSYSPWRMOD_RUN, 3=GMSYSPWRMOD_CRK}, implementation-data-type=uint8, type-emitter=RTE
    HwAgOffsRec1: category=STRUCTURE, sw-calibration-access=READ-ONLY, type-emitter=RTE
      element OffsTrim: implementation-data-type=float32
      element OffsTrimPrfmdSts: implementation-data-type=boolean
    HwAgSnsrTrimRec1: category=STRUCTURE, sw-calibration-access=READ-ONLY, type-emitter=RTE
      element TrimVal: implementation-data-type=float32
      element TrimPrfmd: implementation-data-type=boolean
    HwAgTrajCmdSt1: compu {0=HWAGTRAJCMDST_WAIT, 1=HWAGTRAJCMDST_HWAGA, 2=HWAGTRAJCMDST_CONVEL, 3=HWAGTRAJCMDST_HWAGDECEL, 4=HWAGTRAJCMDST_HLD}, implementation-data-type=uint16, type-emitter=RTE
    HwTqOffsRec1: category=STRUCTURE, sw-calibration-access=READ-ONLY, type-emitter=RTE
      element OffsTrim: implementation-data-type=float32
      element OffsTrimPrfmdSts: implementation-data-type=boolean
    ImcArbnRxDataSrc1: implementation-data-type=ImcArbnRxDataSrc2, type-emitter=RTE
    ImcArbnRxDataSrc2: implementation-data-type=uint8, type-emitter=ImcArbn
    ImcArbnRxExtdSts1: implementation-data-type=ImcArbnRxExtdSts2, type-emitter=RTE
    ImcArbnRxExtdSts2: implementation-data-type=uint8, type-emitter=ImcArbn
    ImcArbnRxSts1: compu {0=IMCARBNRXSTS_NODATA, 1=IMCARBNRXSTS_VLD, 2=IMCARBNRXSTS_INVLD}, implementation-data-type=uint8, type-emitter=RTE
    LoaSt1: compu {0=LOAST_NORM, 1=LOAST_LIMD, 2=LOAST_SWBASDMTGTN, 3=LOAST_FADEOUT, 4=LOAST_CTRLDSHTDWNREQD, 5=LOAST_IMDTSHTDWNREQD}, implementation-data-type=uint8, type-emitter=RTE
    MaxHwAgCwAndCcwRec1: category=STRUCTURE, sw-calibration-access=READ-ONLY, type-emitter=RTE
      element HwAgCcwMax: implementation-data-type=float32
      element HwAgCwMax: implementation-data-type=float32
    MaxHwAgCwAndCcwRec2: category=STRUCTURE, sw-calibration-access=READ-ONLY, type-emitter=RTE
      element HwAgCcwMax: implementation-data-type=float32
      element HwAgCwMax: implementation-data-type=float32
      element HwAgOverTrvlCnt: implementation-data-type=uint8
    MfgEnaSt1: compu {0=MFGENAST_PRDNMOD, 1=MFGENAST_MFGMOD, 2=MFGENAST_TESTMOD}, implementation-data-type=uint8, type-emitter=RTE
    MotAgMeasEolPrmRec1: category=STRUCTURE, sw-calibration-access=READ-ONLY, type-emitter=RTE
      5 x element, all with category=TYPE_REFERENCE, implementation-data-type=float32:
        SinOffs
        CosOffs
        SinAmpRecpr
        CosAmpRecpr
        SinDelta
    MotCurrEolCalSt1: compu {1=MCECS_OFFSCMDHI, 2=MCECS_OFFSCMDLO, 3=MCECS_OFFSCMDZERO, 4=MCECS_OFFSCMDEND, 5=MCECS_GAINCMDAD, 6=MCECS_GAINCMDBE, 7=MCECS_GAINCMDCF, 8=MCECS_CMDSAFEST}, implementation-data-type=uint8, type-emitter=RTE
    MotCurrEolCalSt2: compu {0=MCECS_OFFSCMDSTRT, 1=MCECS_OFFSCMDHI, 2=MCECS_OFFSCMDLO, 3=MCECS_OFFSCMDZERO, 4=MCECS_OFFSCMDEND, 5=MCECS_GAINCMDAD, 6=MCECS_GAINCMDBE, 7=MCECS_GAINCMDCF, 8=MCECS_CMDSAFEST}, implementation-data-type=uint8, type-emitter=RTE
    MotPrmNomEolRec2: category=STRUCTURE, sw-calibration-access=READ-ONLY, type-emitter=RTE
      element MotKeNom: implementation-data-type=float32
      element MotRNom: implementation-data-type=float32
      symbol props MotPrmNomEolRec2
    MotPrmNomEolRec3: category=STRUCTURE, sw-calibration-access=READ-ONLY, type-emitter=RTE
      element MotBackEmfConNom: implementation-data-type=float32
      element MotRNom: implementation-data-type=float32
      symbol props MotPrmNomEolRec3
    MotQuad1: compu {1..4=MOTQUAD_QUAD1..MOTQUAD_QUAD4}, implementation-data-type=uint8, type-emitter=RTE
    MotRplCoggPrmRec1: category=STRUCTURE, sw-calibration-access=READ-ONLY, type-emitter=RTE
      9 x element, all with category=TYPE_REFERENCE:
        CoggOrder1: implementation-data-type=uint16
        CoggOrder1X: implementation-data-type=s1p14
        CoggOrder1Y: implementation-data-type=s1p14
        CoggOrder2: implementation-data-type=uint16
        CoggOrder2X: implementation-data-type=s1p14
        CoggOrder2Y: implementation-data-type=s1p14
        CoggOrder3: implementation-data-type=uint16
        CoggOrder3X: implementation-data-type=s1p14
        CoggOrder3Y: implementation-data-type=s1p14
    MotRplCoggPrmRec2: category=STRUCTURE, sw-calibration-access=READ-ONLY, type-emitter=RTE
      9 x element, all with category=TYPE_REFERENCE:
        CoggOrder1: implementation-data-type=uint16
        CoggOrder1X: implementation-data-type=s1p14
        CoggOrder1Y: implementation-data-type=s1p14
        CoggOrder2: implementation-data-type=uint16
        CoggOrder2X: implementation-data-type=s1p14
        CoggOrder2Y: implementation-data-type=s1p14
        CoggOrder3: implementation-data-type=uint16
        CoggOrder3X: implementation-data-type=s1p14
        CoggOrder3Y: implementation-data-type=s1p14
    NtcFltInfoRec1: category=STRUCTURE, sw-calibration-access=READ-ONLY, type-emitter=RTE
      4 x element, all with category=TYPE_REFERENCE:
        NtcNr: implementation-data-type=uint16
        AgiCntr: implementation-data-type=uint8
        Sts: implementation-data-type=uint8
        NtcStInfo: implementation-data-type=uint8
    NtcFltInfoRec2: category=STRUCTURE, sw-calibration-access=READ-ONLY, type-emitter=RTE
      element NtcNr: implementation-data-type=NtcNrWithResd1
      element AgiCntr: implementation-data-type=uint8
      element Sts: implementation-data-type=uint8
    NtcInfoRec1: category=STRUCTURE, sw-calibration-access=READ-ONLY, type-emitter=RTE
      element AgiCntr: implementation-data-type=uint8
      element Sts: implementation-data-type=uint8
      element NtcStInfo: implementation-data-type=uint8
    NtcInfoRec3: category=STRUCTURE, sw-calibration-access=READ-ONLY, type-emitter=RTE
      5 x element, all with category=TYPE_REFERENCE:
        NtcNr: implementation-data-type=NtcNr2
        NtcStInfo: implementation-data-type=uint8
        Sts: implementation-data-type=uint8
        DebCntr: implementation-data-type=sint16
        AgiCntr: implementation-data-type=uint8
    NtcInfoRec4: category=STRUCTURE, sw-calibration-access=READ-ONLY, type-emitter=DiagcMgr
      element NtcStInfo: implementation-data-type=uint8
      element Sts: implementation-data-type=uint8
      element AgiCntr: implementation-data-type=uint8
    NtcNr1: compu {1..511=NTCNR_0X001..NTCNR_0X1FF}, implementation-data-type=uint16, type-emitter=RTE
    NtcNr2: compu {0..511=NTCNR_0X000..NTCNR_0X1FF}, implementation-data-type=uint16, type-emitter=RTE
    NtcNrWithResd1: compu {0=NTCNR_RESD, 1..511=NTCNR_0X001..NTCNR_0X1FF}, implementation-data-type=uint16, type-emitter=RTE
    NtcSts1: compu {0=NTCSTS_PASSD, 1=NTCSTS_FAILD, 2=NTCSTS_PREPASSD, 3=NTCSTS_PREFAILD}, implementation-data-type=uint8, type-emitter=RTE
    NvMProxyFltTblAry1D1: category=ARRAY, sw-calibration-access=READ-ONLY, type-emitter=RTE
      element Element: array-size=5, array-size-semantics=FIXED-SIZE, implementation-data-type=NvMProxyFltTblRec1
      symbol props NvMProxyFltTblAry1D1
    NvMProxyFltTblRec1: category=STRUCTURE, sw-calibration-access=READ-ONLY, type-emitter=RTE
      element FltSts: implementation-data-type=NtcSts1
      element FltPrm: implementation-data-type=uint8
      symbol props NvMProxyFltTblRec1
    NvMProxyRtnBufAry1D: category=ARRAY, sw-calibration-access=READ-ONLY, type-emitter=RTE
      element Element: array-size=30, array-size-semantics=FIXED-SIZE, implementation-data-type=NvMProxyRtnBufRec
      symbol props NvMProxyRtnBufAry1D
    NvMProxyRtnBufRec: category=STRUCTURE, sw-calibration-access=READ-ONLY, type-emitter=RTE
      element StdRtn: implementation-data-type=uint8
      element ReqPen: implementation-data-type=uint8
      element ReqRes: implementation-data-type=uint8
      symbol props NvMProxyNonTrustedRtnBufRec
    OnlineCalPageInfoRec1: category=STRUCTURE, sw-calibration-access=READ-ONLY, type-emitter=TunSelnMngt
      element PageAcs: implementation-data-type=uint8
    OnlineCalSegInfoRec1: category=STRUCTURE, sw-calibration-access=READ-ONLY, type-emitter=TunSelnMngt
      element Page: implementation-data-type=Ary1D_OnlineCalPageInfoRec1_2
    OnlineCalStsRec1: category=STRUCTURE, type-emitter=RTE
      5 x element, all with category=TYPE_REFERENCE:
        Seg: implementation-data-type=Ary1D_OnlineCalSegInfoRec1_TunSelnMngt1
        CopySts: implementation-data-type=CalCopySts1
        ActvGroup: implementation-data-type=uint8
        ActvInin: implementation-data-type=uint8
        ActvRt: implementation-data-type=uint8
    PassFailCntrDiagcRec1: category=STRUCTURE, sw-calibration-access=READ-ONLY, type-emitter=RTE
      5 x element, all with category=TYPE_REFERENCE:
        Cntr: implementation-data-type=float32
        Thd: implementation-data-type=float32
        NegStep: implementation-data-type=float32
        PosStep: implementation-data-type=float32
        Sts: implementation-data-type=SigQlfr1
    ReadFltInfoRec1: category=STRUCTURE, sw-calibration-access=READ-ONLY, type-emitter=RTE
      4 x element, all with category=TYPE_REFERENCE:
        NtcNr: implementation-data-type=NtcNrWithResd1
        AgiCntr: implementation-data-type=uint8
        Sts: implementation-data-type=uint8
        NtcStInfo: implementation-data-type=uint8
    s10p5: implementation-data-type=sint16, type-emitter=RTE
    s11p4: implementation-data-type=sint16, type-emitter=RTE
    s14p1: implementation-data-type=sint16, type-emitter=RTE
    s15p0: implementation-data-type=sint16, type-emitter=RTE
    s15p16: implementation-data-type=sint32, type-emitter=RTE
    s18p13: implementation-data-type=sint32, type-emitter=RTE
    s1p14: implementation-data-type=sint16, type-emitter=RTE
    s2p13: implementation-data-type=sint16, type-emitter=RTE
    s3p12: implementation-data-type=sint16, type-emitter=RTE
    s4p11: implementation-data-type=sint16, type-emitter=RTE
    s5p10: implementation-data-type=sint16, type-emitter=RTE
    s6p9: implementation-data-type=sint16, type-emitter=RTE
    s7p8: implementation-data-type=sint16, type-emitter=RTE
    s8p7: implementation-data-type=sint16, type-emitter=RTE
    SigQlfr1: compu {0=SIGQLFR_NORES, 1=SIGQLFR_PASSD, 2=SIGQLFR_FAILD}, implementation-data-type=uint8, type-emitter=RTE
    sm5p12: implementation-data-type=sint8, type-emitter=RTE
    SnpshtDataRec1: category=STRUCTURE, sw-calibration-access=READ-ONLY, type-emitter=RTE
      10 x element, all with category=TYPE_REFERENCE:
        MicroDiagcData: implementation-data-type=uint32
        HwTq: implementation-data-type=s5p10
        MotTq: implementation-data-type=s5p10
        IgnCntr: implementation-data-type=uint32
        BrdgVltg: implementation-data-type=u6p10
        EcuT: implementation-data-type=s8p7
        NtcNr: implementation-data-type=uint16
        NtcStInfo: implementation-data-type=uint8
        SysSt: implementation-data-type=SysSt1
        VehSpd: implementation-data-type=u9p7
    SnsrLrndOffsRec1: category=STRUCTURE, sw-calibration-access=READ-ONLY, type-emitter=RTE
      15 x element, all with category=TYPE_REFERENCE:
        HwAgLrndTi: implementation-data-type=float32
        YawRateElpdTi: implementation-data-type=float32
        HwTqLrngCovariMtrx: implementation-data-type=Ary2D_f32_3_3
        HwTqLrngEstimnVect: implementation-data-type=Ary1D_f32_3
        YawRateOffs: implementation-data-type=s6p9
        HwAgOffs: implementation-data-type=s5p10
        HwTqOffs: implementation-data-type=s3p12
        HwAgLrngYawOffsRef: implementation-data-type=s6p9
        HwAgLrngHwAgFilSt: implementation-data-type=s11p4
        HwAgLrngSysTqFilSt: implementation-data-type=s10p5
        HwTqLrngHwAgRef: implementation-data-type=s11p4
        HwTqLrngSampleCntNeg: implementation-data-type=uint16
        HwTqLrngSampleCntPos: implementation-data-type=uint16
        HwTqLrngSts: implementation-data-type=uint8
        YawRateOffsVld: implementation-data-type=boolean
    StHlthMonSig1: compu {0=STHLTHMONSIG_ECUTFILTD, 1=STHLTHMONSIG_ASSIDUETOVLTG}, implementation-data-type=uint8, type-emitter=RTE
    StHlthMonSig2:
      compu {0=STHLTHMONSIG_ECUTFILTD, 1=STHLTHMONSIG_ASSIDUETOVLTG, 2=STHLTHMONSIG_DIGTQSNSRA, 3=STHLTHMONSIG_DIGTQSNSRB, 4=STHLTHMONSIG_DIGTQIDPTSIG, 5=STHLTHMONSIG_DUTYCYC, 6=STHLTHMONSIG_EOTIMPCT, 7=STHLTHMONSIG_MOTPOS, 8=STHLTHMONSIG_MOTPOSABDIFF, 9=STHLTHMONSIG_MOTPOSACDIFF, 10=STHLTHMONSIG_MOTPOSBCDIFF, 11=STHLTHMONSIG_CURRMOTSUMABC, 12=STHLTHMONSIG_CURRMOTSUMDEF, 13=STHLTHMONSIG_MOTPOSPHASEA, 14=STHLTHMONSIG_MOTPOSPHASEB, 15=STHLTHMONSIG_MOTPOSPHASEC, 16=STHLTHMONSIG_MOTPOSPHASED, 17=STHLTHMONSIG_MOTPOSPHASEE, 18=STHLTHMONSIG_MOTPOSPHASEF, 19=STHLTHMONSIG_BITCORRN}
      implementation-data-type=uint8
      type-emitter=RTE
    StHlthMonSig3:
      compu {0=STHLTHMONSIG_ECUTFILTD, 1=STHLTHMONSIG_ASSIDUETOVLTG, 2=STHLTHMONSIG_DIGTQSNSRA, 3=STHLTHMONSIG_DIGTQSNSRB, 4=STHLTHMONSIG_DIGTQIDPTSIG, 5=STHLTHMONSIG_DUTYCYC, 6=STHLTHMONSIG_EOTIMPCT, 7=STHLTHMONSIG_MOTPOS, 8=STHLTHMONSIG_MOTPOSABDIFF, 9=STHLTHMONSIG_MOTPOSACDIFF, 10=STHLTHMONSIG_MOTPOSBCDIFF, 11=STHLTHMONSIG_CURRMOTSUMABC, 12=STHLTHMONSIG_CURRMOTSUMDEF, 13=STHLTHMONSIG_MOTPOSPHASEA, 14=STHLTHMONSIG_MOTPOSPHASEB, 15=STHLTHMONSIG_MOTPOSPHASEC, 16=STHLTHMONSIG_MOTPOSPHASED, 17=STHLTHMONSIG_MOTPOSPHASEE, 18=STHLTHMONSIG_MOTPOSPHASEF, 19=STHLTHMONSIG_BITCORRN, 20=STHLTHMONSIG_FRICESTIMN, 21=STHLTHMONSIG_WHLIMBREJCTN}
      implementation-data-type=uint8
      type-emitter=RTE
    StordLstPrmRec1: category=STRUCTURE, sw-calibration-access=READ-ONLY, type-emitter=RTE
      element PinionAg: implementation-data-type=float32
      element PinionAgVld: implementation-data-type=boolean
    StrtUpSt1: compu {1=STRTUPST_PWRDISCNCTATESTCMPL, 2=STRTUPST_PWRDISCNCTBTESTCMPL, 3=STRTUPST_TMPLMONININTESTCMPL, 4=STRTUPST_MOTDRVRININCMPL, 5=STRTUPST_CURRMEASWRMININTESTCMPL, 6=STRTUPST_WARMININCMPL, 7=STRTUPST_RUN, 8=STRTUPST_DISABLE}, implementation-data-type=uint8, type-emitter=RTE
    SyncCrcHwStsAry1D1: category=ARRAY, sw-calibration-access=READ-ONLY, type-emitter=RTE
      element Element: array-size=4, array-size-semantics=FIXED-SIZE, implementation-data-type=SyncCrcHwStsRec1
    SyncCrcHwStsRec1: category=STRUCTURE, sw-calibration-access=READ-ONLY, type-emitter=RTE
      element TaskId: implementation-data-type=uint16
      element CrcHwSts: implementation-data-type=uint8
    SysFricDataRec1: category=STRUCTURE, sw-calibration-access=READ-ONLY, type-emitter=RTE
      6 x element, all with category=TYPE_REFERENCE:
        FricOffs: implementation-data-type=float32
        BasLineFric: implementation-data-type=Ary1D_f32_4
        VehLrndFric: implementation-data-type=Ary1D_f32_4
        Hys: implementation-data-type=Ary2D_f32_8_4
        RngCntr: implementation-data-type=Ary2D_u16_8_3
        SysFricLrngOperMod: implementation-data-type=SysFricLrngOperMod1
    SysFricLrngOperMod1: compu {0=SYSFRICLRNGOPERMOD_CALIBRATION, 1=SYSFRICLRNGOPERMOD_NORMAL, 2=SYSFRICLRNGOPERMOD_CLEAR, 3=SYSFRICLRNGOPERMOD_IDLE, 4=SYSFRICLRNGOPERMOD_BASELINE}, implementation-data-type=uint8, type-emitter=RTE
    SysFricNonLrngDataRec1: category=STRUCTURE, sw-calibration-access=READ-ONLY, type-emitter=RTE
      element EolFric: implementation-data-type=float32
      element EnaFricLrng: implementation-data-type=boolean
      element EnaFricOffsOutp: implementation-data-type=boolean
    SysSt1: compu {0=SYSST_DI, 1=SYSST_OFF, 2=SYSST_ENA, 3=SYSST_WRMININ}, implementation-data-type=uint8, type-emitter=RTE
    TrigReg1: compu {85=TRIGREG_MST, 170=TRIGREG_CHKR, 255=TRIGREG_MSTANDCHKR}, implementation-data-type=uint8, type-emitter=EcmOutpAndDiagc
    u0p16: implementation-data-type=uint16, type-emitter=RTE
    u10p6: implementation-data-type=uint16, type-emitter=RTE
    u11p5: implementation-data-type=uint16, type-emitter=RTE
    u12p4: implementation-data-type=uint16, type-emitter=RTE
    u13p3: implementation-data-type=uint16, type-emitter=RTE
    u16p0: implementation-data-type=uint16, type-emitter=RTE
    u1p15: implementation-data-type=uint16, type-emitter=RTE
    u2p14: implementation-data-type=uint16, type-emitter=RTE
    u3p13: implementation-data-type=uint16, type-emitter=RTE
    u4p12: implementation-data-type=uint16, type-emitter=RTE
    u5p11: implementation-data-type=uint16, type-emitter=RTE
    u6p10: implementation-data-type=uint16, type-emitter=RTE
    u7p9: implementation-data-type=uint16, type-emitter=RTE
    u8p8: implementation-data-type=uint16, type-emitter=RTE
    u9p7: implementation-data-type=uint16, type-emitter=RTE
package /Nexteer/NvMProxy_swc/DataTypes
  impl type NvM_BlockIdType: category=VALUE, base-type=BaseTypes/NvM_BlockIdType, range raw 1..32767
  impl type NvM_RequestResultType: category=VALUE, base-type=BaseTypes/NvM_RequestResultType, compu {0=NVM_REQ_OK, 1=NVM_REQ_NOT_OK, 2=NVM_REQ_PENDING, 3=NVM_REQ_INTEGRITY_FAILED, 4=NVM_REQ_BLOCK_SKIPPED, 5=NVM_REQ_NV_INVALIDATED, 6=NVM_REQ_CANCELED, 7=NVM_REQ_REDUNDANCY_FAILED, 8=NVM_REQ_RESTORED_FROM_ROM}
package /Nexteer/NvMProxy_swc/DataTypes/BaseTypes
  base type NvM_BlockIdType: category=FIXED_LENGTH, base-type-size=16, base-type-encoding=NONE, native-declaration=uint16
  base type NvM_RequestResultType: category=FIXED_LENGTH, base-type-size=8, base-type-encoding=NONE, native-declaration=uint8
package /Nexteer/NvMProxy_swc/DataTypes/DataConstrs
  range UInt8_Constr: raw 0..255
package /Nexteer/Units
  72 x unit, all with factor-si-to-unit=1, offset-si-to-unit=0:
    Ampr: display-name=Amp
    AmprPerVolt: display-name=Amp/V
    AmprSqd: display-name=Amp^2
    Bar: display-name=bar
    Cnt: display-name=Cnt
    CntPerNanoSec: display-name=Cnt/nS
    DegCgrd: display-name=degC
    DegCgrdPerSec: display-name=degC/s
    DegCgrdPerVolt: display-name=degC/Volt
    DegCgrdPerWatt: display-name=degC/Watt
    FixdPt
    Henry: display-name=H
    HwDeg: display-name=HwDeg
    HwDegPerSec: display-name=HwDeg/s
    HwDegPerVolt: display-name=HwDeg/volt
    HwNwtMtr: display-name=HwNm
    HwNwtMtrPerHwDeg: display-name=HwNm/HwDeg
    HwNwtMtrPerMotNwtMtr: display-name=HwNm/MotNm
    HwRad: display-name=HwRad
    HwRadPerSec: display-name=HwRad/s
    Hz: display-name=Hz
    IvsHwNwtMtr: display-name=1/HwNm
    KiloGrMtrSqd: display-name=kgm^2
    KiloHz: display-name=kHz
    KiloMtrPerHr: display-name=KpH
    Kph: display-name=kph
    KphPerSec: display-name=kph/s
    KphPerSecPerMtrPerSecSqd: display-name=kph/(m/s^2)
    KphPerSecSqd: display-name=kph/s^2
    MicroSec: display-name=uS
    MilliSec: display-name=mS
    MotDeg: display-name=MotDeg
    MotDegElec: display-name=MotDegElec
    MotDegPerHwDeg: display-name=MotDeg/HwDeg
    MotDegPerSec: display-name=MotDeg/s
    MotNwtMtr: display-name=MotNm
    MotNwtMtrPerHwDegSec: display-name=MotNm/HwDegS
    MotNwtMtrPerHwNwtMtr: display-name=MotNm/HwNm
    MotNwtMtrPerMotDeg: display-name=MotNm/MotDeg
    MotNwtMtrPerMotRadPerSec: display-name=MotNm/MotRad/S
    MotNwtMtrPerRadPerSec: display-name=MotNM/Rad/s
    MotNwtMtrPerSec: display-name=MotNm/S
    MotRad: display-name=MotRad
    MotRadPerSec: display-name=MotRad/s
    MotRev: display-name=MotRev
    MotRevElec: display-name=MotRevElec
    Mtr: display-name=m
    MtrPerSec: display-name=m/s
    MtrPerSecSqd: display-name=m/s^2
    NanoSec: display-name=nS
    NanoSecPerCnt: display-name=nS/Cnt
    Ohm: display-name=ohm
    OhmPerDegCgrd: display-name=ohm/degC
    Rad: display-name=Radians  # Motor Positions
    Rec: display-name=rec
    Sec: display-name=sec
    TrsmNwtMtr: display-name=TrsmNm
    Uls: display-name=Uls
    UlsPerMilliSec: display-name=Uls/mS
    UlsPerSec: display-name=Uls/S
    VehDegPerSec: display-name=VehDeg/S
    VehDegPerSecSqd: display-name=VehDeg/S^2
    Volt: display-name=V
    VoltNanoSec: display-name=VnS
    VoltPerCnt: display-name=Volt/Cnt
    VoltPerMotRadPerSec: display-name=V/MotRad/Sec
    VoltPerMotRadPerSecPerDegCgrd: display-name=V/MotRad/S/degC
    VoltPerRadPerSec: display-name=V/Rad/s
    VoltPerRadPerSecPerDegCgrd: display-name=(V/Rad/S)/degC
    VoltPerSec: display-name=V/s
    VoltPerVoltNanoSec
    WattPerAmprSqd: display-name=Watt/A^2
