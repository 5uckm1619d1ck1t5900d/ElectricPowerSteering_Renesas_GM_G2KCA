[part 2 of 2: packages /Nexteer/NvMProxy_swc/Interfaces to /PortInterfaces]
AUTOSAR XML (schema 4-0-3)
package /Nexteer/NvMProxy_swc/Interfaces
  5 x client server interface, all with is-service=true:
    NvMAdministration
      operation SetBlockProtection: possible-error=NvMAdministration/E_NOT_OK
        arg ProtectionEnabled_Arg: type=boolean, direction=IN, server-argument-impl-policy=USE-ARGUMENT-TYPE
      error E_NOT_OK: error-code=1
    NvMService_AC3_SRBS
      6 x operation, all with possible-error=NvMService_AC3_SRBS/E_NOT_OK:
        EraseBlock
        GetErrorStatus
          arg ErrorStatus: type=NvM_RequestResultType, direction=OUT, server-argument-impl-policy=USE-ARGUMENT-TYPE
        InvalidateNvBlock
        ReadBlock
          arg DstPtr: type=dtRef_VOID, direction=IN, server-argument-impl-policy=USE-ARGUMENT-TYPE
        SetRamBlockStatus
          arg RamBlockStatus: type=Boolean, direction=IN, server-argument-impl-policy=USE-ARGUMENT-TYPE
        WriteBlock
          arg SrcPtr: type=dtRef_const_VOID, direction=IN, server-argument-impl-policy=USE-ARGUMENT-TYPE
      error E_NOT_OK: error-code=1
    NvMService_AC3_SRBS_Defs
      7 x operation, all with possible-error=NvMService_AC3_SRBS_Defs/E_NOT_OK:
        EraseBlock
        GetErrorStatus
          arg ErrorStatus: type=NvM_RequestResultType, direction=OUT, server-argument-impl-policy=USE-ARGUMENT-TYPE
        InvalidateNvBlock
        ReadBlock
          arg DstPtr: type=dtRef_VOID, direction=IN, server-argument-impl-policy=USE-ARGUMENT-TYPE
        RestoreBlockDefaults
          arg DstPtr: type=dtRef_VOID, direction=IN, server-argument-impl-policy=USE-ARGUMENT-TYPE
        SetRamBlockStatus
          arg RamBlockStatus: type=Boolean, direction=IN, server-argument-impl-policy=USE-ARGUMENT-TYPE
        WriteBlock
          arg SrcPtr: type=dtRef_const_VOID, direction=IN, server-argument-impl-policy=USE-ARGUMENT-TYPE
      error E_NOT_OK: error-code=1
    NvMService_AC3_SRBS_DS
      8 x operation, all with possible-error=NvMService_AC3_SRBS_DS/E_NOT_OK:
        EraseBlock
        GetDataIndex
          arg DataIndex_Arg: type=uint8, direction=OUT, server-argument-impl-policy=USE-ARGUMENT-TYPE
        GetErrorStatus
          arg ErrorStatus_Arg: type=NvM_RequestResultType, direction=OUT, server-argument-impl-policy=USE-ARGUMENT-TYPE
        InvalidateNvBlock
        ReadBlock
          arg DstPtr_Arg: type=dtRef_VOID, direction=IN, server-argument-impl-policy=USE-ARGUMENT-TYPE
        SetDataIndex
          arg DataIndex_Arg: type=uint8, direction=IN, server-argument-impl-policy=USE-ARGUMENT-TYPE
        SetRamBlockStatus
          arg RamBlockStatus_Arg: type=boolean, direction=IN, server-argument-impl-policy=USE-ARGUMENT-TYPE
        WriteBlock
          arg SrcPtr_Arg: type=dtRef_const_VOID, direction=IN, server-argument-impl-policy=USE-ARGUMENT-TYPE
      error E_NOT_OK: error-code=1
    NvMService_AC3_SRBS_DS_Defs
      9 x operation, all with possible-error=NvMService_AC3_SRBS_DS_Defs/E_NOT_OK:
        EraseBlock
        GetDataIndex
          arg DataIndex_Arg: type=uint8, direction=OUT, server-argument-impl-policy=USE-ARGUMENT-TYPE
        GetErrorStatus
          arg ErrorStatus_Arg: type=NvM_RequestResultType, direction=OUT, server-argument-impl-policy=USE-ARGUMENT-TYPE
        InvalidateNvBlock
        ReadBlock
          arg DstPtr_Arg: type=dtRef_VOID, direction=IN, server-argument-impl-policy=USE-ARGUMENT-TYPE
        RestoreBlockDefaults
          arg DstPtr_Arg: type=dtRef_VOID, direction=IN, server-argument-impl-policy=USE-ARGUMENT-TYPE
        SetDataIndex
          arg DataIndex_Arg: type=uint8, direction=IN, server-argument-impl-policy=USE-ARGUMENT-TYPE
        SetRamBlockStatus
          arg RamBlockStatus_Arg: type=boolean, direction=IN, server-argument-impl-policy=USE-ARGUMENT-TYPE
        WriteBlock
          arg SrcPtr_Arg: type=dtRef_const_VOID, direction=IN, server-argument-impl-policy=USE-ARGUMENT-TYPE
      error E_NOT_OK: error-code=1
package /Nexteer/PortInterfaces
  364 x client server interface:
    ActvTunStsReq_PortIf1
      operation Oper
        5 x arg, all with type=uint8, direction=INOUT, server-argument-impl-policy=USE-ARGUMENT-TYPE:
          ActvRtIdx_Arg
          ActvIninIdx_Arg
          CalChgAllwd_Arg
          ActvGroup_Arg
          CalCopyCmpl_Arg
    Adc1CfgAndUseAdc1EnaCnvn1
      operation Oper
    AdcScanGroupCfg_PortIf1
      operation Oper
        arg StrtPtr_Arg: type=uint8, direction=IN, server-argument-impl-policy=USE-ARGUMENT-TYPE
        arg EndPtr_Arg: type=uint8, direction=IN, server-argument-impl-policy=USE-ARGUMENT-TYPE
    Calc16BitCrc_u08_PortIf1
      operation Oper: possible-error=Calc16BitCrc_u08_PortIf1/E_NOT_OK
        5 x arg, all with server-argument-impl-policy=USE-ARGUMENT-TYPE:
          DataPtr_Arg: type=uint8, direction=INOUT
          Len_Arg: type=uint32, direction=IN
          StrtVal_Arg: type=uint16, direction=IN
          FirstCall_Arg: type=boolean, direction=IN
          CalcCrcRes_Arg: type=uint16, direction=OUT
      error E_NOT_OK: error-code=1
    Calc16BitCrc_u16_PortIf1
      operation Oper: possible-error=Calc16BitCrc_u16_PortIf1/E_NOT_OK
        5 x arg, all with server-argument-impl-policy=USE-ARGUMENT-TYPE:
          DataPtr_Arg: type=uint16, direction=INOUT
          Len_Arg: type=uint32, direction=IN
          StrtVal_Arg: type=uint16, direction=IN
          FirstCall_Arg: type=boolean, direction=IN
          CalcCrcRes_Arg: type=uint16, direction=OUT
      error E_NOT_OK: error-code=1
    Calc32BitCrc_u08_PortIf1
      operation Oper: possible-error=Calc32BitCrc_u08_PortIf1/E_NOT_OK
        5 x arg, all with server-argument-impl-policy=USE-ARGUMENT-TYPE:
          DataPtr_Arg: type=uint8, direction=INOUT
          Len_Arg: type=uint32, direction=IN
          StrtVal_Arg: type=uint32, direction=IN
          FirstCall_Arg: type=boolean, direction=IN
          CalcCrcRes_Arg: type=uint32, direction=OUT
      error E_NOT_OK: error-code=1
    Calc32BitCrc_u16_PortIf1
      operation Oper: possible-error=Calc32BitCrc_u16_PortIf1/E_NOT_OK
        5 x arg, all with server-argument-impl-policy=USE-ARGUMENT-TYPE:
          DataPtr_Arg: type=uint16, direction=INOUT
          Len_Arg: type=uint32, direction=IN
          StrtVal_Arg: type=uint32, direction=IN
          FirstCall_Arg: type=boolean, direction=IN
          CalcCrcRes_Arg: type=uint32, direction=OUT
      error E_NOT_OK: error-code=1
    Calc32BitCrc_u32_PortIf1
      operation Oper: possible-error=Calc32BitCrc_u32_PortIf1/E_NOT_OK
        5 x arg, all with server-argument-impl-policy=USE-ARGUMENT-TYPE:
          DataPtr_Arg: type=uint32, direction=INOUT
          Len_Arg: type=uint32, direction=IN
          StrtVal_Arg: type=uint32, direction=IN
          FirstCall_Arg: type=boolean, direction=IN
          CalcCrcRes_Arg: type=uint32, direction=OUT
      error E_NOT_OK: error-code=1
    Calc8BitCrc_PortIf1
      operation Oper: possible-error=Calc8BitCrc_PortIf1/E_NOT_OK
        5 x arg, all with server-argument-impl-policy=USE-ARGUMENT-TYPE:
          DataPtr_Arg: type=uint8, direction=INOUT
          Len_Arg: type=uint32, direction=IN
          StrtVal_Arg: type=uint8, direction=IN
          FirstCall_Arg: type=boolean, direction=IN
          CalcCrcRes_Arg: type=uint8, direction=OUT
      error E_NOT_OK: error-code=1
    ChkForStrtUpTest_PortIf1
      operation Oper
        arg ExecStrtUpTest_Arg: type=boolean, direction=OUT, server-argument-impl-policy=USE-ARGUMENT-TYPE
    ClrAllDiagc_PortIf1
      operation Oper
    ClrAllNtc_PortIf1
      operation Oper: possible-error=ClrAllNtc_PortIf1/E_NOT_OK
      error E_NOT_OK: error-code=1
    ClrFricLrngOperMod_PortIf1
      operation Oper
    ClrHwAgTrimVal_PortIf1
      operation Oper
    ClrSigStcHlthData_PortIf1
      operation Oper
        arg ClrTar_Arg: type=boolean, direction=IN, server-argument-impl-policy=USE-ARGUMENT-TYPE
    ClrSnpshtData_PortIf1
      operation Oper
    CopyCalPageReq_PortIf1
      operation Oper: possible-error=CopyCalPageReq_PortIf1/E_NOT_OK
        arg Seg_Arg: type=uint8, direction=IN, server-argument-impl-policy=USE-ARGUMENT-TYPE
      error E_NOT_OK: error-code=1
    CtrlErrOut_PortIf1
      operation Oper
        arg PinSt_Arg: type=boolean, direction=IN, server-argument-impl-policy=USE-ARGUMENT-TYPE
        arg TrigReg_Arg: type=TrigReg1, direction=IN, server-argument-impl-policy=USE-ARGUMENT-TYPE
    CurrMeasEolGainReq_PortIf1
      operation Oper
    CurrMeasEolGainReq1
      operation Oper: possible-error=CurrMeasEolGainReq1/E_NOT_OK
      error E_NOT_OK: error-code=1
    CurrMeasEolGainStReq_PortIf1
      operation Oper
        arg CurrMeasEolGainSt_Arg: type=uint8, direction=OUT, server-argument-impl-policy=USE-ARGUMENT-TYPE
    CurrMeasEolGainStReq1
      operation Oper: possible-error=CurrMeasEolGainStReq1/E_NOT_OK
        arg CurrMeasEolGainSt: type=Cnt12, direction=OUT, server-argument-impl-policy=USE-ARGUMENT-TYPE
      error E_NOT_OK: error-code=1
    CurrMeasEolOffsReq_PortIf1
      operation Oper
    CurrMeasEolOffsReq1
      operation Oper: possible-error=CurrMeasEolOffsReq1/E_NOT_OK
      error E_NOT_OK: error-code=1
    CurrMeasEolOffsStReq_PortIf1
      operation Oper
        arg CurrMeasEolOffsSt_Arg: type=uint8, direction=OUT, server-argument-impl-policy=USE-ARGUMENT-TYPE
    CurrMeasEolOffsStReq1
      operation Oper: possible-error=CurrMeasEolOffsStReq1/E_NOT_OK
        arg CurrMeasEolOffsSt: type=Cnt12, direction=OUT, server-argument-impl-policy=USE-ARGUMENT-TYPE
      error E_NOT_OK: error-code=1
    CurrMeasGainReadReq_PortIf1
      operation Oper
        6 x arg, all with type=float32, direction=OUT, server-argument-impl-policy=USE-ARGUMENT-TYPE:
          CurrMeasMotCurrGainA_Arg
          CurrMeasMotCurrGainB_Arg
          CurrMeasMotCurrGainC_Arg
          CurrMeasMotCurrGainD_Arg
          CurrMeasMotCurrGainE_Arg
          CurrMeasMotCurrGainF_Arg
    CurrMeasGainReadReq_PortIf2
      operation Oper
        arg CurrMeasMotCurrGainA_Arg: type=float32, direction=OUT, server-argument-impl-policy=USE-ARGUMENT-TYPE
        arg CurrMeasMotCurrGainB_Arg: type=float32, direction=OUT, server-argument-impl-policy=USE-ARGUMENT-TYPE
        arg CurrMeasMotCurrGainC_Arg: type=float32, direction=OUT, server-argument-impl-policy=USE-ARGUMENT-TYPE
    CurrMeasGainWrReq_PortIf1  # OBSELETE
      operation Oper
        6 x arg, all with type=float32, direction=IN, server-argument-impl-policy=USE-ARGUMENT-TYPE:
          CurrMeasMotCurrGainA_Arg
          CurrMeasMotCurrGainB_Arg
          CurrMeasMotCurrGainC_Arg
          CurrMeasMotCurrGainD_Arg
          CurrMeasMotCurrGainE_Arg
          CurrMeasMotCurrGainF_Arg
    CurrMeasGainWrReq_PortIf2
      operation Oper
        7 x arg, all with server-argument-impl-policy=USE-ARGUMENT-TYPE:
          CurrMeasMotCurrGainA_Arg: type=float32, direction=IN
          CurrMeasMotCurrGainB_Arg: type=float32, direction=IN
          CurrMeasMotCurrGainC_Arg: type=float32, direction=IN
          CurrMeasMotCurrGainD_Arg: type=float32, direction=IN
          CurrMeasMotCurrGainE_Arg: type=float32, direction=IN
          CurrMeasMotCurrGainF_Arg: type=float32, direction=IN
          CurrMeasGainWrReqSts_Arg: type=uint8, direction=OUT
    CurrMeasGainWrReq_PortIf3
      operation Oper
        4 x arg, all with server-argument-impl-policy=USE-ARGUMENT-TYPE:
          CurrMeasMotCurrGainA_Arg: type=float32, direction=IN
          CurrMeasMotCurrGainB_Arg: type=float32, direction=IN
          CurrMeasMotCurrGainC_Arg: type=float32, direction=IN
          CurrMeasGainWrReqSts_Arg: type=uint8, direction=OUT
    CurrMeasOffsReadReq_PortIf1  # OBSELETE
      operation Oper
        13 x arg, all with type=float32, direction=OUT, server-argument-impl-policy=USE-ARGUMENT-TYPE:
          CurrMeasEolOffsHiBrdgVltg
          CurrMeasMotCurrOffsDifA
          CurrMeasMotCurrOffsDifB
          CurrMeasMotCurrOffsDifC
          CurrMeasMotCurrOffsDifD
          CurrMeasMotCurrOffsDifE
          CurrMeasMotCurrOffsDifF
          CurrMeasMotCurrOffsLoAvrgA
          CurrMeasMotCurrOffsLoAvrgB
          CurrMeasMotCurrOffsLoAvrgC
          CurrMeasMotCurrOffsLoAvrgD
          CurrMeasMotCurrOffsLoAvrgE
          CurrMeasMotCurrOffsLoAvrgF
    CurrMeasOffsReadReq_PortIf2
      operation Oper
        13 x arg, all with type=float32, direction=OUT, server-argument-impl-policy=USE-ARGUMENT-TYPE:
          CurrMeasEolOffsHiBrdgVltg_Arg
          CurrMeasMotCurrOffsDifA_Arg
          CurrMeasMotCurrOffsDifB_Arg
          CurrMeasMotCurrOffsDifC_Arg
          CurrMeasMotCurrOffsDifD_Arg
          CurrMeasMotCurrOffsDifE_Arg
          CurrMeasMotCurrOffsDifF_Arg
          CurrMeasMotCurrOffsLoAvrgA_Arg
          CurrMeasMotCurrOffsLoAvrgB_Arg
          CurrMeasMotCurrOffsLoAvrgC_Arg
          CurrMeasMotCurrOffsLoAvrgD_Arg
          CurrMeasMotCurrOffsLoAvrgE_Arg
          CurrMeasMotCurrOffsLoAvrgF_Arg
    CurrMeasOffsReadReq_PortIf3
      operation Oper
        arg MotCurrOffsZeroAvrgA_Arg: type=float32, direction=OUT, server-argument-impl-policy=USE-ARGUMENT-TYPE
        arg MotCurrOffsZeroAvrgB_Arg: type=float32, direction=OUT, server-argument-impl-policy=USE-ARGUMENT-TYPE
        arg MotCurrOffsZeroAvrgC_Arg: type=float32, direction=OUT, server-argument-impl-policy=USE-ARGUMENT-TYPE
    CurrMeasOffsWrReq_PortIf1  # OBSELETE
      operation Oper
        13 x arg, all with type=float32, direction=IN, server-argument-impl-policy=USE-ARGUMENT-TYPE:
          CurrMeasEolOffsHiBrdgVltg
          CurrMeasMotCurrOffsDifA
          CurrMeasMotCurrOffsDifB
          CurrMeasMotCurrOffsDifC
          CurrMeasMotCurrOffsDifD
          CurrMeasMotCurrOffsDifE
          CurrMeasMotCurrOffsDifF
          CurrMeasMotCurrOffsLoAvrgA
          CurrMeasMotCurrOffsLoAvrgB
          CurrMeasMotCurrOffsLoAvrgC
          CurrMeasMotCurrOffsLoAvrgD
          CurrMeasMotCurrOffsLoAvrgE
          CurrMeasMotCurrOffsLoAvrgF
    CurrMeasOffsWrReq_PortIf2  # OBSELETE
      operation Oper
        13 x arg, all with type=float32, direction=IN, server-argument-impl-policy=USE-ARGUMENT-TYPE:
          CurrMeasEolOffsHiBrdgVltg_Arg
          CurrMeasMotCurrOffsDifA_Arg
          CurrMeasMotCurrOffsDifB_Arg
          CurrMeasMotCurrOffsDifC_Arg
          CurrMeasMotCurrOffsDifD_Arg
          CurrMeasMotCurrOffsDifE_Arg
          CurrMeasMotCurrOffsDifF_Arg
          CurrMeasMotCurrOffsLoAvrgA_Arg
          CurrMeasMotCurrOffsLoAvrgB_Arg
          CurrMeasMotCurrOffsLoAvrgC_Arg
          CurrMeasMotCurrOffsLoAvrgD_Arg
          CurrMeasMotCurrOffsLoAvrgE_Arg
          CurrMeasMotCurrOffsLoAvrgF_Arg
    CurrMeasOffsWrReq_PortIf3
      operation Oper
        14 x arg, all with server-argument-impl-policy=USE-ARGUMENT-TYPE:
          CurrMeasEolOffsHiBrdgVltg_Arg: type=float32, direction=IN
          CurrMeasMotCurrOffsDifA_Arg: type=float32, direction=IN
          CurrMeasMotCurrOffsDifB_Arg: type=float32, direction=IN
          CurrMeasMotCurrOffsDifC_Arg: type=float32, direction=IN
          CurrMeasMotCurrOffsDifD_Arg: type=float32, direction=IN
          CurrMeasMotCurrOffsDifE_Arg: type=float32, direction=IN
          CurrMeasMotCurrOffsDifF_Arg: type=float32, direction=IN
          CurrMeasMotCurrOffsLoAvrgA_Arg: type=float32, direction=IN
          CurrMeasMotCurrOffsLoAvrgB_Arg: type=float32, direction=IN
          CurrMeasMotCurrOffsLoAvrgC_Arg: type=float32, direction=IN
          CurrMeasMotCurrOffsLoAvrgD_Arg: type=float32, direction=IN
          CurrMeasMotCurrOffsLoAvrgE_Arg: type=float32, direction=IN
          CurrMeasMotCurrOffsLoAvrgF_Arg: type=float32, direction=IN
          CurrMeasOffsWrReqSts_Arg: type=uint8, direction=OUT
    CurrMeasOffsWrReq_PortIf4
      operation Oper
        arg MotCurrOffsZeroAvrgA_Arg: type=float32, direction=IN, server-argument-impl-policy=USE-ARGUMENT-TYPE
        arg MotCurrOffsZeroAvrgB_Arg: type=float32, direction=IN, server-argument-impl-policy=USE-ARGUMENT-TYPE
        arg MotCurrOffsZeroAvrgC_Arg: type=float32, direction=IN, server-argument-impl-policy=USE-ARGUMENT-TYPE
    CustDiagcClrGmIgnCntr_PortIf1
      operation Oper
    DiagcMgrIninCore_PortIf1
      operation Oper
        5 x arg, all with server-argument-impl-policy=USE-ARGUMENT-TYPE:
          ApplIdx_Arg: type=uint8, direction=IN
          NtcInfoSize_Arg: type=uint16, direction=IN
          NtcInfoAry_Arg: type=Ary1D_NtcInfoRec4_DiagcMgr, direction=INOUT
          DiagcData_Arg: type=DiagcDataRec1, direction=OUT
          ProxySetNtcData_Arg: type=DiagcDataRec1, direction=OUT
    DiagcMgrIninCore_PortIf2
      operation Oper
        5 x arg, all with server-argument-impl-policy=USE-ARGUMENT-TYPE:
          ApplIdx_Arg: type=uint8, direction=IN
          NtcInfoArySize_Arg: type=uint8, direction=IN
          NtcInfoAry_Arg: type=Ary1D_NtcInfoRec4_DiagcMgr, direction=INOUT
          DiagcData_Arg: type=DiagcDataRec1, direction=OUT
          ProxySetNtcData_Arg: type=DiagcDataRec1, direction=OUT
    DiagcMgrPwrDwn_PortIf1
      operation Oper: possible-error=DiagcMgrPwrDwn_PortIf1/E_NOT_OK
      error E_NOT_OK: error-code=1
    DmaEna2MilliSecToMotCtrlTrf1
      operation Oper
    DmaEna2msToMotCtrlTrf
      operation Oper
    DmaEna2msToMotCtrlTrf1
      operation DmaEna2msToMotCtrlTrf_Oper
    DmaWaitForMotCtrlTo2MilliSecTrf1
      operation Oper: possible-error=DmaWaitForMotCtrlTo2MilliSecTrf1/E_NOT_OK
      error E_NOT_OK: error-code=1
    DmaWaitForMotCtrlTo2msTrf
      operation Oper: possible-error=DmaWaitForMotCtrlTo2msTrf/E_NOT_OK
      error E_NOT_OK: error-code=1
    DmaWaitForMotCtrlTo2msTrf1
      operation DmaWaitForMotCtrlTo2msTrf_Oper: possible-error=DmaWaitForMotCtrlTo2msTrf1/E_NOT_OK
      error E_NOT_OK: error-code=1
    FltInj_f32_PortIf1
      operation Oper
        arg SigPah_Arg: type=float32, direction=INOUT, server-argument-impl-policy=USE-ARGUMENT-TYPE
        arg LocnKey_Arg: type=uint16, direction=IN, server-argument-impl-policy=USE-ARGUMENT-TYPE
    FltInj_logl_PortIf1
      operation Oper
        arg SigPah_Arg: type=boolean, direction=INOUT, server-argument-impl-policy=USE-ARGUMENT-TYPE
        arg LocnKey_Arg: type=uint16, direction=IN, server-argument-impl-policy=USE-ARGUMENT-TYPE
    FltInj_u08_PortIf1
      operation Oper
        arg SigPah_Arg: type=uint8, direction=INOUT, server-argument-impl-policy=USE-ARGUMENT-TYPE
        arg LocnKey_Arg: type=uint16, direction=IN, server-argument-impl-policy=USE-ARGUMENT-TYPE
    FltInj_u0p16_PortIf1
      operation Oper
        arg SigPah_Arg: type=u0p16, direction=INOUT, server-argument-impl-policy=USE-ARGUMENT-TYPE
        arg LocnKey_Arg: type=uint16, direction=IN, server-argument-impl-policy=USE-ARGUMENT-TYPE
    FltInj1  # OBSOLETE
      operation Oper: possible-error=FltInj1/E_NOT_OK
        arg SigPah: type=Uls5, direction=INOUT, server-argument-impl-policy=USE-ARGUMENT-TYPE
        arg LocnKey: type=Cnt16, direction=IN, server-argument-impl-policy=USE-ARGUMENT-TYPE
      error E_NOT_OK: error-code=1
    FltInj2
      operation Oper
        arg SigPah_Arg: type=Uls5, direction=INOUT, server-argument-impl-policy=USE-ARGUMENT-TYPE
        arg LocnKey_Arg: type=Cnt16, direction=IN, server-argument-impl-policy=USE-ARGUMENT-TYPE
    FltInj3
      operation Oper
        arg SigPah_Arg: type=Uls24, direction=INOUT, server-argument-impl-policy=USE-ARGUMENT-TYPE
        arg LocnKey_Arg: type=Cnt16, direction=IN, server-argument-impl-policy=USE-ARGUMENT-TYPE
    FSnsrlsHwCentr_PortIf1
      operation Oper
    GetCalPageReq_PortIf1
      operation Oper
        4 x arg, all with type=uint8, server-argument-impl-policy=USE-ARGUMENT-TYPE:
          Seg_Arg: direction=IN
          Mod_Arg: direction=IN
          Page_Arg: direction=INOUT
          Rtn_Arg: direction=OUT
    GetCtrlPrm_PortIf1
      operation Oper
        7 x arg, all with type=float32, direction=OUT, server-argument-impl-policy=USE-ARGUMENT-TYPE:
          MotVelCtrlPropGain_Arg
          MotVelCtrlIntgtrGain_Arg
          MotVelCtrlDerivtvGain_Arg
          MotVelCtrlAntiWdupLim_Arg
          MotVelCtrlAntiWdupGain_Arg
          MotVelCtrlDerivtvLpFilTiCon_Arg
          MotVelCtrlTqCmdLim_Arg
    GetDiagcDataApplX_PortIf1
      operation Oper
        arg DiagcData_Arg: type=DiagcDataRec1, direction=OUT, server-argument-impl-policy=USE-ARGUMENT-TYPE
    GetFricLrngData_PortIf1
      operation Oper
        4 x arg, all with direction=OUT, server-argument-impl-policy=USE-ARGUMENT-TYPE:
          FricLrngEna_Arg: type=boolean
          FricLrngOffsOutpEna_Arg: type=boolean
          FricLrngOperMod_Arg: type=SysFricLrngOperMod1
          EolFric_Arg: type=float32
    GetFricOffsOutpDi_PortIf1
      operation Oper
        arg FricOffsOutpDi_Arg: type=boolean, direction=OUT, server-argument-impl-policy=USE-ARGUMENT-TYPE
    GetGmLoaIgnCntr_PortIf1
      operation Oper
        arg GmLoaIgnCntr_Arg: type=uint16, direction=OUT, server-argument-impl-policy=USE-ARGUMENT-TYPE
    GetGpio_PortIf1
      operation Oper: possible-error=GetGpio_PortIf1/E_NOT_OK
        arg PinSt_Arg: type=boolean, direction=OUT, server-argument-impl-policy=USE-ARGUMENT-TYPE
      error E_NOT_OK: error-code=1
    GetGpio1
      operation Oper: possible-error=GetGpio1/E_NOT_OK
        arg PinSt: type=Logl1, direction=OUT, server-argument-impl-policy=USE-ARGUMENT-TYPE
      error E_NOT_OK: error-code=1
    GetHwAgOffs_PortIf1
      operation Oper
        arg HwAgOffs_Arg: type=float32, direction=OUT, server-argument-impl-policy=USE-ARGUMENT-TYPE
        arg HwAgLrngStRst_Arg: type=boolean, direction=OUT, server-argument-impl-policy=USE-ARGUMENT-TYPE
    GetHwAgOverTrvlCnt_PortIf2
      operation Oper
        arg HwAgOverTrvlCnt_Arg: type=uint8, direction=OUT, server-argument-impl-policy=USE-ARGUMENT-TYPE
    GetHwAgTrimVal_PortIf1  # OBSELETE
      operation Oper
        arg HwAgTrimVal_Arg: type=float32, direction=OUT, server-argument-impl-policy=USE-ARGUMENT-TYPE
    GetHwAgTrimVal_PortIf2
      operation Oper
        arg HwAgTrimVal_Arg: type=float32, direction=OUT, server-argument-impl-policy=USE-ARGUMENT-TYPE
        arg HwAgTrimPrfmd_Arg: type=boolean, direction=OUT, server-argument-impl-policy=USE-ARGUMENT-TYPE
    GetHwTqOffs_PortIf1
      operation Oper
        arg HwTqOffs_Arg: type=float32, direction=OUT, server-argument-impl-policy=USE-ARGUMENT-TYPE
        arg HwTqLrngStRst_Arg: type=boolean, direction=OUT, server-argument-impl-policy=USE-ARGUMENT-TYPE
    GetMotAgMecl_PortIf1
      operation Oper
        arg MotAgMecl_Arg: type=u0p16, direction=OUT, server-argument-impl-policy=USE-ARGUMENT-TYPE
    GetMotCoggCmdPrm_PortIf1
      operation Oper
        arg MotCoggCmdY_Arg: type=Ary1D_s1p14_128, direction=OUT, server-argument-impl-policy=USE-ARGUMENT-TYPE
        arg Idx_Arg: type=uint8, direction=IN, server-argument-impl-policy=USE-ARGUMENT-TYPE
    GetMotPrmNomEol1  # OBSELETE
      operation Oper: possible-error=GetMotPrmNomEol1/E_NOT_OK
        arg MotKeNom: type=MotCon1, direction=OUT, server-argument-impl-policy=USE-ARGUMENT-TYPE
        arg MotRNom: type=R6, direction=OUT, server-argument-impl-policy=USE-ARGUMENT-TYPE
      error E_NOT_OK: error-code=1
    GetMotPrmNomEol2
      operation Oper: possible-error=GetMotPrmNomEol2/E_NOT_OK
        arg MotBackEmfConNom_Arg: type=MotCon1, direction=OUT, server-argument-impl-policy=USE-ARGUMENT-TYPE
        arg MotRNom_Arg: type=R6, direction=OUT, server-argument-impl-policy=USE-ARGUMENT-TYPE
      error E_NOT_OK: error-code=1
    GetMotRplCoggPrm_PortIf1
      operation Oper
        9 x arg, all with direction=OUT, server-argument-impl-policy=USE-ARGUMENT-TYPE:
          CoggOrder1_Arg: type=uint16
          CoggOrder1X_Arg: type=s1p14
          CoggOrder1Y_Arg: type=s1p14
          CoggOrder2_Arg: type=uint16
          CoggOrder2X_Arg: type=s1p14
          CoggOrder2Y_Arg: type=s1p14
          CoggOrder3_Arg: type=uint16
          CoggOrder3X_Arg: type=s1p14
          CoggOrder3Y_Arg: type=s1p14
    GetMotTqCmdSca_PortIf1
      operation Oper
        arg MotTqCmdSca_Arg: type=float32, direction=OUT, server-argument-impl-policy=USE-ARGUMENT-TYPE
    GetNtcActv_PortIf1
      operation Oper: possible-error=GetNtcActv_PortIf1/E_NOT_OK
        arg NtcNr_Arg: type=NtcNr1, direction=IN, server-argument-impl-policy=USE-ARGUMENT-TYPE
        arg NtcActv_Arg: type=boolean, direction=OUT, server-argument-impl-policy=USE-ARGUMENT-TYPE
      error E_NOT_OK: error-code=1
    GetNtcActv1
      operation Oper: possible-error=GetNtcActv1/E_NOT_OK
        arg NtcNr: type=NtcNr1, direction=IN, server-argument-impl-policy=USE-ARGUMENT-TYPE
        arg NtcActv: type=boolean, direction=OUT, server-argument-impl-policy=USE-ARGUMENT-TYPE
      error E_NOT_OK: error-code=1
    GetNtcActvCore_PortIf1
      operation Oper
        arg NtcNr_Arg: type=NtcNr1, direction=IN, server-argument-impl-policy=USE-ARGUMENT-TYPE
        arg NtcActv_Arg: type=boolean, direction=OUT, server-argument-impl-policy=USE-ARGUMENT-TYPE
    GetNtcDebCntrApplX_PortIf1
      operation Oper
        arg DebCntrIdx_Arg: type=uint8, direction=IN, server-argument-impl-policy=USE-ARGUMENT-TYPE
        arg DebCntr_Arg: type=sint16, direction=OUT, server-argument-impl-policy=USE-ARGUMENT-TYPE
    GetNtcInfoApplX_PortIf1
      operation Oper
        arg NtcInfo_Arg: type=uint32, direction=OUT, server-argument-impl-policy=USE-ARGUMENT-TYPE
    GetNtcInfoApplX_PortIf2
      operation Oper
        arg NtcInfoIdx_Arg: type=uint8, direction=IN, server-argument-impl-policy=USE-ARGUMENT-TYPE
        arg NtcInfo_Arg: type=NtcInfoRec4, direction=OUT, server-argument-impl-policy=USE-ARGUMENT-TYPE
    GetNtcQlfrSts_PortIf1
      operation Oper: possible-error=GetNtcQlfrSts_PortIf1/E_NOT_OK
        arg NtcNr_Arg: type=NtcNr1, direction=IN, server-argument-impl-policy=USE-ARGUMENT-TYPE
        arg NtcQlfr_Arg: type=SigQlfr1, direction=OUT, server-argument-impl-policy=USE-ARGUMENT-TYPE
      error E_NOT_OK: error-code=1
    GetNtcQlfrSts1
      operation Oper: possible-error=GetNtcQlfrSts1/E_NOT_OK
        arg NtcNr: type=NtcNr1, direction=IN, server-argument-impl-policy=USE-ARGUMENT-TYPE
        arg NtcQlfr: type=SigQlfr1, direction=OUT, server-argument-impl-policy=USE-ARGUMENT-TYPE
      error E_NOT_OK: error-code=1
    GetNtcQlfrStsCore_PortIf1
      operation Oper
        arg NtcNr_Arg: type=NtcNr1, direction=IN, server-argument-impl-policy=USE-ARGUMENT-TYPE
        arg NtcQlfr_Arg: type=SigQlfr1, direction=OUT, server-argument-impl-policy=USE-ARGUMENT-TYPE
    GetNtcSts_PortIf1
      operation Oper: possible-error=GetNtcSts_PortIf1/E_NOT_OK
        arg NtcNr_Arg: type=NtcNr1, direction=IN, server-argument-impl-policy=USE-ARGUMENT-TYPE
        arg NtcInfoSts_Arg: type=uint8, direction=OUT, server-argument-impl-policy=USE-ARGUMENT-TYPE
      error E_NOT_OK: error-code=1
    GetNtcSts1
      operation Oper: possible-error=GetNtcSts1/E_NOT_OK
        arg NtcNr: type=NtcNr1, direction=IN, server-argument-impl-policy=USE-ARGUMENT-TYPE
        arg NtcInfoSts: type=uint8, direction=OUT, server-argument-impl-policy=USE-ARGUMENT-TYPE
      error E_NOT_OK: error-code=1
    GetNtcStsCore_PortIf1
      operation Oper
        arg NtcNr_Arg: type=NtcNr1, direction=IN, server-argument-impl-policy=USE-ARGUMENT-TYPE
        arg NtcInfoSts_Arg: type=uint8, direction=OUT, server-argument-impl-policy=USE-ARGUMENT-TYPE
    GetPullCmpPrm_PortIf1
      operation Oper
        4 x arg, all with direction=OUT, server-argument-impl-policy=USE-ARGUMENT-TYPE:
          PullCmpCmdTot_Arg: type=float32
          PullCmpShoTerm_Arg: type=float32
          PullCmpLongTerm_Arg: type=float32
          LrngEnad_Arg: type=boolean
    GetRefTmr100MicroSec32bit_PortIf1
      operation Oper
        arg RefTmr_Arg: type=uint32, direction=OUT, server-argument-impl-policy=USE-ARGUMENT-TYPE
    GetRefTmr100MicroSec32bit1
      operation Oper
        arg RefTmr: type=uint32, direction=OUT, server-argument-impl-policy=USE-ARGUMENT-TYPE
    GetRefTmr1MicroSec32bit_PortIf1
      operation Oper
        arg RefTmr_Arg: type=uint32, direction=OUT, server-argument-impl-policy=USE-ARGUMENT-TYPE
    GetRefTmr1MicroSec32bit1
      operation Oper
        arg RefTmr: type=uint32, direction=OUT, server-argument-impl-policy=USE-ARGUMENT-TYPE
    GetSegInfoReq_PortIf1
      operation Oper: possible-error=GetSegInfoReq_PortIf1/E_NOT_OK
        6 x arg, all with type=uint8, server-argument-impl-policy=USE-ARGUMENT-TYPE:
          Mod_Arg: direction=IN
          Seg_Arg: direction=IN
          SegInfo_Arg: direction=IN
          MpgIdx_Arg: direction=IN
          Resp_Arg: direction=INOUT
          RespLen_Arg: direction=INOUT
      error E_NOT_OK: error-code=1
    GetSegInfoReq_PortIf2
      operation Oper
        7 x arg, all with server-argument-impl-policy=USE-ARGUMENT-TYPE:
          Mod_Arg: type=GetSegMod1, direction=IN
          Seg_Arg: type=uint8, direction=IN
          SegInfo_Arg: type=uint8, direction=IN
          MpgIdx_Arg: type=uint8, direction=IN
          Resp_Arg: type=uint8, direction=INOUT
          RespLen_Arg: type=uint8, direction=INOUT
          Rtn_Arg: type=uint8, direction=OUT
    GetSigImcData_f32_PortIf1
      operation Oper: possible-error=GetSigImcData_f32_PortIf1/E_NOT_OK
        arg SigId_Arg: type=uint16, direction=IN, server-argument-impl-policy=USE-ARGUMENT-TYPE
        arg Data_Arg: type=float32, direction=OUT, server-argument-impl-policy=USE-ARGUMENT-TYPE
        arg Sts_Arg: type=ImcArbnRxSts1, direction=OUT, server-argument-impl-policy=USE-ARGUMENT-TYPE
      error E_NOT_OK: error-code=1
    GetSigImcData_logl_PortIf1
      operation Oper: possible-error=GetSigImcData_logl_PortIf1/E_NOT_OK
        arg SigId_Arg: type=uint16, direction=IN, server-argument-impl-policy=USE-ARGUMENT-TYPE
        arg Data_Arg: type=boolean, direction=OUT, server-argument-impl-policy=USE-ARGUMENT-TYPE
        arg Sts_Arg: type=ImcArbnRxSts1, direction=OUT, server-argument-impl-policy=USE-ARGUMENT-TYPE
      error E_NOT_OK: error-code=1
    GetSigImcData_s08_PortIf1
      operation Oper: possible-error=GetSigImcData_s08_PortIf1/E_NOT_OK
        arg SigId_Arg: type=uint16, direction=IN, server-argument-impl-policy=USE-ARGUMENT-TYPE
        arg Data_Arg: type=sint8, direction=OUT, server-argument-impl-policy=USE-ARGUMENT-TYPE
        arg Sts_Arg: type=ImcArbnRxSts1, direction=OUT, server-argument-impl-policy=USE-ARGUMENT-TYPE
      error E_NOT_OK: error-code=1
    GetSigImcData_s16_PortIf1
      operation Oper: possible-error=GetSigImcData_s16_PortIf1/E_NOT_OK
        arg SigId_Arg: type=uint16, direction=IN, server-argument-impl-policy=USE-ARGUMENT-TYPE
        arg Data_Arg: type=sint16, direction=OUT, server-argument-impl-policy=USE-ARGUMENT-TYPE
        arg Sts_Arg: type=ImcArbnRxSts1, direction=OUT, server-argument-impl-policy=USE-ARGUMENT-TYPE
      error E_NOT_OK: error-code=1
    GetSigImcData_s32_PortIf1
      operation Oper: possible-error=GetSigImcData_s32_PortIf1/E_NOT_OK
        arg SigId_Arg: type=uint16, direction=IN, server-argument-impl-policy=USE-ARGUMENT-TYPE
        arg Data_Arg: type=sint32, direction=OUT, server-argument-impl-policy=USE-ARGUMENT-TYPE
        arg Sts_Arg: type=ImcArbnRxSts1, direction=OUT, server-argument-impl-policy=USE-ARGUMENT-TYPE
      error E_NOT_OK: error-code=1
    GetSigImcData_u08_PortIf1
      operation Oper: possible-error=GetSigImcData_u08_PortIf1/E_NOT_OK
        arg SigId_Arg: type=uint16, direction=IN, server-argument-impl-policy=USE-ARGUMENT-TYPE
        arg Data_Arg: type=uint8, direction=OUT, server-argument-impl-policy=USE-ARGUMENT-TYPE
        arg Sts_Arg: type=ImcArbnRxSts1, direction=OUT, server-argument-impl-policy=USE-ARGUMENT-TYPE
      error E_NOT_OK: error-code=1
    GetSigImcData_u16_PortIf1
      operation Oper: possible-error=GetSigImcData_u16_PortIf1/E_NOT_OK
        arg SigId_Arg: type=uint16, direction=IN, server-argument-impl-policy=USE-ARGUMENT-TYPE
        arg Data_Arg: type=uint16, direction=OUT, server-argument-impl-policy=USE-ARGUMENT-TYPE
        arg Sts_Arg: type=ImcArbnRxSts1, direction=OUT, server-argument-impl-policy=USE-ARGUMENT-TYPE
      error E_NOT_OK: error-code=1
    GetSigImcData_u32_PortIf1
      operation Oper: possible-error=GetSigImcData_u32_PortIf1/E_NOT_OK
        arg SigId_Arg: type=uint16, direction=IN, server-argument-impl-policy=USE-ARGUMENT-TYPE
        arg Data_Arg: type=uint32, direction=OUT, server-argument-impl-policy=USE-ARGUMENT-TYPE
        arg Sts_Arg: type=ImcArbnRxSts1, direction=OUT, server-argument-impl-policy=USE-ARGUMENT-TYPE
      error E_NOT_OK: error-code=1
    GetSigImcDataExtdSts_f32_PortIf1
      operation Oper: possible-error=GetSigImcDataExtdSts_f32_PortIf1/E_NOT_OK
        4 x arg, all with server-argument-impl-policy=USE-ARGUMENT-TYPE:
          SigId_Arg: type=uint16, direction=IN
          Data_Arg: type=float32, direction=OUT
          Sts_Arg: type=ImcArbnRxExtdSts1, direction=OUT
          DataSrc_Arg: type=ImcArbnRxDataSrc1, direction=OUT
      error E_NOT_OK: error-code=1
    GetSigImcDataExtdSts_logl_PortIf1
      operation Oper: possible-error=GetSigImcDataExtdSts_logl_PortIf1/E_NOT_OK
        4 x arg, all with server-argument-impl-policy=USE-ARGUMENT-TYPE:
          SigId_Arg: type=uint16, direction=IN
          Data_Arg: type=boolean, direction=OUT
          Sts_Arg: type=ImcArbnRxExtdSts1, direction=OUT
          DataSrc_Arg: type=ImcArbnRxDataSrc1, direction=OUT
      error E_NOT_OK: error-code=1
    GetSigImcDataExtdSts_s08_PortIf1
      operation Oper: possible-error=GetSigImcDataExtdSts_s08_PortIf1/E_NOT_OK
        4 x arg, all with server-argument-impl-policy=USE-ARGUMENT-TYPE:
          SigId_Arg: type=uint16, direction=IN
          Data_Arg: type=sint8, direction=OUT
          Sts_Arg: type=ImcArbnRxExtdSts1, direction=OUT
          DataSrc_Arg: type=ImcArbnRxDataSrc1, direction=OUT
      error E_NOT_OK: error-code=1
    GetSigImcDataExtdSts_s16_PortIf1
      operation Oper: possible-error=GetSigImcDataExtdSts_s16_PortIf1/E_NOT_OK
        4 x arg, all with server-argument-impl-policy=USE-ARGUMENT-TYPE:
          SigId_Arg: type=uint16, direction=IN
          Data_Arg: type=sint16, direction=OUT
          Sts_Arg: type=ImcArbnRxExtdSts1, direction=OUT
          DataSrc_Arg: type=ImcArbnRxDataSrc1, direction=OUT
      error E_NOT_OK: error-code=1
    GetSigImcDataExtdSts_s32_PortIf1
      operation Oper: possible-error=GetSigImcDataExtdSts_s32_PortIf1/E_NOT_OK
        4 x arg, all with server-argument-impl-policy=USE-ARGUMENT-TYPE:
          SigId_Arg: type=uint16, direction=IN
          Data_Arg: type=sint32, direction=OUT
          Sts_Arg: type=ImcArbnRxExtdSts1, direction=OUT
          DataSrc_Arg: type=ImcArbnRxDataSrc1, direction=OUT
      error E_NOT_OK: error-code=1
    GetSigImcDataExtdSts_u08_PortIf1
      operation Oper: possible-error=GetSigImcDataExtdSts_u08_PortIf1/E_NOT_OK
        4 x arg, all with server-argument-impl-policy=USE-ARGUMENT-TYPE:
          SigId_Arg: type=uint16, direction=IN
          Data_Arg: type=uint8, direction=OUT
          Sts_Arg: type=ImcArbnRxExtdSts1, direction=OUT
          DataSrc_Arg: type=ImcArbnRxDataSrc1, direction=OUT
      error E_NOT_OK: error-code=1
    GetSigImcDataExtdSts_u16_PortIf1
      operation Oper: possible-error=GetSigImcDataExtdSts_u16_PortIf1/E_NOT_OK
        4 x arg, all with server-argument-impl-policy=USE-ARGUMENT-TYPE:
          SigId_Arg: type=uint16, direction=IN
          Data_Arg: type=uint16, direction=OUT
          Sts_Arg: type=ImcArbnRxExtdSts1, direction=OUT
          DataSrc_Arg: type=ImcArbnRxDataSrc1, direction=OUT
      error E_NOT_OK: error-code=1
    GetSigImcDataExtdSts_u32_PortIf1
      operation Oper: possible-error=GetSigImcDataExtdSts_u32_PortIf1/E_NOT_OK
        4 x arg, all with server-argument-impl-policy=USE-ARGUMENT-TYPE:
          SigId_Arg: type=uint16, direction=IN
          Data_Arg: type=uint32, direction=OUT
          Sts_Arg: type=ImcArbnRxExtdSts1, direction=OUT
          DataSrc_Arg: type=ImcArbnRxDataSrc1, direction=OUT
      error E_NOT_OK: error-code=1
    GetSigStcHlthData_PortIf1
      operation Oper: possible-error=GetSigStcHlthData_PortIf1/E_NOT_OK
        arg SigId_Arg: type=StHlthMonSig1, direction=IN, server-argument-impl-policy=USE-ARGUMENT-TYPE
        arg BufPtr_Arg: type=uint32, direction=OUT, server-argument-impl-policy=USE-ARGUMENT-TYPE
      error E_NOT_OK: error-code=1
    GetSigStcHlthData_PortIf2
      operation Oper: possible-error=GetSigStcHlthData_PortIf2/E_NOT_OK
        arg SigId_Arg: type=StHlthMonSig2, direction=IN, server-argument-impl-policy=USE-ARGUMENT-TYPE
        arg BufPtr_Arg: type=uint32, direction=OUT, server-argument-impl-policy=USE-ARGUMENT-TYPE
      error E_NOT_OK: error-code=1
    GetSigStcHlthData_PortIf3
      operation Oper: possible-error=GetSigStcHlthData_PortIf3/E_NOT_OK
        arg SigId_Arg: type=StHlthMonSig3, direction=IN, server-argument-impl-policy=USE-ARGUMENT-TYPE
        arg BufPtr_Arg: type=uint32, direction=OUT, server-argument-impl-policy=USE-ARGUMENT-TYPE
      error E_NOT_OK: error-code=1
    GetTiSpan100MicroSec32bit_PortIf1
      operation Oper
        arg RefTmr_Arg: type=uint32, direction=IN, server-argument-impl-policy=USE-ARGUMENT-TYPE
        arg TiSpan_Arg: type=uint32, direction=OUT, server-argument-impl-policy=USE-ARGUMENT-TYPE
    GetTiSpan100MicroSec32bit1
      operation Oper
        arg RefTmr: type=uint32, direction=IN, server-argument-impl-policy=USE-ARGUMENT-TYPE
        arg TiSpan: type=uint32, direction=OUT, server-argument-impl-policy=USE-ARGUMENT-TYPE
    GetTiSpan1MicroSec32bit_PortIf1
      operation Oper
        arg RefTmr_Arg: type=uint32, direction=IN, server-argument-impl-policy=USE-ARGUMENT-TYPE
        arg TiSpan_Arg: type=uint32, direction=OUT, server-argument-impl-policy=USE-ARGUMENT-TYPE
    GetTiSpan1MicroSec32bit1
      operation Oper
        arg RefTmr: type=uint32, direction=IN, server-argument-impl-policy=USE-ARGUMENT-TYPE
        arg TiSpan: type=uint32, direction=OUT, server-argument-impl-policy=USE-ARGUMENT-TYPE
    GetTxRateGroup_PortIf1
      operation Oper: possible-error=GetTxRateGroup_PortIf1/E_NOT_OK
        arg RateGroup_Arg: type=uint8, direction=IN, server-argument-impl-policy=USE-ARGUMENT-TYPE
        arg Buf_Arg: type=uint8, direction=OUT, server-argument-impl-policy=USE-ARGUMENT-TYPE
      error E_NOT_OK: error-code=1
    GetTxSigGroup_PortIf1
      operation Oper: possible-error=GetTxSigGroup_PortIf1/E_NOT_OK
        arg SigGroupId_Arg: type=uint8, direction=IN, server-argument-impl-policy=USE-ARGUMENT-TYPE
        arg Buf_Arg: type=uint8, direction=OUT, server-argument-impl-policy=USE-ARGUMENT-TYPE
      error E_NOT_OK: error-code=1
    GetYawRateOffs_PortIf1
      operation Oper
        arg VehYawRateOffs_Arg: type=float32, direction=OUT, server-argument-impl-policy=USE-ARGUMENT-TYPE
        arg VehYawRateLrngStRst_Arg: type=boolean, direction=OUT, server-argument-impl-policy=USE-ARGUMENT-TYPE
    GmDid_PortIf1
      operation Oper
        arg Data_arg: type=uint8, direction=OUT, server-argument-impl-policy=USE-ARGUMENT-TYPE
    GmDid_PortIf1_01: is-service=true
      operation Oper
        arg DataBuf_Arg: type=uint8, direction=OUT, server-argument-impl-policy=USE-ARGUMENT-TYPE
    GmDid_PortIf1_02: is-service=true
      operation Oper
        arg DataBuf_Arg: type=uint8, direction=OUT, server-argument-impl-policy=USE-ARGUMENT-TYPE
    GmDid_PortIf1_03: is-service=true
      operation Oper
        arg DataBuf_Arg: type=uint8, direction=OUT, server-argument-impl-policy=USE-ARGUMENT-TYPE
    GmDid_PortIf1_04: is-service=true
      operation Oper
        arg DataBuf_Arg: type=uint8, direction=OUT, server-argument-impl-policy=USE-ARGUMENT-TYPE
    GmDid_PortIf1_05: is-service=true
      operation Oper
        arg DataBuf_Arg: type=uint8, direction=OUT, server-argument-impl-policy=USE-ARGUMENT-TYPE
    GmDid_PortIf1_06: is-service=true
      operation Oper
        arg DataBuf_Arg: type=uint8, direction=OUT, server-argument-impl-policy=USE-ARGUMENT-TYPE
    GmDid_PortIf1_07: is-service=true
      operation Oper
        arg DataBuf_Arg: type=uint8, direction=OUT, server-argument-impl-policy=USE-ARGUMENT-TYPE
    GmDid_PortIf1_08: is-service=true
      operation Oper
        arg DataBuf_Arg: type=uint8, direction=OUT, server-argument-impl-policy=USE-ARGUMENT-TYPE
    GmDid_PortIf1_09: is-service=true
      operation Oper
        arg DataBuf_Arg: type=uint8, direction=OUT, server-argument-impl-policy=USE-ARGUMENT-TYPE
    GmDid_PortIf1_10: is-service=true
      operation Oper
        arg DataBuf_Arg: type=uint8, direction=OUT, server-argument-impl-policy=USE-ARGUMENT-TYPE
    GmDid_PortIf1_11: is-service=true
      operation Oper
        arg DataBuf_Arg: type=uint8, direction=OUT, server-argument-impl-policy=USE-ARGUMENT-TYPE
    GmDid_PortIf1_12: is-service=true
      operation Oper
        arg DataBuf_Arg: type=uint8, direction=OUT, server-argument-impl-policy=USE-ARGUMENT-TYPE
    GmDid_PortIf1_13: is-service=true
      operation Oper
        arg DataBuf_Arg: type=uint8, direction=OUT, server-argument-impl-policy=USE-ARGUMENT-TYPE
    GmDid_PortIf1_14: is-service=true
      operation Oper
        arg DataBuf_Arg: type=uint8, direction=OUT, server-argument-impl-policy=USE-ARGUMENT-TYPE
    GmDid_PortIf1_15: is-service=true
      operation Oper
        arg DataBuf_Arg: type=uint8, direction=OUT, server-argument-impl-policy=USE-ARGUMENT-TYPE
    GmDid_PortIf1_16: is-service=true
      operation Oper
        arg DataBuf_Arg: type=uint8, direction=OUT, server-argument-impl-policy=USE-ARGUMENT-TYPE
    GmDid_PortIf1_17: is-service=true
      operation Oper
        arg DataBuf_Arg: type=uint8, direction=OUT, server-argument-impl-policy=USE-ARGUMENT-TYPE
    GmDid_PortIf1_18: is-service=true
      operation Oper
        arg DataBuf_Arg: type=uint8, direction=OUT, server-argument-impl-policy=USE-ARGUMENT-TYPE
    GmFctDiReq_PortIf1
      operation Oper
    HwAg0MeasHwAg0AutoTrim1  # OBSOLETE
      operation Oper
    HwAg0MeasHwAg0ClrTrim1  # OBSOLETE
      operation Oper
    HwAg0MeasHwAg0ReadTrim1  # OBSELETE
      operation Oper
        arg HwAg0MeasHwAg0WrOffsTrimData: type=Ag19, direction=IN, server-argument-impl-policy=USE-ARGUMENT-TYPE
    HwAg0MeasHwAg0ReadTrim2  # OBSOLETE
      operation Oper
        arg HwAg0MeasHwAg0WrOffsTrimData: type=Ag19, direction=OUT, server-argument-impl-policy=USE-ARGUMENT-TYPE
    HwAg0MeasHwAg0TrimPrfmdSts1  # OBSELETE
      operation Oper
        arg HwAg0MeasHwAg0OffsTrimPrfmdStsData: type=Logl1, direction=IN, server-argument-impl-policy=USE-ARGUMENT-TYPE
    HwAg0MeasHwAg0TrimPrfmdSts2  # OBSOLETE
      operation Oper
        arg HwAg0MeasHwAg0OffsTrimPrfmdStsData: type=Logl1, direction=OUT, server-argument-impl-policy=USE-ARGUMENT-TYPE
    HwAg0MeasHwAg0WrTrim1  # OBSELETE
      operation Oper
    HwAg0MeasHwAg0WrTrim2  # OBSOLETE
      operation Oper
        arg HwAg0MeasHwAg0WrTrimData: type=Ag19, direction=IN, server-argument-impl-policy=USE-ARGUMENT-TYPE
    HwAg1MeasHwAg1AutoTrim1  # OBSOLETE
      operation Oper
    HwAg1MeasHwAg1ClrTrim1  # OBSOLETE
      operation Oper
    HwAg1MeasHwAg1ReadTrim1  # OBSELETE
      operation Oper
        arg HwAg1MeasHwAg1WrOffsTrimData: type=Ag19, direction=IN, server-argument-impl-policy=USE-ARGUMENT-TYPE
    HwAg1MeasHwAg1ReadTrim2  # OBSOLETE
      operation Oper
        arg HwAg1MeasHwAg1WrOffsTrimData: type=Ag19, direction=OUT, server-argument-impl-policy=USE-ARGUMENT-TYPE
    HwAg1MeasHwAg1TrimPrfmdSts1  # OBSELETE
      operation Oper
        arg HwAg1MeasHwAg1OffsTrimPrfmdStsData: type=Logl1, direction=IN, server-argument-impl-policy=USE-ARGUMENT-TYPE
    HwAg1MeasHwAg1TrimPrfmdSts2  # OBSOLETE
      operation Oper
        arg HwAg1MeasHwAg1OffsTrimPrfmdStsData: type=Logl1, direction=OUT, server-argument-impl-policy=USE-ARGUMENT-TYPE
    HwAg1MeasHwAg1WrTrim1  # OBSELETE
      operation Oper
    HwAg1MeasHwAg1WrTrim2  # OBSOLETE
      operation Oper
        arg HwAg1MeasHwAg1WrTrimData: type=Ag19, direction=IN, server-argument-impl-policy=USE-ARGUMENT-TYPE
    HwAgMeasHwAgAutTrim1
      operation Oper
    HwAgMeasHwAgClrTrim1
      operation Oper
    HwAgMeasHwAgReadTrim1
      operation Oper
        arg HwAgReadTrimData_Arg: type=Ag19, direction=OUT, server-argument-impl-policy=USE-ARGUMENT-TYPE
    HwAgMeasHwAgTrimPrfmdSts1
      operation Oper
        arg HwAgOffsTrimPrfmdStsData_Arg: type=Logl1, direction=OUT, server-argument-impl-policy=USE-ARGUMENT-TYPE
    HwAgMeasHwAgWrTrim1
      operation Oper
        arg HwAgWrOffsTrimData_Arg: type=Ag19, direction=IN, server-argument-impl-policy=USE-ARGUMENT-TYPE
    HwTq0MeasHwTq0AutTrim_PortIf1  # OBSOLETE
      operation Oper
    HwTq0MeasHwTq0ClrTrim_PortIf1  # OBSOLETE
      operation Oper
    HwTq0MeasHwTq0ReadTrim_PortIf1  # OBSOLETE
      operation Oper
        arg HwTq0MeasHwTq0ReadTrimData_Arg: type=float32, direction=OUT, server-argument-impl-policy=USE-ARGUMENT-TYPE
    HwTq0MeasHwTq0TrimPrfmdSts_PortIf1  # OBSOLETE
      operation Oper
        arg HwTq0MeasHwTq0OffsTrimPrfmdStsData_Arg: type=boolean, direction=OUT, server-argument-impl-policy=USE-ARGUMENT-TYPE
    HwTq0MeasHwTq0WrTrim_PortIf1  # OBSOLETE
      operation Oper
        arg HwTq0MeasHwTq0WrOffsTrimData_Arg: type=float32, direction=IN, server-argument-impl-policy=USE-ARGUMENT-TYPE
    HwTq1MeasHwTq1AutTrim_PortIf1  # OBSOLETE
      operation Oper
    HwTq1MeasHwTq1ClrTrim_PortIf1  # OBSOLETE
      operation Oper
    HwTq1MeasHwTq1ReadTrim_PortIf1  # OBSOLETE
      operation Oper
        arg HwTq1MeasHwTq1ReadTrimData_Arg: type=float32, direction=OUT, server-argument-impl-policy=USE-ARGUMENT-TYPE
    HwTq1MeasHwTq1TrimPrfmdSts_PortIf1  # OBSOLETE
      operation Oper
        arg HwTq1MeasHwTq1OffsTrimPrfmdStsData_Arg: type=boolean, direction=OUT, server-argument-impl-policy=USE-ARGUMENT-TYPE
    HwTq1MeasHwTq1WrTrim_PortIf1  # OBSOLETE
      operation Oper
        arg HwTq1MeasHwTq1WrOffsTrimData_Arg: type=float32, direction=IN, server-argument-impl-policy=USE-ARGUMENT-TYPE
    HwTq2MeasHwTq2AutTrim_PortIf1  # OBSOLETE
      operation Oper
    HwTq2MeasHwTq2ClrTrim_PortIf1  # OBSOLETE
      operation Oper
    HwTq2MeasHwTq2ReadTrim_PortIf1  # OBSOLETE
      operation Oper
        arg HwTq2MeasHwTq2ReadTrimData_Arg: type=float32, direction=OUT, server-argument-impl-policy=USE-ARGUMENT-TYPE
    HwTq2MeasHwTq2TrimPrfmdSts_PortIf1  # OBSOLETE
      operation Oper
        arg HwTq2MeasHwTq2OffsTrimPrfmdStsData_Arg: type=boolean, direction=OUT, server-argument-impl-policy=USE-ARGUMENT-TYPE
    HwTq2MeasHwTq2WrTrim_PortIf1  # OBSOLETE
      operation Oper
        arg HwTq2MeasHwTq2WrOffsTrimData_Arg: type=float32, direction=IN, server-argument-impl-policy=USE-ARGUMENT-TYPE
    HwTq3MeasHwTq3AutTrim_PortIf1  # OBSOLETE
      operation Oper
    HwTq3MeasHwTq3ClrTrim_PortIf1  # OBSOLETE
      operation Oper
    HwTq3MeasHwTq3ReadTrim_PortIf1  # OBSOLETE
      operation Oper
        arg HwTq3MeasHwTq3ReadTrimData_Arg: type=float32, direction=OUT, server-argument-impl-policy=USE-ARGUMENT-TYPE
    HwTq3MeasHwTq3TrimPrfmdSts_PortIf1  # OBSOLETE
      operation Oper
        arg HwTq3MeasHwTq3OffsTrimPrfmdStsData_Arg: type=boolean, direction=OUT, server-argument-impl-policy=USE-ARGUMENT-TYPE
    HwTq3MeasHwTq3WrTrim_PortIf1  # OBSOLETE
      operation Oper
        arg HwTq3MeasHwTq3WrOffsTrimData_Arg: type=float32, direction=IN, server-argument-impl-policy=USE-ARGUMENT-TYPE
    HwTqClrSnsrSca_PortIf1
      operation Oper
    HwTqMeasHwTqAutTrim_PortIf1
      operation Oper
    HwTqMeasHwTqClrTrim_PortIf1
      operation Oper
    HwTqMeasHwTqReadTrim_PortIf1
      operation Oper
        arg HwTqReadTrimData_Arg: type=float32, direction=OUT, server-argument-impl-policy=USE-ARGUMENT-TYPE
    HwTqMeasHwTqTrimPrfmdSts_PortIf1
      operation Oper
        arg HwTqOffsTrimPrfmdStsData_Arg: type=boolean, direction=OUT, server-argument-impl-policy=USE-ARGUMENT-TYPE
    HwTqMeasHwTqWrTrim_PortIf1
      operation Oper
        arg HwTqWrOffsTrimData_Arg: type=float32, direction=IN, server-argument-impl-policy=USE-ARGUMENT-TYPE
    HwTqReadSnsrSca_PortIf1  # OBSELETE
      operation Oper
        arg HwTqReadScaData_Arg: type=float32, direction=OUT, server-argument-impl-policy=USE-ARGUMENT-TYPE
        arg HwTqScaPrfmdStsData_Arg: type=boolean, direction=OUT, server-argument-impl-policy=USE-ARGUMENT-TYPE
    HwTqReadSnsrSca_PortIf2
      operation Oper
        arg HwTqReadScaData_Arg: type=float32, direction=OUT, server-argument-impl-policy=USE-ARGUMENT-TYPE
    HwTqSetSnsrSca_PortIf1  # OBSELETE
      operation Oper
        arg HwTqScaVal_Arg: type=float32, direction=IN, server-argument-impl-policy=USE-ARGUMENT-TYPE
    HwTqSnsrScaPrfmdSts_PortIf1
      operation Oper
        arg HwTqScaPrfmdStsData_Arg: type=boolean, direction=OUT, server-argument-impl-policy=USE-ARGUMENT-TYPE
    HwTqWrSnsrSca_PortIf1
      operation Oper
        arg HwTqScaVal_Arg: type=float32, direction=IN, server-argument-impl-policy=USE-ARGUMENT-TYPE
    InitFricLrngTbl_PortIf1
      operation Oper
    MeasTrgStrt_PortIf1  # OBSELETE
      operation Oper
    MeasTrigStrt_PortIf1
      operation Oper
    MotAg0MeasMotAg0CorrnTblClr1  # OBSELETE
      operation Oper
    MotAg0MeasMotAg0CorrnTblRead1  # OBSELETE
      operation Oper
        arg MotAg0MeasMotAg0CorrnTblCrc: type=Cnt16, direction=OUT, server-argument-impl-policy=USE-ARGUMENT-TYPE
    MotAg0MeasMotAg0CorrnTblSegRead1  # OBSELETE
      operation Oper
        arg MotAg0MeasMotAg0CorrnTblSegReadData: type=CntAry1D3, direction=OUT, server-argument-impl-policy=USE-ARGUMENT-TYPE
        arg MotAg0MeasMotAg0CorrnTblSegRead: type=Cnt13, direction=IN, server-argument-impl-policy=USE-ARGUMENT-TYPE
    MotAg0MeasMotAg0CorrnTblSegUpd1  # OBSELETE
      operation Oper
        arg MotAg0MeasMotAg0CorrnTblSegWrData: type=CntAry1D3, direction=IN, server-argument-impl-policy=USE-ARGUMENT-TYPE
        arg MotAg0MeasMotAg0CorrnTblSegWr: type=Cnt13, direction=IN, server-argument-impl-policy=USE-ARGUMENT-TYPE
        arg MotAg0MeasMotAg0CorrnTblSegUpdResp: type=Cnt25, direction=OUT, server-argument-impl-policy=USE-ARGUMENT-TYPE
    MotAg0MeasMotAg0CorrnTblWr1  # OBSELETE
      operation Oper
        arg MotAg0MeasMotAg0CorrnTblCrc: type=Cnt16, direction=IN, server-argument-impl-policy=USE-ARGUMENT-TYPE
        arg MotAg0MeasMotAg0CorrnTblWrResp: type=Cnt25, direction=OUT, server-argument-impl-policy=USE-ARGUMENT-TYPE
    MotAg0SnsrCfgDmaStrt_PortIf1  # OBSELETE
      operation Oper
      error E_NOT_OK: error-code=1
    MotAg0SnsrCfgDmaStrt_PortIf2
      operation Oper: possible-error=MotAg0SnsrCfgDmaStrt_PortIf2/E_NOT_OK
      error E_NOT_OK: error-code=1
    MotAg1MeasMotAg1CorrnTblClr1  # OBSELETE
      operation Oper
    MotAg1MeasMotAg1CorrnTblRead1  # OBSELETE
      operation Oper
        arg MotAg1MeasMotAg1CorrnTblCrc: type=Cnt16, direction=OUT, server-argument-impl-policy=USE-ARGUMENT-TYPE
    MotAg1MeasMotAg1CorrnTblSegRead1  # OBSELETE
      operation Oper
        arg MotAg1MeasMotAg1CorrnTblSegReadData: type=CntAry1D3, direction=OUT, server-argument-impl-policy=USE-ARGUMENT-TYPE
        arg MotAg1MeasMotAg1CorrnTblSegRead: type=Cnt13, direction=IN, server-argument-impl-policy=USE-ARGUMENT-TYPE
    MotAg1MeasMotAg1CorrnTblSegUpd1  # OBSELETE
      operation Oper
        arg MotAg1MeasMotAg1CorrnTblSegWrData: type=CntAry1D3, direction=IN, server-argument-impl-policy=USE-ARGUMENT-TYPE
        arg MotAg1MeasMotAg1CorrnTblSegWr: type=Cnt13, direction=IN, server-argument-impl-policy=USE-ARGUMENT-TYPE
        arg MotAg1MeasMotAg1CorrnTblSegUpdResp: type=Cnt25, direction=OUT, server-argument-impl-policy=USE-ARGUMENT-TYPE
    MotAg1MeasMotAg1CorrnTblWr1  # OBSELETE
      operation Oper
        arg MotAg1MeasMotAg1CorrnTblCrc: type=Cnt16, direction=IN, server-argument-impl-policy=USE-ARGUMENT-TYPE
        arg MotAg1MeasMotAg1CorrnTblWrResp: type=Cnt25, direction=OUT, server-argument-impl-policy=USE-ARGUMENT-TYPE
    MotAgCmpBackEmfRead1  # OBSELETE
      operation Oper: possible-error=MotAgCmpBackEmfRead1/E_NOT_OK
        arg MotAgBackEmfRead: type=Ag9, direction=OUT, server-argument-impl-policy=USE-ARGUMENT-TYPE
      error E_NOT_OK: error-code=1
    MotAgCmpBackEmfRead2  # OBSELETE
      operation Oper
        arg MotAgBackEmfRead: type=Ag9, direction=OUT, server-argument-impl-policy=USE-ARGUMENT-TYPE
    MotAgCmpBackEmfWr1
      operation Oper: possible-error=MotAgCmpBackEmfWr1/E_NOT_OK
        arg MotAgCmpBackEmfWrData: type=Ag9, direction=IN, server-argument-impl-policy=USE-ARGUMENT-TYPE
      error E_NOT_OK: error-code=1
    MotAgMeasEolPrmRead_PortIf1
      operation Oper
        arg MotAgEolPrmReadCrc_Arg: type=uint16, direction=OUT, server-argument-impl-policy=USE-ARGUMENT-TYPE
        arg MotAgEolPrmRead_Arg: type=MotAgMeasEolPrmRec1, direction=OUT, server-argument-impl-policy=USE-ARGUMENT-TYPE
    MotAgMeasEolPrmRead_PortIf2
      operation Oper
        arg MotAgEolPrmRead_Arg: type=MotAgMeasEolPrmRec1, direction=OUT, server-argument-impl-policy=USE-ARGUMENT-TYPE
    MotAgMeasEolPrmWr_PortIf1
      operation Oper
        arg MotAgSinCosEolCalData_Arg: type=MotAgMeasEolPrmRec1, direction=IN, server-argument-impl-policy=USE-ARGUMENT-TYPE
        arg MotAgSinCosEolCalDataCrc_Arg: type=uint16, direction=IN, server-argument-impl-policy=USE-ARGUMENT-TYPE
        arg MotAgSinCosWrResp_Arg: type=uint8, direction=OUT, server-argument-impl-policy=USE-ARGUMENT-TYPE
    MotAgMeasEolPrmWr_PortIf2
      operation Oper
        arg MotAgSinCosEolCalData_Arg: type=MotAgMeasEolPrmRec1, direction=IN, server-argument-impl-policy=USE-ARGUMENT-TYPE
    MotAgMeasMotAgCoeffTblRead_PortIf1
      operation Oper
        arg MotAgCoeffTbl_Arg: type=Ary1D_f32_26, direction=OUT, server-argument-impl-policy=USE-ARGUMENT-TYPE
    MotAgMeasMotAgCoeffTblWr_PortIf1
      operation Oper
        arg MotAgCoeffTbl_Arg: type=Ary1D_f32_26, direction=IN, server-argument-impl-policy=USE-ARGUMENT-TYPE
    MsgTxCallBack_PortIf1
      operation Oper
    NxtrCalIdsCalDevlpRd_PortIf1
      operation Oper: possible-error=NxtrCalIdsCalDevlpRd_PortIf1/E_NOT_OK
        5 x arg, all with server-argument-impl-policy=USE-ARGUMENT-TYPE:
          CalRegn: type=uint8, direction=IN
          CalAuthor: type=Ary1D_u8_6, direction=OUT
          CalVers: type=uint8, direction=OUT
          CalTiStamp: type=uint32, direction=OUT
          CalDescr: type=Ary1D_u8_48, direction=OUT
      error E_NOT_OK: error-code=1
    NxtrCalIdsCalRelRd_PortIf1
      operation Oper
        arg CalRegn: type=uint8, direction=IN, server-argument-impl-policy=USE-ARGUMENT-TYPE
        arg RelNr: type=uint32, direction=OUT, server-argument-impl-policy=USE-ARGUMENT-TYPE
        arg RelSt: type=uint8, direction=OUT, server-argument-impl-policy=USE-ARGUMENT-TYPE
    NxtrSwIdsPsrInfoRd_PortIf1
      operation Oper: possible-error=NxtrSwIdsPsrInfoRd_PortIf1/E_NOT_OK
        arg PsrId: type=uint32, direction=OUT, server-argument-impl-policy=USE-ARGUMENT-TYPE
        arg PsrRev: type=uint8, direction=OUT, server-argument-impl-policy=USE-ARGUMENT-TYPE
      error E_NOT_OK: error-code=1
    NxtrSwIdsSwBuildDateTiRd_PortIf1
      operation Oper
        arg SwBuildDateTi: type=Ary1D_u8_20, direction=OUT, server-argument-impl-policy=USE-ARGUMENT-TYPE
    NxtrSwIdsSwRelInfoRd_PortIf1
      operation Oper
        arg SwOrigin: type=uint8, direction=OUT, server-argument-impl-policy=USE-ARGUMENT-TYPE
        arg SwAuthor: type=Ary1D_u8_6, direction=OUT, server-argument-impl-policy=USE-ARGUMENT-TYPE
    NxtrSwIdsSwRelNrRd_PortIf1
      operation Oper
        arg SwRelNr: type=Ary1D_u8_16, direction=OUT, server-argument-impl-policy=USE-ARGUMENT-TYPE
    NxtrSwIdsSwRelVerRd_PortIf1
      operation Oper
        arg SwRelVer: type=Ary1D_u8_16, direction=OUT, server-argument-impl-policy=USE-ARGUMENT-TYPE
    OnlineTunRamAdrMpg_PortIf1
      operation Oper: possible-error=OnlineTunRamAdrMpg_PortIf1/E_NOT_OK
        arg ReqAdr_Arg: type=uint32, direction=IN, server-argument-impl-policy=USE-ARGUMENT-TYPE
        arg CorrdAdr_Arg: type=uint32, direction=INOUT, server-argument-impl-policy=USE-ARGUMENT-TYPE
        arg ReqTyp_Arg: type=AdrMpgReqTyp1, direction=IN, server-argument-impl-policy=USE-ARGUMENT-TYPE
      error E_NOT_OK: error-code=1
    PartNrBasMdlPartNrAlphaCodRd_PortIf1
      operation Oper
        arg BasMdlPartNrAlphaCod: type=Ary1D_u8_2, direction=OUT, server-argument-impl-policy=USE-ARGUMENT-TYPE
    PartNrBasMdlPartNrAlphaCodRd1
      operation Oper
        arg BasMdlPartNrAlphaCod: type=Ary1D_u8_2, direction=OUT, server-argument-impl-policy=USE-ARGUMENT-TYPE
    PartNrBasMdlPartNrAlphaCodWr_PortIf1
      operation Oper
        arg BasMdlPartNrAlphaCod: type=Ary1D_u8_2, direction=IN, server-argument-impl-policy=USE-ARGUMENT-TYPE
    PartNrBasMdlPartNrAlphaCodWr1
      operation Oper
        arg BasMdlPartNrAlphaCod: type=Ary1D_u8_2, direction=IN, server-argument-impl-policy=USE-ARGUMENT-TYPE
    PartNrBasMdlPartNrRd_PortIf1
      operation Oper
        arg BasMdlPartNr: type=Ary1D_u8_4, direction=OUT, server-argument-impl-policy=USE-ARGUMENT-TYPE
    PartNrBasMdlPartNrRd1
      operation Oper
        arg BasMdlPartNr: type=Ary1D_u8_4, direction=OUT, server-argument-impl-policy=USE-ARGUMENT-TYPE
    PartNrBasMdlPartNrWr_PortIf1
      operation Oper
        arg BasMdlPartNr: type=Ary1D_u8_4, direction=IN, server-argument-impl-policy=USE-ARGUMENT-TYPE
    PartNrBasMdlPartNrWr1
      operation Oper
        arg BasMdlPartNr: type=Ary1D_u8_4, direction=IN, server-argument-impl-policy=USE-ARGUMENT-TYPE
    PartNrCalProgdStsRd1
      operation Oper
        arg CalProgdSts: type=uint8, direction=OUT, server-argument-impl-policy=USE-ARGUMENT-TYPE
    PartNrCalProgdStsWr1
      operation Oper: possible-error=InvldVal
        arg CalProgdSts: type=uint8, direction=IN, server-argument-impl-policy=USE-ARGUMENT-TYPE
      error InvldVal: error-code=1
    PartNrCcaMfgTrakgRd_PortIf1
      operation Oper
        arg CcaMfgTrakg: type=Ary1D_u8_9, direction=OUT, server-argument-impl-policy=USE-ARGUMENT-TYPE
    PartNrCcaMfgTrakgRd1
      operation Oper
        arg CcaMfgTrakg: type=Ary1D_u8_9, direction=OUT, server-argument-impl-policy=USE-ARGUMENT-TYPE
    PartNrCcaMfgTrakgWr_PortIf1
      operation Oper
        arg CcaMfgTrakg: type=Ary1D_u8_9, direction=IN, server-argument-impl-policy=USE-ARGUMENT-TYPE
    PartNrCcaMfgTrakgWr1
      operation Oper
        arg CcaMfgTrakg: type=Ary1D_u8_9, direction=IN, server-argument-impl-policy=USE-ARGUMENT-TYPE
    PartNrCmpdVehPartnProdtStructRd1
      operation Oper
        arg CmpdVehPartnProdtStruct: type=Ary1D_u8_14, direction=OUT, server-argument-impl-policy=USE-ARGUMENT-TYPE
    PartNrCtrlPidKeyChk1
      operation Oper: possible-error=PartNrCtrlPidKeyChk1/InvldKey
        arg CtrlPidKey: type=Ary1D_u8_5, direction=IN, server-argument-impl-policy=USE-ARGUMENT-TYPE
      error InvldKey: error-code=1
    PartNrCtrlPidKeyWr1
      operation Oper
        arg CtrlPidKey: type=Ary1D_u8_5, direction=IN, server-argument-impl-policy=USE-ARGUMENT-TYPE
    PartNrCtrlPidSeedKeyWr_PortIf1
      operation Oper
        arg CtrlPidSeedKey: type=Ary1D_u8_10, direction=IN, server-argument-impl-policy=USE-ARGUMENT-TYPE
    PartNrCtrlPidSeedKeyWr1
      operation Oper
        arg CtrlPidSeedKey: type=Ary1D_u8_10, direction=IN, server-argument-impl-policy=USE-ARGUMENT-TYPE
    PartNrCtrlPidSeedRd1
      operation Oper
        arg CtrlPidSeed: type=Ary1D_u8_5, direction=OUT, server-argument-impl-policy=USE-ARGUMENT-TYPE
    PartNrCtrlPidSeedUpprByteRd1
      operation Oper
        arg CtrlPidSeedUpprByte: type=uint8, direction=OUT, server-argument-impl-policy=USE-ARGUMENT-TYPE
    PartNrCtrlPidSeedUpprByteWr1
      operation Oper: possible-error=MfgEnaCntrNotZero
        arg CtrlPidSeedUpprByte: type=uint8, direction=IN, server-argument-impl-policy=USE-ARGUMENT-TYPE
      error MfgEnaCntrNotZero: error-code=1
    PartNrCustMfgEnaCntrRd_PortIf1
      operation Oper
        arg CustMfgEnaCntr: type=uint8, direction=OUT, server-argument-impl-policy=USE-ARGUMENT-TYPE
    PartNrCustMfgEnaCntrRd1
      operation Oper
        arg CustMfgEnaCntr: type=uint8, direction=OUT, server-argument-impl-policy=USE-ARGUMENT-TYPE
    PartNrCustMfgEnaCntrWr_PortIf1
      operation Oper: possible-error=PartNrCustMfgEnaCntrWr_PortIf1/CustMfgEnaCntrZero
        arg CustMfgEnaCntr: type=uint8, direction=IN, server-argument-impl-policy=USE-ARGUMENT-TYPE
      error CustMfgEnaCntrZero: error-code=1
    PartNrCustMfgEnaCntrWr1
      operation Oper: possible-error=PartNrCustMfgEnaCntrWr1/CustMfgEnaCntrZero
        arg CustMfgEnaCntr: type=uint8, direction=IN, server-argument-impl-policy=USE-ARGUMENT-TYPE
      error CustMfgEnaCntrZero: error-code=1
    PartNrDataUniversalNrSysIdRd_PortIf1
      operation Oper
        arg DataUniversalNrSysId: type=Ary1D_u8_9, direction=OUT, server-argument-impl-policy=USE-ARGUMENT-TYPE
    PartNrDataUniversalNrSysIdRd1
      operation Oper
        arg DataUniversalNrSysId: type=Ary1D_u8_9, direction=OUT, server-argument-impl-policy=USE-ARGUMENT-TYPE
    PartNrDataUniversalNrSysIdWr
      operation Oper
        arg DataUniversalNrSysId: type=Ary1D_u8_9, direction=IN, server-argument-impl-policy=USE-ARGUMENT-TYPE
    PartNrDataUniversalNrSysIdWr_PortIf1
      operation Oper
        arg DataUniversalNrSysId: type=Ary1D_u8_9, direction=IN, server-argument-impl-policy=USE-ARGUMENT-TYPE
    PartNrEcuIdRd_PortIf1
      operation Oper
        arg EcuId_Arg: type=Ary1D_u8_16, direction=OUT, server-argument-impl-policy=USE-ARGUMENT-TYPE
    PartNrEcuIdWr_PortIf1
      operation Oper
        arg EcuId_Arg: type=Ary1D_u8_16, direction=IN, server-argument-impl-policy=USE-ARGUMENT-TYPE
    PartNrEndMdlPartNrAlphaCodRd_PortIf1
      operation Oper
        arg EndMdlPartNrAlphaCod: type=Ary1D_u8_2, direction=OUT, server-argument-impl-policy=USE-ARGUMENT-TYPE
    PartNrEndMdlPartNrAlphaCodRd1
      operation Oper
        arg EndMdlPartNrAlphaCod: type=Ary1D_u8_2, direction=OUT, server-argument-impl-policy=USE-ARGUMENT-TYPE
    PartNrEndMdlPartNrAlphaCodWr_PortIf1
      operation Oper
        arg EndMdlPartNrAlphaCod: type=Ary1D_u8_2, direction=IN, server-argument-impl-policy=USE-ARGUMENT-TYPE
    PartNrEndMdlPartNrAlphaCodWr1
      operation Oper
        arg EndMdlPartNrAlphaCod: type=Ary1D_u8_2, direction=IN, server-argument-impl-policy=USE-ARGUMENT-TYPE
    PartNrEndMdlPartNrRd_PortIf1
      operation Oper
        arg EndMdlPartNr: type=Ary1D_u8_4, direction=OUT, server-argument-impl-policy=USE-ARGUMENT-TYPE
    PartNrEndMdlPartNrRd1
      operation Oper
        arg EndMdlPartNr: type=Ary1D_u8_4, direction=OUT, server-argument-impl-policy=USE-ARGUMENT-TYPE
    PartNrEndMdlPartNrWr_PortIf1
      operation Oper
        arg EndMdlPartNr: type=Ary1D_u8_4, direction=IN, server-argument-impl-policy=USE-ARGUMENT-TYPE
    PartNrEndMdlPartNrWr1
      operation Oper
        arg EndMdlPartNr: type=Ary1D_u8_4, direction=IN, server-argument-impl-policy=USE-ARGUMENT-TYPE
    PartNrGmLanIdRd1
      operation Oper
        arg GmLanId: type=Ary1D_u8_12, direction=OUT, server-argument-impl-policy=USE-ARGUMENT-TYPE
    PartNrLstRepairShopCodRd1
      operation Oper
        arg RepairShopCod: type=Ary1D_u8_10, direction=OUT, server-argument-impl-policy=USE-ARGUMENT-TYPE
    PartNrNxtrMfgTrakgRd_PortIf1
      operation Oper
        arg NxtrMfgTrakg: type=Ary1D_u8_7, direction=OUT, server-argument-impl-policy=USE-ARGUMENT-TYPE
    PartNrNxtrMfgTrakgRd1
      operation Oper
        arg NxtrMfgTrakg: type=Ary1D_u8_7, direction=OUT, server-argument-impl-policy=USE-ARGUMENT-TYPE
    PartNrNxtrMfgTrakgWr_PortIf1
      operation Oper
        arg NxtrMfgTrakg: type=Ary1D_u8_7, direction=IN, server-argument-impl-policy=USE-ARGUMENT-TYPE
    PartNrNxtrMfgTrakgWr1
      operation Oper
        arg NxtrMfgTrakg: type=Ary1D_u8_7, direction=IN, server-argument-impl-policy=USE-ARGUMENT-TYPE
    PartNrProgmDateRd_PortIf1
      operation Oper
        arg ProgmDate: type=Ary1D_u8_4, direction=OUT, server-argument-impl-policy=USE-ARGUMENT-TYPE
    PartNrProgmDateRd1
      operation Oper
        arg ProgmDate: type=Ary1D_u8_4, direction=OUT, server-argument-impl-policy=USE-ARGUMENT-TYPE
    PartNrProgmDateWr_PortIf1
      operation Oper: possible-error=PartNrProgmDateWr_PortIf1/OutOfRange
        arg ProgmDate: type=Ary1D_u8_4, direction=IN, server-argument-impl-policy=USE-ARGUMENT-TYPE
      error OutOfRange: error-code=1
    PartNrProgmDateWr1
      operation Oper: possible-error=PartNrProgmDateWr1/OutOfRange
        arg ProgmDate: type=Ary1D_u8_4, direction=IN, server-argument-impl-policy=USE-ARGUMENT-TYPE
      error OutOfRange: error-code=1
    PartNrProgmSessionKeyChk1
      operation Oper: possible-error=PartNrProgmSessionKeyChk1/InvldKey
        arg ProgmSessionKey: type=Ary1D_u8_5, direction=IN, server-argument-impl-policy=USE-ARGUMENT-TYPE
      error InvldKey: error-code=1
    PartNrProgmSessionSeedKeyWr_PortIf1
      operation Oper
        arg ProgmSessionSeedKey: type=Ary1D_u8_10, direction=IN, server-argument-impl-policy=USE-ARGUMENT-TYPE
    PartNrProgmSessionSeedKeyWr1
      operation Oper
        arg ProgmSessionSeedKey: type=Ary1D_u8_10, direction=IN, server-argument-impl-policy=USE-ARGUMENT-TYPE
    PartNrProgmSessionSeedRd1
      operation Oper
        arg ProgmSessionSeed: type=Ary1D_u8_5, direction=OUT, server-argument-impl-policy=USE-ARGUMENT-TYPE
    PartNrRepairShopCodRd_PortIf1
      operation Oper
        arg RepairShopCod: type=Ary1D_u8_20, direction=OUT, server-argument-impl-policy=USE-ARGUMENT-TYPE
    PartNrRepairShopCodRd1
      operation Oper
        arg RepairShopCod: type=Ary1D_u8_20, direction=OUT, server-argument-impl-policy=USE-ARGUMENT-TYPE
    PartNrRepairShopCodWr_PortIf1
      operation Oper
        arg RepairShopCod: type=Ary1D_u8_10, direction=IN, server-argument-impl-policy=USE-ARGUMENT-TYPE
    PartNrRepairShopCodWr1
      operation Oper
        arg RepairShopCod: type=Ary1D_u8_10, direction=IN, server-argument-impl-policy=USE-ARGUMENT-TYPE
    PartNrSecuBypAuthnRd_PortIf1
      operation Oper
        arg SecuBypAuthn_Arg: type=Ary1D_u8_822, direction=OUT, server-argument-impl-policy=USE-ARGUMENT-TYPE
    PartNrSecuBypAuthnWr_PortIf1
      operation Oper
        arg SecuBypAuthn_Arg: type=Ary1D_u8_822, direction=IN, server-argument-impl-policy=USE-ARGUMENT-TYPE
    PartNrSysCodVersNrRd_PortIf1
      operation Oper
        arg SysCodVersNr: type=Ary1D_u8_2, direction=OUT, server-argument-impl-policy=USE-ARGUMENT-TYPE
    PartNrSysCodVersNrRd1
      operation Oper
        arg SysCodVersNr: type=Ary1D_u8_2, direction=OUT, server-argument-impl-policy=USE-ARGUMENT-TYPE
    PartNrSysCodVersNrWr_PortIf1
      operation Oper
        arg SysCodVersNr: type=Ary1D_u8_2, direction=IN, server-argument-impl-policy=USE-ARGUMENT-TYPE
    PartNrSysCodVersNrWr1
      operation Oper
        arg SysCodVersNr: type=Ary1D_u8_2, direction=IN, server-argument-impl-policy=USE-ARGUMENT-TYPE
    PartNrSysNameRd_PortIf1
      operation Oper
        arg SysName: type=Ary1D_u8_20, direction=OUT, server-argument-impl-policy=USE-ARGUMENT-TYPE
    PartNrSysNameRd1
      operation Oper
        arg SysName: type=Ary1D_u8_20, direction=OUT, server-argument-impl-policy=USE-ARGUMENT-TYPE
    PartNrSysNameWr_PortIf1
      operation Oper
        arg SysName: type=Ary1D_u8_20, direction=IN, server-argument-impl-policy=USE-ARGUMENT-TYPE
    PartNrSysNameWr1
      operation Oper
        arg SysName: type=Ary1D_u8_20, direction=IN, server-argument-impl-policy=USE-ARGUMENT-TYPE
    PartNrVinDataRd_PortIf1
      operation Oper
        arg VinData: type=Ary1D_u8_17, direction=OUT, server-argument-impl-policy=USE-ARGUMENT-TYPE
    PartNrVinDataRd1
      operation Oper
        arg VinData: type=Ary1D_u8_17, direction=OUT, server-argument-impl-policy=USE-ARGUMENT-TYPE
    PartNrVinDataWr_PortIf1
      operation Oper
        arg VinData: type=Ary1D_u8_17, direction=IN, server-argument-impl-policy=USE-ARGUMENT-TYPE
    PartNrVinDataWr1
      operation Oper
        arg VinData: type=Ary1D_u8_17, direction=IN, server-argument-impl-policy=USE-ARGUMENT-TYPE
    PolarityCfgRead1
      operation Oper: possible-error=PolarityCfgRead1/E_NOT_OK
        arg PolarityCfgSaved: type=Cnt15, direction=OUT, server-argument-impl-policy=USE-ARGUMENT-TYPE
      error E_NOT_OK: error-code=1
    PolarityCfgWr1
      operation Oper: possible-error=PolarityCfgWr1/E_NOT_OK
        arg PolarityCfgSaved: type=Cnt15, direction=IN, server-argument-impl-policy=USE-ARGUMENT-TYPE
      error E_NOT_OK: error-code=1
    ReadNtcFltAry_PortIf1
      operation Oper
        arg DiagcMgrReadFltInfo_Arg: type=Ary1D_ReadFltInfoRec1_20, direction=OUT, server-argument-impl-policy=USE-ARGUMENT-TYPE
    ReadNtcFltAry1
      operation Oper: possible-error=ReadNtcFltAry1/E_NOT_OK
        arg DiagcMgrNtcFltAry: type=NtcFltInfoRec1, direction=OUT, server-argument-impl-policy=USE-ARGUMENT-TYPE
      error E_NOT_OK: error-code=1
    ReadNtcInfoAndDebCntr_PortIf1
      operation Oper
        arg NtcNr_Arg: type=NtcNr1, direction=IN, server-argument-impl-policy=USE-ARGUMENT-TYPE
        arg NtcInfo_Arg: type=NtcInfoRec4, direction=OUT, server-argument-impl-policy=USE-ARGUMENT-TYPE
        arg DebCntr_Arg: type=sint16, direction=OUT, server-argument-impl-policy=USE-ARGUMENT-TYPE
    ReadSnpshtData_PortIf1
      operation Oper
        arg ReadSnpshtDataAry_Arg: type=Ary1D_SnpshtDataRec1_8, direction=OUT, server-argument-impl-policy=USE-ARGUMENT-TYPE
    ResvCrcHwUnit_PortIf1
      operation Oper: possible-error=ResvCrcHwUnit_PortIf1/E_NOT_OK
        6 x arg, all with server-argument-impl-policy=USE-ARGUMENT-TYPE:
          Mod_Arg: type=CrcHwResvMod1, direction=IN
          CrcCfg_Arg: type=CrcHwResvCfg1, direction=IN
          CrcHwInRegAdr_Arg: type=uint32, direction=OUT
          CrcHwOutRegAdr_Arg: type=uint32, direction=OUT
          StrtVal_Arg: type=uint32, direction=IN
          ResvKey_Arg: type=uint16, direction=INOUT
      error E_NOT_OK: error-code=1
    RstHwAgOverTrvlCnt_PortIf1
      operation Oper
    RstHwTq_PortIf1
      operation Oper
    RstMaxHwAgCwAndCcw_PortIf1
      operation Oper
    RstPullCmp_PortIf1
      operation Oper
    RstSnsrlsHwCentr_PortIf1
      operation Oper
    RstYawAndAg_PortIf1
      operation Oper
    RtCalChgReq
      operation Oper: possible-error=RtCalChgReq/E_NOT_OK
      error E_NOT_OK: error-code=1
    RtCalChgReq_PortIf1
      operation Oper: possible-error=RtCalChgReq_PortIf1/E_NOT_OK
      error E_NOT_OK: error-code=1
    RtnMaxHwAgCwAndCcw_PortIf1
      operation Oper
        arg HwAgCcwMax_Arg: type=float32, direction=OUT, server-argument-impl-policy=USE-ARGUMENT-TYPE
        arg HwAgCwMax_Arg: type=float32, direction=OUT, server-argument-impl-policy=USE-ARGUMENT-TYPE
    SerlComEna_PortIf1
      operation Oper
        arg Ena_Arg: type=boolean, direction=IN, server-argument-impl-policy=USE-ARGUMENT-TYPE
    SerlComInpProxyGmLanIdRd1
      operation Oper
        arg GmLanId: type=Ary1D_u8_12, direction=OUT, server-argument-impl-policy=USE-ARGUMENT-TYPE
    SerlComRstEot_PortIf1
      operation Oper
    SetCalPageReq_PortIf1
      operation Oper
        arg Seg_Arg: type=uint8, direction=IN, server-argument-impl-policy=USE-ARGUMENT-TYPE
        arg Mod_Arg: type=uint8, direction=IN, server-argument-impl-policy=USE-ARGUMENT-TYPE
        arg Page_Arg: type=uint8, direction=IN, server-argument-impl-policy=USE-ARGUMENT-TYPE
    SetCtrlPrm_PortIf1
      operation Oper
        7 x arg, all with type=float32, direction=IN, server-argument-impl-policy=USE-ARGUMENT-TYPE:
          MotVelCtrlPropGain_Arg
          MotVelCtrlIntgtrGain_Arg
          MotVelCtrlDerivtvGain_Arg
          MotVelCtrlAntiWdupLim_Arg
          MotVelCtrlAntiWdupGain_Arg
          MotVelCtrlDerivtvLpFilTiCon_Arg
          MotVelCtrlTqCmdLim_Arg
    SetEolFric_PortIf1  # OBSOLETE
      operation Oper
        arg EolFric_Arg: type=float32, direction=IN, server-argument-impl-policy=USE-ARGUMENT-TYPE
    SetFctGpio_PortIf1
      operation Oper: possible-error=SetFctGpio_PortIf1/E_NOT_OK
      error E_NOT_OK: error-code=1
    SetFctGpio1
      operation Oper: possible-error=SetFctGpio1/E_NOT_OK
      error E_NOT_OK: error-code=1
    SetFctPeriph_PortIf1
      operation Oper: possible-error=SetFctPeriph_PortIf1/E_NOT_OK
      error E_NOT_OK: error-code=1
    SetFctPeriph1
      operation Oper: possible-error=SetFctPeriph1/E_NOT_OK
      error E_NOT_OK: error-code=1
    SetFricLrngData_PortIf1
      operation Oper
        4 x arg, all with direction=IN, server-argument-impl-policy=USE-ARGUMENT-TYPE:
          FricLrngEna_Arg: type=boolean
          FricLrngOffsOutpEna_Arg: type=boolean
          FricLrngOperMod_Arg: type=SysFricLrngOperMod1
          EolFric_Arg: type=float32
    SetFricLrngOperMod_PortIf1  # OBSELETE
      operation Oper
        arg FricLrngEna_Arg: type=boolean, direction=IN, server-argument-impl-policy=USE-ARGUMENT-TYPE
        arg FricLrngOffsOutpEna_Arg: type=boolean, direction=IN, server-argument-impl-policy=USE-ARGUMENT-TYPE
        arg FricLrngOperMod_Arg: type=SysFricLrngOperMod1, direction=IN, server-argument-impl-policy=USE-ARGUMENT-TYPE
    SetFricOffsOutpDi_PortIf1
      operation Oper
        arg FricOffsOutpDi_Arg: type=boolean, direction=IN, server-argument-impl-policy=USE-ARGUMENT-TYPE
    SetGmLoaIgnCntr_PortIf1
      operation Oper
        arg GmLoaIgnCntr_Arg: type=uint16, direction=IN, server-argument-impl-policy=USE-ARGUMENT-TYPE
    SetGpio_PortIf1
      operation Oper: possible-error=SetGpio_PortIf1/E_NOT_OK
        arg PinSt_Arg: type=boolean, direction=IN, server-argument-impl-policy=USE-ARGUMENT-TYPE
      error E_NOT_OK: error-code=1
    SetGpio1
      operation Oper: possible-error=SetGpio1/E_NOT_OK
        arg PinSt: type=boolean, direction=IN, server-argument-impl-policy=USE-ARGUMENT-TYPE
      error E_NOT_OK: error-code=1
    SetHwAgOffs_PortIf1
      operation Oper
        arg HwAgOffs_Arg: type=float32, direction=IN, server-argument-impl-policy=USE-ARGUMENT-TYPE
        arg HwAgLrngStRst_Arg: type=boolean, direction=IN, server-argument-impl-policy=USE-ARGUMENT-TYPE
    SetHwAgOverTrvlCnt_PortIf2
      operation Oper
        arg HwAgOverTrvlCnt_Arg: type=uint8, direction=IN, server-argument-impl-policy=USE-ARGUMENT-TYPE
    SetHwAgTrimVal_PortIf1  # OBSELETE
      operation Oper
        arg HwAgTrimVal_Arg: type=float32, direction=IN, server-argument-impl-policy=USE-ARGUMENT-TYPE
    SetHwAgTrimVal_PortIf2
      operation Oper
        arg HwAgTrimVal_Arg: type=float32, direction=IN, server-argument-impl-policy=USE-ARGUMENT-TYPE
        arg HwAgTrimPrfmd_Arg: type=boolean, direction=IN, server-argument-impl-policy=USE-ARGUMENT-TYPE
    SetHwTqOffs_PortIf1
      operation Oper
        arg HwTqOffs_Arg: type=float32, direction=IN, server-argument-impl-policy=USE-ARGUMENT-TYPE
        arg HwTqLrngStRst_Arg: type=boolean, direction=IN, server-argument-impl-policy=USE-ARGUMENT-TYPE
    SetManTqCmd1
      operation Oper: possible-error=SetManTqCmd1/E_NOT_OK
        arg ManTqCmd: type=Tq1, direction=IN, server-argument-impl-policy=USE-ARGUMENT-TYPE
        arg ManTqCmdEna: type=boolean, direction=IN, server-argument-impl-policy=USE-ARGUMENT-TYPE
      error E_NOT_OK: error-code=1
    SetMotCoggCmdPrm_PortIf1
      operation Oper
        arg MotCoggCmdY_Arg: type=Ary1D_s1p14_128, direction=IN, server-argument-impl-policy=USE-ARGUMENT-TYPE
        arg Idx_Arg: type=uint8, direction=IN, server-argument-impl-policy=USE-ARGUMENT-TYPE
    SetMotPrmNomEol1  # OBSELETE
      operation Oper: possible-error=SetMotPrmNomEol1/E_NOT_OK
        arg MotKeNom: type=MotCon1, direction=IN, server-argument-impl-policy=USE-ARGUMENT-TYPE
        arg MotRNom: type=R6, direction=IN, server-argument-impl-policy=USE-ARGUMENT-TYPE
      error E_NOT_OK: error-code=1
    SetMotPrmNomEol2
      operation Oper: possible-error=SetMotPrmNomEol2/E_NOT_OK
        arg MotBackEmfConNom_Arg: type=MotCon1, direction=IN, server-argument-impl-policy=USE-ARGUMENT-TYPE
        arg MotRNom_Arg: type=R6, direction=IN, server-argument-impl-policy=USE-ARGUMENT-TYPE
      error E_NOT_OK: error-code=1
    SetMotRplCoggPrm_PortIf1
      operation Oper
        9 x arg, all with direction=IN, server-argument-impl-policy=USE-ARGUMENT-TYPE:
          CoggOrder1_Arg: type=uint16
          CoggOrder1X_Arg: type=s1p14
          CoggOrder1Y_Arg: type=s1p14
          CoggOrder2_Arg: type=uint16
          CoggOrder2X_Arg: type=s1p14
          CoggOrder2Y_Arg: type=s1p14
          CoggOrder3_Arg: type=uint16
          CoggOrder3X_Arg: type=s1p14
          CoggOrder3Y_Arg: type=s1p14
    SetMotTqCmdSca_PortIf1
      operation Oper
        arg MotTqCmdSca_Arg: type=float32, direction=IN, server-argument-impl-policy=USE-ARGUMENT-TYPE
    SetNerrStDiOutp1
      operation Oper: possible-error=SetNerrStDiOutp1/E_NOT_OK
        arg NerrSt: type=Logl1, direction=IN, server-argument-impl-policy=USE-ARGUMENT-TYPE
      error E_NOT_OK: error-code=1
    SetNtcSts_PortIf1
      operation Oper: possible-error=SetNtcSts_PortIf1/E_NOT_OK
        4 x arg, all with direction=IN, server-argument-impl-policy=USE-ARGUMENT-TYPE:
          NtcNr_Arg: type=NtcNr1
          NtcStInfo_Arg: type=uint8
          NtcSts_Arg: type=NtcSts1
          DebStep_Arg: type=uint16
      error E_NOT_OK: error-code=1
    SetNtcSts1
      operation Oper: possible-error=SetNtcSts1/E_NOT_OK
        4 x arg, all with direction=IN, server-argument-impl-policy=USE-ARGUMENT-TYPE:
          NtcNr: type=NtcNr1
          NtcStInfo: type=uint8
          NtcSts: type=NtcSts1
          DebStep: type=uint16
      error E_NOT_OK: error-code=1
    SetNtcStsCore_PortIf1
      operation Oper: possible-error=SetNtcStsCore_PortIf1/E_NOT_OK
        8 x arg, all with server-argument-impl-policy=USE-ARGUMENT-TYPE:
          NtcNr_Arg: type=NtcNr1, direction=IN
          NtcStInfo_Arg: type=uint8, direction=IN
          NtcSts_Arg: type=NtcSts1, direction=IN
          DebStep_Arg: type=uint16, direction=IN
          DiagcData_Arg: type=DiagcDataRec1, direction=INOUT
          ProxySetNtcData_Arg: type=DiagcDataRec1, direction=INOUT
          NtcInfo_Arg: type=NtcInfoRec4, direction=INOUT
          NtcInfoDebCntr_Arg: type=sint16, direction=INOUT
      error E_NOT_OK: error-code=1
    SetPullCmpLongTerm_PortIf1
      operation Oper
        arg PullCmpLongTerm_Arg: type=float32, direction=IN, server-argument-impl-policy=USE-ARGUMENT-TYPE
    SetPullCmpShoTerm_PortIf1
      operation Oper
        arg PullCmpShoTerm_Arg: type=float32, direction=IN, server-argument-impl-policy=USE-ARGUMENT-TYPE
    SetRxSigGroup_PortIf1
      operation Oper: possible-error=SetRxSigGroup_PortIf1/E_NOT_OK
        arg SigGroup_Arg: type=uint8, direction=IN, server-argument-impl-policy=USE-ARGUMENT-TYPE
        arg DataSrc_Arg: type=ImcArbnRxDataSrc1, direction=IN, server-argument-impl-policy=USE-ARGUMENT-TYPE
        arg Buf_Arg: type=Ary1D_u8_8, direction=IN, server-argument-impl-policy=USE-ARGUMENT-TYPE
      error E_NOT_OK: error-code=1
    SetTrajTarPrm_PortIf1
      operation Oper
        arg HwAgTrajGennHwAgTar_Arg: type=float32, direction=IN, server-argument-impl-policy=USE-ARGUMENT-TYPE
        arg HwAgTrajGennHwVelTar_Arg: type=float32, direction=IN, server-argument-impl-policy=USE-ARGUMENT-TYPE
        arg HwAgTrajGennHwATar_Arg: type=float32, direction=IN, server-argument-impl-policy=USE-ARGUMENT-TYPE
    SetYawRateOffs_PortIf1
      operation Oper
        arg VehYawRateOffs_Arg: type=float32, direction=IN, server-argument-impl-policy=USE-ARGUMENT-TYPE
        arg VehYawRateLrngStRst_Arg: type=boolean, direction=IN, server-argument-impl-policy=USE-ARGUMENT-TYPE
    StHlthStcPwrDwn_PortIf1
      operation Oper
    StopCtrl_PortIf1
      operation Oper
        arg MotVelCtrlVelSlewRate_Arg: type=float32, direction=IN, server-argument-impl-policy=USE-ARGUMENT-TYPE
    StrtCtrl_PortIf1
      operation Oper
        arg MotVelCtrlMotVelTar_Arg: type=float32, direction=IN, server-argument-impl-policy=USE-ARGUMENT-TYPE
        arg MotVelCtrlVelSlewRate_Arg: type=float32, direction=IN, server-argument-impl-policy=USE-ARGUMENT-TYPE
    SyncCrcCalc16_16BitWide_PortIf1
      operation Oper: possible-error=SyncCrcCalc16_16BitWide_PortIf1/E_NOT_OK
        5 x arg, all with server-argument-impl-policy=USE-ARGUMENT-TYPE:
          DataPtr_Arg: type=uint16, direction=INOUT
          Len_Arg: type=uint32, direction=IN
          StrtVal_Arg: type=uint16, direction=IN
          FirstCall_Arg: type=boolean, direction=IN
          CalcCrcRes_Arg: type=uint16, direction=OUT
      error E_NOT_OK: error-code=1
    SyncCrcCalc16_8BitWide_PortIf1
      operation Oper: possible-error=SyncCrcCalc16_8BitWide_PortIf1/E_NOT_OK
        5 x arg, all with server-argument-impl-policy=USE-ARGUMENT-TYPE:
          DataPtr_Arg: type=uint8, direction=INOUT
          Len_Arg: type=uint32, direction=IN
          StrtVal_Arg: type=uint16, direction=IN
          FirstCall_Arg: type=boolean, direction=IN
          CalcCrcRes_Arg: type=uint16, direction=OUT
      error E_NOT_OK: error-code=1
    SyncCrcCalc32_16BitWide_PortIf1
      operation Oper: possible-error=SyncCrcCalc32_16BitWide_PortIf1/E_NOT_OK
        5 x arg, all with server-argument-impl-policy=USE-ARGUMENT-TYPE:
          DataPtr_Arg: type=uint16, direction=INOUT
          Len_Arg: type=uint32, direction=IN
          StrtVal_Arg: type=uint32, direction=IN
          FirstCall_Arg: type=boolean, direction=IN
          CalcCrcRes_Arg: type=uint32, direction=OUT
      error E_NOT_OK: error-code=1
    SyncCrcCalc32_32BitWide_PortIf1
      operation Oper: possible-error=SyncCrcCalc32_32BitWide_PortIf1/E_NOT_OK
        5 x arg, all with server-argument-impl-policy=USE-ARGUMENT-TYPE:
          DataPtr_Arg: type=uint32, direction=INOUT
          Len_Arg: type=uint32, direction=IN
          StrtVal_Arg: type=uint32, direction=IN
          FirstCall_Arg: type=boolean, direction=IN
          CalcCrcRes_Arg: type=uint32, direction=OUT
      error E_NOT_OK: error-code=1
    SyncCrcCalc32_8BitWide_PortIf1
      operation Oper: possible-error=SyncCrcCalc32_8BitWide_PortIf1/E_NOT_OK
        5 x arg, all with server-argument-impl-policy=USE-ARGUMENT-TYPE:
          DataPtr_Arg: type=uint8, direction=INOUT
          Len_Arg: type=uint32, direction=IN
          StrtVal_Arg: type=uint32, direction=IN
          FirstCall_Arg: type=boolean, direction=IN
          CalcCrcRes_Arg: type=uint32, direction=OUT
      error E_NOT_OK: error-code=1
    SyncCrcCalc8_PortIf1
      operation Oper: possible-error=SyncCrcCalc8_PortIf1/E_NOT_OK
        5 x arg, all with server-argument-impl-policy=USE-ARGUMENT-TYPE:
          DataPtr_Arg: type=uint8, direction=INOUT
          Len_Arg: type=uint32, direction=IN
          StrtVal_Arg: type=uint8, direction=IN
          FirstCall_Arg: type=boolean, direction=IN
          CalcCrcRes_Arg: type=uint8, direction=OUT
      error E_NOT_OK: error-code=1
    UpdHwAgTrimVal_PortIf1
      operation Oper
        arg UpdHwAgTrimValSrvResp_Arg: type=uint8, direction=OUT, server-argument-impl-policy=USE-ARGUMENT-TYPE
    UpdRawSig_PortIf1
      operation Oper
        arg SigId_Arg: type=StHlthMonSig1, direction=IN, server-argument-impl-policy=USE-ARGUMENT-TYPE
    UpdRawSig_PortIf2
      operation Oper
        arg SigId_Arg: type=StHlthMonSig2, direction=IN, server-argument-impl-policy=USE-ARGUMENT-TYPE
    UpdRawSig_PortIf3
      operation Oper
        arg SigId_Arg: type=StHlthMonSig3, direction=IN, server-argument-impl-policy=USE-ARGUMENT-TYPE
    UpdStHlthStcData_PortIf1
      operation Oper
        arg TaskId_Arg: type=uint8, direction=IN, server-argument-impl-policy=USE-ARGUMENT-TYPE
    XcpCalChgReq
      operation Oper: possible-error=XcpCalChgReq/E_NOT_OK
      error E_NOT_OK: error-code=1
  6 x parameter interface:
    Ary1D_u8_14_PortIf1
      parameter data prototype Val: sw-calibration-access=READ-WRITE, type=Ary1D_u8_14
    Ary1D_u8_48_CalPortIf1
      parameter data prototype Val: sw-calibration-access=READ-WRITE, type=Ary1D_u8_48
    Ary1D_u8_6_CalPortIf1
      parameter data prototype Val: sw-calibration-access=READ-WRITE, type=Ary1D_u8_6
    Rate4
      parameter data prototype Val: sw-calibration-access=READ-WRITE, type=Rate6
    sint8_CalPortIf1
      parameter data prototype Val: sw-calibration-access=READ-WRITE, type=sint8
    Spd3
      parameter data prototype Val: sw-calibration-access=READ-WRITE, type=Spd4
  102 x sender receiver interface:
    A1: invalidation-policy{data-element=A1/Val, handle-invalid=DONT-INVALIDATE}
      data Val: sw-calibration-access=READ-ONLY, type=A1
    A2: invalidation-policy{data-element=A2/Val, handle-invalid=DONT-INVALIDATE}
      data Val: sw-calibration-access=READ-ONLY, type=A2
    A3: invalidation-policy{data-element=A3/Val, handle-invalid=DONT-INVALIDATE}
      data Val: sw-calibration-access=READ-ONLY, type=A3
    ActvGroup_PortIf1: invalidation-policy{data-element=ActvGroup_PortIf1/Val, handle-invalid=DONT-INVALIDATE}
      data Val: type=uint8
    Ag1: invalidation-policy{data-element=Ag1/Val, handle-invalid=DONT-INVALIDATE}
      data Val: sw-calibration-access=READ-ONLY, type=Ag2
    Ag2: invalidation-policy{data-element=Ag2/Val, handle-invalid=DONT-INVALIDATE}
      data Val: sw-calibration-access=READ-ONLY, type=Ag5
    Ag3: invalidation-policy{data-element=Ag3/Val, handle-invalid=DONT-INVALIDATE}
      data Val: sw-calibration-access=READ-ONLY, type=Ag7
    Ag4: invalidation-policy{data-element=Ag4/Val, handle-invalid=DONT-INVALIDATE}
      data Val: sw-calibration-access=READ-ONLY, type=Ag8
    Ag5: invalidation-policy{data-element=Ag5/Val, handle-invalid=DONT-INVALIDATE}
      data Val: sw-calibration-access=READ-ONLY, type=Ag12
    Ag6: invalidation-policy{data-element=Ag6/Val, handle-invalid=DONT-INVALIDATE}
      data Val: sw-calibration-access=READ-ONLY, type=Ag10
    Ag7: invalidation-policy{data-element=Ag7/Val, handle-invalid=DONT-INVALIDATE}
      data Val: sw-calibration-access=READ-ONLY, type=Ag15
    Ag8: invalidation-policy{data-element=Ag8/Val, handle-invalid=DONT-INVALIDATE}
      data Val: sw-calibration-access=READ-ONLY, type=Ag16
    Ag9: invalidation-policy{data-element=Ag9/Val, handle-invalid=DONT-INVALIDATE}
      data Val: sw-calibration-access=READ-ONLY, type=Ag19
    AgAry1D1: invalidation-policy{data-element=AgAry1D1/Ary1D, handle-invalid=DONT-INVALIDATE}
      data Ary1D: sw-calibration-access=READ-ONLY, type=AgAry1D2
    Ary1D_f32_8_PortIf1: invalidation-policy{data-element=Ary1D_f32_8_PortIf1/Ary1D, handle-invalid=DONT-INVALIDATE}
      data Ary1D: sw-calibration-access=READ-ONLY, type=Ary1D_f32_8
    BattSwdVltgCorrlnSts1: invalidation-policy{data-element=BattSwdVltgCorrlnSts1/Val, handle-invalid=DONT-INVALIDATE}
      data Val: sw-calibration-access=READ-ONLY, type=BattSwdVltgCorrlnSts1
    BattSwdVltgCorrlnSts1_PortIf1: invalidation-policy{data-element=BattSwdVltgCorrlnSts1_PortIf1/Val, handle-invalid=DONT-INVALIDATE}
      data Val: sw-calibration-access=READ-ONLY, type=BattSwdVltgCorrlnSts1
    boolean_PortIf1: invalidation-policy{data-element=boolean_PortIf1/Logl, handle-invalid=DONT-INVALIDATE}
      data Logl: sw-calibration-access=READ-ONLY, type=boolean
    CalCopyCmpl_PortIf1: invalidation-policy{data-element=CalCopyCmpl_PortIf1/Val, handle-invalid=DONT-INVALIDATE}
      data Val: type=uint8
    CalCopySts_PortIf1: invalidation-policy{data-element=CalCopySts_PortIf1/Val, handle-invalid=DONT-INVALIDATE}
      data Val: type=CalCopySts1
    Cnt1: invalidation-policy{data-element=Cnt1/Val, handle-invalid=DONT-INVALIDATE}
      data Val: sw-calibration-access=READ-ONLY, type=Cnt1
    Cnt10: invalidation-policy{data-element=Cnt10/Val, handle-invalid=DONT-INVALIDATE}
      data Val: sw-calibration-access=READ-ONLY, type=Cnt16
    Cnt11: invalidation-policy{data-element=Cnt11/Val, handle-invalid=DONT-INVALIDATE}
      data Val: sw-calibration-access=READ-ONLY, type=Cnt17
    Cnt12: invalidation-policy{data-element=Cnt12/Val, handle-invalid=DONT-INVALIDATE}
      data Val: sw-calibration-access=READ-ONLY, type=Cnt22
    Cnt13: invalidation-policy{data-element=Cnt13/Val, handle-invalid=DONT-INVALIDATE}
      data Val: sw-calibration-access=READ-ONLY, type=Cnt13
    Cnt14: invalidation-policy{data-element=Cnt14/Val, handle-invalid=DONT-INVALIDATE}
      data Val: sw-calibration-access=READ-ONLY, type=Cnt19
    Cnt2: invalidation-policy{data-element=Cnt2/Val, handle-invalid=DONT-INVALIDATE}
      data Val: sw-calibration-access=READ-ONLY, type=Cnt2
    Cnt3: invalidation-policy{data-element=Cnt3/Val, handle-invalid=DONT-INVALIDATE}
      data Val: sw-calibration-access=READ-ONLY, type=Cnt3
    Cnt4: invalidation-policy{data-element=Cnt4/Val, handle-invalid=DONT-INVALIDATE}
      data Val: sw-calibration-access=READ-ONLY, data-constr=p0pt0_p31pt0, type=Cnt4
    Cnt5: invalidation-policy{data-element=Cnt5/Val, handle-invalid=DONT-INVALIDATE}
      data Val: sw-calibration-access=READ-ONLY, type=Cnt5
    Cnt6: invalidation-policy{data-element=Cnt6/Val, handle-invalid=DONT-INVALIDATE}
      data Val: sw-calibration-access=READ-ONLY, type=uint8
    Cnt7: invalidation-policy{data-element=Cnt7/Val, handle-invalid=DONT-INVALIDATE}
      data Val: sw-calibration-access=READ-ONLY, type=Cnt6
    Cnt8: invalidation-policy{data-element=Cnt8/Val, handle-invalid=DONT-INVALIDATE}
      data Val: sw-calibration-access=READ-ONLY, type=Cnt7
    Cnt9: invalidation-policy{data-element=Cnt9/Val, handle-invalid=DONT-INVALIDATE}
      data Val: sw-calibration-access=READ-ONLY, type=uint32
    CntAry1D1: invalidation-policy{data-element=CntAry1D1/Ary1D, handle-invalid=DONT-INVALIDATE}
      data Ary1D: sw-calibration-access=READ-ONLY, type=CntAry1D2
    Curr1: invalidation-policy{data-element=Curr1/Val, handle-invalid=DONT-INVALIDATE}
      data Val: sw-calibration-access=READ-ONLY, type=Curr1
    Curr2: invalidation-policy{data-element=Curr2/Val, handle-invalid=DONT-INVALIDATE}
      data Val: sw-calibration-access=READ-ONLY, type=Curr6
    Curr3: invalidation-policy{data-element=Curr3/Val, handle-invalid=DONT-INVALIDATE}
      data Val: sw-calibration-access=READ-ONLY, type=Curr7
    EgyModSt1_PortIf1: invalidation-policy{data-element=EgyModSt1_PortIf1/Val, handle-invalid=DONT-INVALIDATE}
      data Val: sw-calibration-access=READ-ONLY, type=EgyModSt1
    float32_PortIf1: invalidation-policy{data-element=float32_PortIf1/Val, handle-invalid=DONT-INVALIDATE}
      data Val: sw-calibration-access=READ-ONLY, type=float32
    Frq1: invalidation-policy{data-element=Frq1/Val, handle-invalid=DONT-INVALIDATE}
      data Val: sw-calibration-access=READ-ONLY, type=Frq1
    GmFctDiArbnSts_PortIf1: invalidation-policy{data-element=GmFctDiArbnSts_PortIf1/Val, handle-invalid=DONT-INVALIDATE}
      data Val: sw-calibration-access=READ-ONLY, type=GmFctDiArbnSts1
    GmSysPwrMod1_PortIf1: invalidation-policy{data-element=GmSysPwrMod1_PortIf1/Val, handle-invalid=DONT-INVALIDATE}
      data Val: type=GmSysPwrMod1
    Indu1: invalidation-policy{data-element=Indu1, handle-invalid=DONT-INVALIDATE}  # OBSOLETE
      data Indu1: sw-calibration-access=READ-ONLY, type=Indu1
    Indu2: invalidation-policy{data-element=Indu2/Val, handle-invalid=DONT-INVALIDATE}
      data Val: sw-calibration-access=READ-ONLY, type=Indu1
    LoaSt1_PortIf1: invalidation-policy{data-element=LoaSt1_PortIf1/Val, handle-invalid=DONT-INVALIDATE}
      data Val: sw-calibration-access=READ-ONLY, type=LoaSt1
    Logl1: invalidation-policy{data-element=Logl1/Logl, handle-invalid=DONT-INVALIDATE}
      data Logl: sw-calibration-access=READ-ONLY, type=boolean
    Logl2: invalidation-policy{data-element=Logl2/Logl, handle-invalid=DONT-INVALIDATE}
      data Logl: sw-calibration-access=READ-ONLY, type=Logl1
    MfgEnaSt1_PortIf1: invalidation-policy{data-element=MfgEnaSt1_PortIf1/Val, handle-invalid=DONT-INVALIDATE}
      data Val: type=MfgEnaSt1
    MotCon1: invalidation-policy{data-element=MotCon1/Val, handle-invalid=DONT-INVALIDATE}
      data Val: sw-calibration-access=READ-ONLY, type=MotCon1
    MotCurrEolCalSt_PortIf1: invalidation-policy{data-element=MotCurrEolCalSt_PortIf1/Val, handle-invalid=DONT-INVALIDATE}
      data Val: sw-calibration-access=READ-ONLY, type=MotCurrEolCalSt2
    MotCurrEolCalSt1: invalidation-policy{data-element=MotCurrEolCalSt1/Val, handle-invalid=DONT-INVALIDATE}
      data Val: sw-calibration-access=READ-ONLY, type=MotCurrEolCalSt1
    MotCurrEolCalSt2: invalidation-policy{data-element=MotCurrEolCalSt2/Val, handle-invalid=DONT-INVALIDATE}
      data Val: sw-calibration-access=READ-ONLY, type=MotCurrEolCalSt2
    MotQuad1: invalidation-policy{data-element=MotQuad1/Val, handle-invalid=DONT-INVALIDATE}
      data Val: sw-calibration-access=READ-ONLY, type=MotQuad1
    R1: invalidation-policy{data-element=R1/Val, handle-invalid=DONT-INVALIDATE}
      data Val: sw-calibration-access=READ-ONLY, type=R2
    R2: invalidation-policy{data-element=R2/Val, handle-invalid=DONT-INVALIDATE}
      data Val: sw-calibration-access=READ-ONLY, type=R3
    R3: invalidation-policy{data-element=R3/Val, handle-invalid=DONT-INVALIDATE}
      data Val: sw-calibration-access=READ-ONLY, type=R4
    R4: invalidation-policy{data-element=R4/Val, handle-invalid=DONT-INVALIDATE}
      data Val: sw-calibration-access=READ-ONLY, type=R5
    R5: invalidation-policy{data-element=R5/Val, handle-invalid=DONT-INVALIDATE}
      data Val: sw-calibration-access=READ-ONLY, type=R7
    R6: invalidation-policy{data-element=R6/Val, handle-invalid=DONT-INVALIDATE}
      data Val: sw-calibration-access=READ-ONLY, type=R6
    Rate1: invalidation-policy{data-element=Rate1/Val, handle-invalid=DONT-INVALIDATE}
      data Val: sw-calibration-access=READ-ONLY, type=Rate1
    Rate2: invalidation-policy{data-element=Rate2/Val, handle-invalid=DONT-INVALIDATE}
      data Val: sw-calibration-access=READ-ONLY, type=Rate5
    s18p13_PortIf1: invalidation-policy{data-element=s18p13_PortIf1/Val, handle-invalid=DONT-INVALIDATE}
      data Val: sw-calibration-access=READ-ONLY, type=s18p13
    SigQlfr_PortIf1: invalidation-policy{data-element=SigQlfr_PortIf1/Val, handle-invalid=DONT-INVALIDATE}
      data Val: sw-calibration-access=READ-ONLY, type=SigQlfr1
    SigQlfr1: invalidation-policy{data-element=SigQlfr1/Val, handle-invalid=DONT-INVALIDATE}
      data Val: sw-calibration-access=READ-ONLY, type=SigQlfr1
    sint32_PortIf1: invalidation-policy{data-element=sint32_PortIf1/Val, handle-invalid=DONT-INVALIDATE}
      data Val: sw-calibration-access=READ-ONLY, type=sint32
    sint8_PortIf1: invalidation-policy{data-element=sint8_PortIf1/Val, handle-invalid=DONT-INVALIDATE}
      data Val: sw-calibration-access=READ-ONLY, type=sint8
    Spd1: invalidation-policy{data-element=Spd1/Val, handle-invalid=DONT-INVALIDATE}
      data Val: sw-calibration-access=READ-ONLY, type=Spd1
    Spd2: invalidation-policy{data-element=Spd2/Val, handle-invalid=DONT-INVALIDATE}
      data Val: sw-calibration-access=READ-ONLY, type=Spd2
    StrtUpSt1: invalidation-policy{data-element=StrtUpSt1/Val, handle-invalid=DONT-INVALIDATE}
      data Val: sw-calibration-access=READ-ONLY, type=StrtUpSt1
    SysSt1: invalidation-policy{data-element=SysSt1/Val, handle-invalid=DONT-INVALIDATE}
      data Val: sw-calibration-access=READ-ONLY, type=SysSt1
    SysSt1_PortIf1: invalidation-policy{data-element=SysSt1_PortIf1/Val, handle-invalid=DONT-INVALIDATE}
      data Val: sw-calibration-access=READ-ONLY, type=SysSt1
    T1: invalidation-policy{data-element=T1/Val, handle-invalid=DONT-INVALIDATE}
      data Val: sw-calibration-access=READ-ONLY, type=T1
    T2: invalidation-policy{data-element=T2, handle-invalid=DONT-INVALIDATE}  # OBSOLETE
      data T2: sw-calibration-access=READ-ONLY, type=T2
    T3: invalidation-policy{data-element=T3, handle-invalid=DONT-INVALIDATE}  # OBSOLETE
      data T3: sw-calibration-access=READ-ONLY, type=T3
    T4: invalidation-policy{data-element=Element, handle-invalid=DONT-INVALIDATE}
      data Element: sw-calibration-access=READ-ONLY, type=T4
    T5: invalidation-policy{data-element=T5/Val, handle-invalid=DONT-INVALIDATE}
      data Val: sw-calibration-access=READ-ONLY, type=T2
    T6: invalidation-policy{data-element=T6/Val, handle-invalid=DONT-INVALIDATE}
      data Val: sw-calibration-access=READ-ONLY, type=T3
    Ti1: invalidation-policy{data-element=Ti1/Val, handle-invalid=DONT-INVALIDATE}
      data Val: sw-calibration-access=READ-ONLY, type=Ti1
    Ti3: invalidation-policy{data-element=Ti3/Val, handle-invalid=DONT-INVALIDATE}
      data Val: sw-calibration-access=READ-ONLY, type=Ti3
    Tq1: invalidation-policy{data-element=Tq1/Val, handle-invalid=DONT-INVALIDATE}
      data Val: sw-calibration-access=READ-ONLY, type=Tq1
    Tq2: invalidation-policy{data-element=Tq2/Val, handle-invalid=DONT-INVALIDATE}
      data Val: sw-calibration-access=READ-ONLY, type=Tq2
    Tq3: invalidation-policy{data-element=Tq3/Val, handle-invalid=DONT-INVALIDATE}
      data Val: sw-calibration-access=READ-ONLY, type=Tq3
    Tq4: invalidation-policy{data-element=Tq4/Val, handle-invalid=DONT-INVALIDATE}
      data Val: sw-calibration-access=READ-ONLY, type=Tq4
    Tq5: invalidation-policy{data-element=Tq5/Val, handle-invalid=DONT-INVALIDATE}
      data Val: sw-calibration-access=READ-ONLY, type=Tq8
    Tq6: invalidation-policy{data-element=Tq6/Val, handle-invalid=DONT-INVALIDATE}
      data Val: sw-calibration-access=READ-ONLY, type=Tq9
    Tq7: invalidation-policy{data-element=Tq7/Val, handle-invalid=DONT-INVALIDATE}
      data Val: sw-calibration-access=READ-ONLY, type=Tq10
    u0p16_PortIf1: invalidation-policy{data-element=u0p16_PortIf1/Val, handle-invalid=DONT-INVALIDATE}
      data Val: sw-calibration-access=READ-ONLY, type=u0p16
    uint16_PortIf1: invalidation-policy{data-element=uint16_PortIf1/Val, handle-invalid=DONT-INVALIDATE}
      data Val: sw-calibration-access=READ-ONLY, type=uint16
    uint32_PortIf1: invalidation-policy{data-element=uint32_PortIf1/Val, handle-invalid=DONT-INVALIDATE}
      data Val: sw-calibration-access=READ-ONLY, type=uint32
    uint8_PortIf1: invalidation-policy{data-element=uint8_PortIf1/Val, handle-invalid=DONT-INVALIDATE}
      data Val: sw-calibration-access=READ-ONLY, type=uint8
    Uls2: invalidation-policy{data-element=Uls2/Val, handle-invalid=DONT-INVALIDATE}
      data Val: sw-calibration-access=READ-ONLY, type=Uls2
    Uls3: invalidation-policy{data-element=Uls3/Val, handle-invalid=DONT-INVALIDATE}
      data Val: sw-calibration-access=READ-ONLY, type=Uls3
    Uls4: invalidation-policy{data-element=Uls4/Val, handle-invalid=DONT-INVALIDATE}
      data Val: sw-calibration-access=READ-ONLY, type=Uls6
    Vel1: invalidation-policy{data-element=Vel1/Val, handle-invalid=DONT-INVALIDATE}
      data Val: sw-calibration-access=READ-ONLY, type=Vel1
    Vel2: invalidation-policy{data-element=Vel2/Val, handle-invalid=DONT-INVALIDATE}
      data Val: sw-calibration-access=READ-ONLY, type=Vel3
    Volt1: invalidation-policy{data-element=Volt1/Val, handle-invalid=DONT-INVALIDATE}
      data Val: sw-calibration-access=READ-ONLY, type=Volt1
    Volt2: invalidation-policy{data-element=Volt2/Val, handle-invalid=DONT-INVALIDATE}
      data Val: sw-calibration-access=READ-ONLY, type=Volt2
    Volt3: invalidation-policy{data-element=Volt3/Val, handle-invalid=DONT-INVALIDATE}
      data Val: sw-calibration-access=READ-ONLY, type=Volt3
    Volt4: invalidation-policy{data-element=Volt4/Val, handle-invalid=DONT-INVALIDATE}
      data Val: sw-calibration-access=READ-ONLY, type=Volt6
    Volt5: invalidation-policy{data-element=Volt5/Val, handle-invalid=DONT-INVALIDATE}
      data Val: sw-calibration-access=READ-ONLY, type=Volt7
    Volt6: invalidation-policy{data-element=Volt6/Val, handle-invalid=DONT-INVALIDATE}
      data Val: sw-calibration-access=READ-ONLY, type=Volt17
package /PortInterface
  client server interface WdgM_AliveSupervision: is-service=true
    operation CheckpointReached: possible-error=WdgM_AliveSupervision/E_NOT_OK  # Indicates to the Watchdog Manager that a Checkpoint within a Supervised Entity has been reached.
    error E_NOT_OK: error-code=1
  client server interface WdgM_GlobalMode: is-service=true
    operation GetGlobalStatus: possible-error=WdgM_GlobalMode/E_NOT_OK  # Returns the global monitoring status of the Watchdog Manager.
      arg Status: type=WdgM_GlobalStatusType, direction=OUT, server-argument-impl-policy=USE-ARGUMENT-TYPE
    operation GetMode: possible-error=WdgM_GlobalMode/E_NOT_OK  # Returns the current mode of the Watchdog Manager.
      arg Mode: type=WdgM_ModeType, direction=OUT, server-argument-impl-policy=USE-ARGUMENT-TYPE
    operation PerformReset: possible-error=WdgM_GlobalMode/E_NOT_OK  # Instructs the Watchdog Manager to cause a watchdog reset.
    error E_NOT_OK: error-code=1
  client server interface WdgM_IndividualMode: is-service=true
    operation ActivateSupervisionEntity: possible-error=WdgM_IndividualMode/E_NOT_OK  # This function activates the monitoring of the given Supervised Entity
    operation DeactivateSupervisionEntity: possible-error=WdgM_IndividualMode/E_NOT_OK  # This function deactivates the monitoring of the given Supervised Entity
    operation GetLocalStatus: possible-error=WdgM_IndividualMode/E_NOT_OK  # Returns the monitoring status of an individual Supervised Entity.
      arg Status: type=WdgM_LocalStatusType, direction=OUT, server-argument-impl-policy=USE-ARGUMENT-TYPE
    error E_NOT_OK: error-code=1
package /PortInterfaces
  11 x client server interface:
    ClrSigStcHlthData_PortIf1
      operation Oper
        arg ClrTar_Arg: type=boolean, direction=IN, server-argument-impl-policy=USE-ARGUMENT-TYPE
    CmnMfgSrvCmnMfgSrvMaiFct
      operation Oper
        7 x arg, all with server-argument-impl-policy=USE-ARGUMENT-TYPE:
          CmnMfgSrvCmnMfgSrvSrvId: type=uint8, direction=IN
          CmnMfgSrvCmnMfgSrvSubFct: type=uint8, direction=IN
          CmnMfgSrvCmnMfgSrvPrmId: type=uint16, direction=IN
          CmnMfgSrvCmnMfgSrvDataBufferPtr: type=uint8, direction=INOUT
          CmnMfgSrvCmnMfgSrvReqLen: type=uint16, direction=IN
          CmnMfgSrvCmnMfgSrvRespLen: type=uint16, direction=OUT
          CmnMfgSrvCmnMfgSrvRespCod: type=uint8, direction=OUT
    CmnMfgSrvIfCmnMfgSrvIfImdtTx
      operation Oper
        arg CmnMfgSrvCmnMfgSrvDataBufferPtr: type=uint8, direction=INOUT, server-argument-impl-policy=USE-ARGUMENT-TYPE
        arg CmnMfgSrvCmnMfgSrvDataLen: type=uint16, direction=IN, server-argument-impl-policy=USE-ARGUMENT-TYPE
    GetSigStcHlthData_PortIf1
      operation Oper: possible-error=GetSigStcHlthData_PortIf1/E_NOT_OK
        arg SigId_Arg: type=StHlthMonSig1, direction=IN, server-argument-impl-policy=USE-ARGUMENT-TYPE
        arg BufPtr_Arg: type=uint32, direction=OUT, server-argument-impl-policy=USE-ARGUMENT-TYPE
      error E_NOT_OK: error-code=1
    RtCalChgReq_PortIf1
      operation Oper: possible-error=RtCalChgReq_PortIf1/E_NOT_OK
      error E_NOT_OK: error-code=1
    SerlComRstEot_PortIf1
      operation Oper
    SetCalPageReq_PortIf1
      operation Oper
        arg Seg_Arg: type=uint8, direction=IN, server-argument-impl-policy=USE-ARGUMENT-TYPE
        arg Mod_Arg: type=uint8, direction=IN, server-argument-impl-policy=USE-ARGUMENT-TYPE
        arg Page_Arg: type=uint8, direction=IN, server-argument-impl-policy=USE-ARGUMENT-TYPE
    StHlthStcPwrDwn_PortIf1
      operation Oper
    UpdRawSig_PortIf1
      operation Oper
        arg SigId_Arg: type=StHlthMonSig1, direction=IN, server-argument-impl-policy=USE-ARGUMENT-TYPE
    UpdStHlthStcData_PortIf1
      operation Oper
        arg TaskId_Arg: type=uint8, direction=IN, server-argument-impl-policy=USE-ARGUMENT-TYPE
    XcpCalChgReq_PortIf1
      operation Oper: possible-error=XcpCalChgReq_PortIf1/E_NOT_OK
      error E_NOT_OK: error-code=1
