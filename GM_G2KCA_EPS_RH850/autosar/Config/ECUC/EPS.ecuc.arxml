AUTOSAR XML (schema 4-0-3)
package /ActiveEcuC
  ecuc value collection ActiveEcuC: ecu-extract=SYSTEM
    ecuc-values:
      Adc0CfgAndUse
      Adc1CfgAndUse
      BswM
      ChkPt
      Crc
      Dem
      Det
      Dio
      EcuC
      EcuM
      Fee
      Fls
      HwAg0Meas
      HwAg1Meas
      IoHwAb
      Mcu
      MemIf
      MotCtrlMgr
      NvM
      Os
      Port
      Rte
      Spi
      TunSelnMngt
      Wdg
      WdgIf
      WdgM
      Adc0CfgAndUse
      Adc1CfgAndUse
      BswM
      ChkPt
      Crc
      Dem
      Det
      Dio
      EcuC
      EcuM
      Fee
      Fls
      HwAg0Meas
      HwAg1Meas
      IoHwAb
      Mcu
      MemIf
      MotCtrlMgr
      NvM
      Os
      Port
      Rte
      Spi
      TunSelnMngt
      Wdg
      WdgIf
      WdgM
      NxtrMfgSrv
      NxtrSwIds
      FlsMem
      SyncCrc
      NvMProxy
      AdcDiagc
      StHlthSigStc
      DiagcMgr
      VrfyCritReg
      NxtrMfgSrvIf
      ImcArbn
      ElecGlbPrm
