AUTOSAR XML (schema 4-0-3)
package /ActiveEcuC
  module config Adc0CfgAndUse: implementation-config-variant=VARIANT-PRE-COMPILE
    Adc0CfgAndUseGeneral:
      ADCD0VCR00 = 24580
      ADCD0VCR01 = 2
      ADCD0VCR02 = 3
      ADCD0VCR03 = 4
      ADCD0VCR04 = 24588
      ADCD0VCR05 = 24580
      ADCD0VCR06 = 2
      ADCD0VCR07 = 3
      ADCD0VCR08 = 4
      ADCD0VCR09 = 1
      ADCD0VCR10 = 24588
      ADCD0VCR{11..20} = 24584
      ADCD0SGVCSP2 = 5
      ADCD0SGVCSP3 = 0
      ADCD0SGVCEP2 = 10
      ADCD0SGVCEP3 = 4
