AUTOSAR XML (schema 4-0-3)
package /ActiveEcuC
  module config Adc1CfgAndUse: implementation-config-variant=VARIANT-PRE-COMPILE
    Adc1CfgAndUseGeneral:
      ADCD1VCR00 = 24580
      ADCD1VCR01 = 2
      ADCD1VCR02 = 9
      ADCD1VCR03 = 24588
      ADCD1VCR04 = 24580
      ADCD1VCR05 = 1
      ADCD1VCR06 = 24588
      ADCD1VCR{07..20} = 24584
      ADCD1SGVCSP2 = 4
      ADCD1SGVCSP3 = 0
      ADCD1SGVCEP2 = 6
      ADCD1SGVCEP3 = 3
