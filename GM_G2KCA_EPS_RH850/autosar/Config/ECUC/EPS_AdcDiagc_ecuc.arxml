AUTOSAR XML (schema 4-0-3)
package /ActiveEcuC
  module config AdcDiagc: implementation-config-variant=VARIANT-PRE-COMPILE
    AdcDiagcGeneral: DYNDIAGFAILSTEP=32760, DYNDIAGPASSSTEP=3270
