AUTOSAR XML (schema 4-0-3)
package /ActiveEcuC
  module config Crc: implementation-config-variant=VARIANT-PRE-COMPILE, module-description=Crc_Impl
    CrcPublishedInformation: CrcInitialValue16=65535, CrcInitialValue32=4294967295, CrcInitialValue8=255, CrcInitialValue8H2F=255
    CrcGeneral:
      Crc16Mode = CRC_16_RUNTIME
      Crc32Mode = CRC_32_RUNTIME
      Crc8H2FMode = CRC_8H2F_RUNTIME
      Crc8Mode = CRC_8_RUNTIME
      CrcVersionInfoApi = true
      Crc32P4Mode = CRC_32P4_RUNTIME
    VectorCommonData: BswmdVersion=5.03.00
