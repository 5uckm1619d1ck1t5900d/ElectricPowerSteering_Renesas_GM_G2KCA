AUTOSAR XML (schema 4-0-3)
package /ActiveEcuC
  module config Dio: implementation-config-variant=VARIANT-POST-BUILD-LOADABLE, module-description=Dio_Impl
    DioGeneral:
      DioDevErrorDetect = true
      DioMaskedWritePortApi = false
      DioFlipChannelApi = false
      DioVersionInfoApi = false
      DioVersionCheckExternalModules = true
      DioCriticalSectionProtection = true
      DioDeviceName = R7F701319
    DioConfig
      5 x DioPort:
        Port0: DioPortId=0, DioPortName=PORTGROUP_0_BITS_0_TO_14
          3 x DioChannel:
            PwrTurnOffCtrl: DioChannelId=0, DioChannelBitPosition=13
            McuEna: DioChannelId=1, DioChannelBitPosition=8
            EcuIdnPin2: DioChannelId=2, DioChannelBitPosition=14
        Port5: DioPortId=4, DioPortName=PORTGROUP_5_BITS_0_TO_15
          TmplMonrWdg (DioChannel): DioChannelId=2, DioChannelBitPosition=10
        Port4: DioPortId=3, DioPortName=PORTGROUP_4_BITS_0_TO_14
          MotAg0CsihCs (DioChannel): DioChannelId=1, DioChannelBitPosition=3
        Port3: DioPortId=2, DioPortName=PORTGROUP_3_BITS_0_TO_14
          10 x DioChannel:
            GateDrv0Rst: DioChannelId=6, DioChannelBitPosition=5
            PhaALowrCmd: DioChannelId=1, DioChannelBitPosition=8
            MotDrvr0Diag: DioChannelId=9, DioChannelBitPosition=4
            PhaBLowrCmd: DioChannelId=3, DioChannelBitPosition=10
            PhaBUpprCmd: DioChannelId=2, DioChannelBitPosition=9
            PhaCLowrCmd: DioChannelId=5, DioChannelBitPosition=13
            PhaCUpprCmd: DioChannelId=4, DioChannelBitPosition=12
            PwrOutpEnaFb: DioChannelId=7, DioChannelBitPosition=6
            MotAg1CsihCs: DioChannelId=8, DioChannelBitPosition=3
            PhaAUpprCmd: DioChannelId=0, DioChannelBitPosition=7
        Port2: DioPortId=1, DioPortName=PORTGROUP_2_BITS_0_TO_15
          SysFlt2A (DioChannel): DioChannelId=0, DioChannelBitPosition=4
          EcuIdnPin1 (DioChannel): DioChannelId=1, DioChannelBitPosition=13
