AUTOSAR XML (schema 4-0-3)
package /ActiveEcuC
  module config Fls: implementation-config-variant=VARIANT-POST-BUILD-LOADABLE, module-description=Fls_Impl
    FlsGeneral:
      FlsDevErrorDetect = true
      FlsAccess = FLS_DATAFLASH_ACCESS
      FlsAcLoadOnJobStart = false
      FlsCancelApi = true
      FlsCompareApi = false
      FlsDriverIndex = 0
      FlsGetJobResultApi = true
      FlsGetStatusApi = true
      FlsSetModeApi = false
      FlsUseInterrupts = false
      FlsVersionInfoApi = false
      FlsVersionCheckExternalModules = false
      FlsCriticalSectionProtection = true
      FlsVirtualBoundaryAddress = 65536
      FlsDeviceName = R7F701319
      FlsBaseAddress = 0
      FlsTotalSize = 32768
      FlsTimeoutMonitoring = true
      FlsDataFlash:
        FlsBlankCheck = FDL_NOT_SUPPORTED
        FlsDFBaseAddress = 4280287232
        FlsDFBlockSize = 64
        FlsDFTotalBlocks = 1024
        FlsDFTotalSize = 65536
        FlsBlankCheckApi = false
        FlsReadImmediateApi = false
        FlsSuspendApi = false
        FlsResumeApi = false
        FlsFdlCpuFrequency = McuClockSettingConfig
    FlsPublishedInformation:
      FlsAcLocationErase = 0
      FlsAcLocationWrite = 0
      FlsAcSizeErase = 0
      FlsAcSizeWrite = 0
      FlsEraseTime = 0.01
      FlsErasedValue = 4294967295
      FlsExpectedHwId = NULL
      FlsSpecifiedEraseCycles = 125000
      FlsReadTime = 0.00005
      FlsWriteTime = 0.0017
      FlsBlankCheckTime = 0.000213
      FlsSuspendTime = 0.0003
      FlsCancelTime = 0.00005
    FlsConfigSet:
      FlsAcErase = 0
      FlsAcWrite = 0
      FlsCallCycle = 0
      FlsDefaultMode = MEMIF_MODE_SLOW
      FlsMaxReadFastMode = 0
      FlsMaxReadNormalMode = 32
      FlsMaxWriteFastMode = 0
      FlsMaxWriteNormalMode = 4
      FlsMaxEraseNormalMode = 64
      FlsProtection = 0
      FlsDemEventParameterRefs:
        FLS_E_COMPARE_FAILED = FLS_E_COMPARE_FAILED
        FLS_E_ERASE_FAILED = FLS_E_ERASE_FAILED
        FLS_E_READ_FAILED = FLS_E_READ_FAILED
        FLS_E_WRITE_FAILED = FLS_E_WRITE_FAILED
        FLS_E_READ_FAILED_DED = FLS_E_READ_FAILED_DED
      FlsSectorList
        FlsSector: FlsSectorIndex=0, FlsSectorOption=FLS_DF_SECTOR, FlsNumberOfSectors=512, FlsPageSize=4, FlsSectorSize=64, FlsSectorStartaddress=0
