AUTOSAR XML (schema 4-0-3)
package /ActiveEcuC
  module config ImcArbn: implementation-config-variant=VARIANT-PRE-COMPILE
    EcuId (ImcArbnSignal): SignalName=EcuId, DestSize=8, DataType=uint8, ImcArbnSigUsersRef=DualEcuIdn
    EcuIdSignalGroup (ImcArbnSignalGroup)
      EcuIdn (ImcArbnSigRef): StartBit=0, ImcArbnSigNameRef=EcuId
      ImcArbnSGAttributes: PrimarySrcOnlySignalGroup=false, ImcArbnGroupTxRate=IMCARBN_100MS_GROUP
    DualEcuIdn (ImcArbnSignalUserGroups): FddName=DualEcuIdn, ReceiverSideSignalName=SecdryEcuIdn, DataType=uint8
    EcuIdSignalGroup10ms (ImcArbnSignalGroup)
      EcuId10ms (ImcArbnSigRef): StartBit=0, ImcArbnSigNameRef=EcuId
      ImcArbnSGAttributes: PrimarySrcOnlySignalGroup=false, ImcArbnGroupTxRate=IMCARBN_10MS_GROUP
    EcuIdSignalGroup2ms (ImcArbnSignalGroup)
      EcuId2ms (ImcArbnSigRef): StartBit=0, ImcArbnSigNameRef=EcuId
      ImcArbnSGAttributes: PrimarySrcOnlySignalGroup=true, ImcArbnGroupTxRate=IMCARBN_2MS_GROUP
