AUTOSAR XML (schema 4-0-3)
package /ActiveEcuC
  module config MemIf: implementation-config-variant=VARIANT-PRE-COMPILE, module-description=MemIf_Impl
    MemIfGeneral: MemIfDevErrorDetect=true, MemIfVersionInfoApi=false
      MemIfDevErrorChecks: MemIfCfgIncludeDet=Det.h, MemIfDevErrorReport=true, MemIfErrorhook=Det_ReportError
    Fee (MemIfMemHwA): MemIfMemHwAId=0, MemIfMemHwARef=FeeGeneral
