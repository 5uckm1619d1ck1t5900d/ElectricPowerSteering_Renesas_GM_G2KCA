AUTOSAR XML (schema 4-0-3)
package /ActiveEcuC
  module config MotCtrlMgr: implementation-config-variant=VARIANT-PRE-COMPILE
    MotCtrlMgrConfigSet
      SignalManagement
        3 x NonRteEnum, all with EnumImplementationDataType=uint8:
          MotCurrEolCalSt2
            9 x EnumElement:
              MCECS_OFFSCMDSTRT: Value=0
              MCECS_GAINCMDCF: Value=7
              MCECS_GAINCMDBE: Value=6
              MCECS_GAINCMDAD: Value=5
              MCECS_OFFSCMDEND: Value=4
              MCECS_OFFSCMDZERO: Value=3
              MCECS_OFFSCMDLO: Value=2
              MCECS_OFFSCMDHI: Value=1
              MCECS_CMDSAFEST: Value=8
          SigQlfr1
            3 x EnumElement:
              SIGQLFR_NORES: Value=0
              SIGQLFR_FAILD: Value=2
              SIGQLFR_PASSD: Value=1
          SysSt1
            4 x EnumElement:
              SYSST_DI: Value=0
              SYSST_OFF: Value=1
              SYSST_ENA: Value=2
              SYSST_WRMININ: Value=3
        99 x Signal:
          Adc0SelfDiag0: WrittenInMotCtrlRunnable=true, ReadInMotCtrlRunnable=false, WrittenIn2msRunnable=false, ReadIn2msRunnable=true, ImplementationDataType=float32, Size=1, InitialValue=0.0F, Min=0, Max=5, Units=Volt
          Adc0SelfDiag2: WrittenInMotCtrlRunnable=true, ReadInMotCtrlRunnable=false, WrittenIn2msRunnable=false, ReadIn2msRunnable=true, ImplementationDataType=float32, Size=1, InitialValue=0.0F, Min=0, Max=5, Units=Volt
          Adc0SelfDiag4: WrittenInMotCtrlRunnable=true, ReadInMotCtrlRunnable=false, WrittenIn2msRunnable=false, ReadIn2msRunnable=true, ImplementationDataType=float32, Size=1, InitialValue=0.0F, Min=0, Max=5, Units=Volt
          MotCurrAdcPeakA: WrittenInMotCtrlRunnable=true, ReadInMotCtrlRunnable=false, WrittenIn2msRunnable=false, ReadIn2msRunnable=false, ImplementationDataType=float32, Size=1, InitialValue=0.0F, Min=0, Max=5, Units=Volt
          MotCurrAdcPeakB: WrittenInMotCtrlRunnable=true, ReadInMotCtrlRunnable=false, WrittenIn2msRunnable=false, ReadIn2msRunnable=false, ImplementationDataType=float32, Size=1, InitialValue=0.0F, Min=0, Max=5, Units=Volt
          MotCurrAdcPeakC: WrittenInMotCtrlRunnable=true, ReadInMotCtrlRunnable=false, WrittenIn2msRunnable=false, ReadIn2msRunnable=false, ImplementationDataType=float32, Size=1, InitialValue=0.0F, Min=0, Max=5, Units=Volt
          MotCurrAdcVlyA: WrittenInMotCtrlRunnable=true, WrittenIn2msRunnable=false, ReadIn2msRunnable=true, ImplementationDataType=float32, Size=1, InitialValue=0.0F, Min=0, Max=5, Units=Volt, ReadInMotCtrlRunnable=true
          MotCurrAdcVlyB: WrittenInMotCtrlRunnable=true, WrittenIn2msRunnable=false, ReadIn2msRunnable=true, ImplementationDataType=float32, Size=1, InitialValue=0.0F, Min=0, Max=5, Units=Volt, ReadInMotCtrlRunnable=true
          MotCurrAdcVlyC: WrittenInMotCtrlRunnable=true, WrittenIn2msRunnable=false, ReadIn2msRunnable=true, ImplementationDataType=float32, Size=1, InitialValue=0.0F, Min=0, Max=5, Units=Volt, ReadInMotCtrlRunnable=true
          MotCurrAdcVlyD: WrittenIn2msRunnable=false, ReadIn2msRunnable=true, ImplementationDataType=float32, Size=1, InitialValue=0.0F, Min=0, Max=5, Units=Volt, ReadInMotCtrlRunnable=true, WrittenInMotCtrlRunnable=false
          MotCurrAdcVlyE: WrittenIn2msRunnable=false, ReadIn2msRunnable=true, ImplementationDataType=float32, Size=1, InitialValue=0.0F, Min=0, Max=5, Units=Volt, ReadInMotCtrlRunnable=true, WrittenInMotCtrlRunnable=false
          MotCurrAdcVlyF: WrittenIn2msRunnable=false, ReadIn2msRunnable=true, ImplementationDataType=float32, Size=1, InitialValue=0.0F, Min=0, Max=5, Units=Volt, ReadInMotCtrlRunnable=true, WrittenInMotCtrlRunnable=false
          MotCurrSnsrOffs1: WrittenInMotCtrlRunnable=true, ReadInMotCtrlRunnable=false, WrittenIn2msRunnable=false, ReadIn2msRunnable=false, ImplementationDataType=float32, Size=1, InitialValue=0.0F, Min=0, Max=5, Units=Volt
          MotCurrEolCalSt: WrittenInMotCtrlRunnable=false, ReadInMotCtrlRunnable=true, WrittenIn2msRunnable=true, ReadIn2msRunnable=true, ImplementationDataType=uint8, Size=1, InitialValue=MCECS_OFFSCMDSTRT, Min=0, Max=8, Units=Cnt, EnumerationNameReference=MotCurrEolCalSt2
          BrdgVltg: WrittenInMotCtrlRunnable=false, ReadInMotCtrlRunnable=true, WrittenIn2msRunnable=true, ReadIn2msRunnable=true, ImplementationDataType=float32, Size=1, InitialValue=6.0F, Max=26.5, Units=Volt, Min=2
          DiagcStsIvtr1Inactv: WrittenInMotCtrlRunnable=false, ReadInMotCtrlRunnable=true, WrittenIn2msRunnable=true, ReadIn2msRunnable=true, ImplementationDataType=boolean, Size=1, InitialValue=FALSE, Min=0, Max=1, Units=Cnt
          DiagcStsIvtr2Inactv: WrittenInMotCtrlRunnable=false, ReadInMotCtrlRunnable=true, WrittenIn2msRunnable=true, ReadIn2msRunnable=true, ImplementationDataType=boolean, Size=1, InitialValue=FALSE, Min=0, Max=1, Units=Cnt
          MotElecMeclPolarity: WrittenInMotCtrlRunnable=false, ReadInMotCtrlRunnable=true, WrittenIn2msRunnable=true, ImplementationDataType=sint8, Size=1, InitialValue=1, Min=-1, Max=1, Units=Uls, ReadIn2msRunnable=false
          MotVelMrf: WrittenInMotCtrlRunnable=false, ReadInMotCtrlRunnable=true, WrittenIn2msRunnable=true, ReadIn2msRunnable=true, ImplementationDataType=float32, Size=1, InitialValue=0.0F, Min=-1350, Max=1350, Units=MotRadPerSec
          SysSt: WrittenInMotCtrlRunnable=false, ReadInMotCtrlRunnable=true, WrittenIn2msRunnable=true, ReadIn2msRunnable=true, ImplementationDataType=uint8, Size=1, InitialValue=SYSST_WRMININ, Min=0, Max=3, Units=Cnt, EnumerationNameReference=SysSt1
          PhaOnTiA: WrittenInMotCtrlRunnable=true, ReadInMotCtrlRunnable=true, WrittenIn2msRunnable=false, ReadIn2msRunnable=false, ImplementationDataType=uint32, Size=1, InitialValue=0U, Min=0, Max=71429, Units=NanoSec
          PhaOnTiB: WrittenInMotCtrlRunnable=true, ReadInMotCtrlRunnable=true, WrittenIn2msRunnable=false, ReadIn2msRunnable=false, ImplementationDataType=uint32, Size=1, InitialValue=0U, Min=0, Max=71429, Units=NanoSec
          PhaOnTiC: WrittenInMotCtrlRunnable=true, ReadInMotCtrlRunnable=true, WrittenIn2msRunnable=false, ReadIn2msRunnable=false, ImplementationDataType=uint32, Size=1, InitialValue=0U, Min=0, Max=71429, Units=NanoSec
          PwmPerd: WrittenInMotCtrlRunnable=true, ReadInMotCtrlRunnable=true, WrittenIn2msRunnable=false, ReadIn2msRunnable=false, ImplementationDataType=uint32, Size=1, InitialValue=62500U, Max=71429, Units=NanoSec, Min=55555
          CurrMeasMotAgCorrd: WrittenInMotCtrlRunnable=true, ReadInMotCtrlRunnable=true, WrittenIn2msRunnable=false, ReadIn2msRunnable=false, ImplementationDataType=float32, Size=1, InitialValue=0.0F, Min=-6.2832, Max=6.2832, Units=MotRad
          MotCurrDax: WrittenInMotCtrlRunnable=true, ReadInMotCtrlRunnable=true, WrittenIn2msRunnable=false, ReadIn2msRunnable=true, ImplementationDataType=float32, Size=1, InitialValue=0.0F, Min=-200, Max=200, Units=Ampr
          MotCurrQax: WrittenInMotCtrlRunnable=true, ReadInMotCtrlRunnable=true, WrittenIn2msRunnable=false, ReadIn2msRunnable=true, ImplementationDataType=float32, Size=1, InitialValue=0.0F, Min=-200, Max=200, Units=Ampr
          MotAg0RawRes: ReadInMotCtrlRunnable=true, WrittenIn2msRunnable=false, ReadIn2msRunnable=false, ImplementationDataType=uint32, Size=3, Min=0, Max=67108863, Units=Cnt, InitialValue=0U, 0U, 0U, WrittenInMotCtrlRunnable=false
          MotAg0Mecl: WrittenInMotCtrlRunnable=true, WrittenIn2msRunnable=false, ImplementationDataType=uint16, Size=1, InitialValue=0U, Min=0, Max=0.9999847412, Units=MotRev, ReadInMotCtrlRunnable=false, ReadIn2msRunnable=true
          MotAgMeasTi: WrittenInMotCtrlRunnable=true, ReadInMotCtrlRunnable=true, WrittenIn2msRunnable=false, ReadIn2msRunnable=false, ImplementationDataType=uint32, Size=1, InitialValue=0U, Min=0, Max=4294967295, Units=Cnt
          MotAgMecl: WrittenInMotCtrlRunnable=true, ReadInMotCtrlRunnable=true, WrittenIn2msRunnable=false, ReadIn2msRunnable=false, ImplementationDataType=uint16, Size=1, InitialValue=0U, Min=0, Max=0.9999847412, Units=MotRev
          MotAgElec: WrittenInMotCtrlRunnable=true, ReadInMotCtrlRunnable=true, WrittenIn2msRunnable=false, ReadIn2msRunnable=false, ImplementationDataType=uint16, Size=1, InitialValue=0U, Min=0, Max=0.9999847412, Units=MotRevElec
          MotModlnIdx: WrittenInMotCtrlRunnable=true, ReadInMotCtrlRunnable=true, WrittenIn2msRunnable=false, ReadIn2msRunnable=false, ImplementationDataType=float32, Size=1, InitialValue=0.0F, Min=0, Max=1, Units=Uls
          MotPhaAdv: WrittenInMotCtrlRunnable=true, ReadInMotCtrlRunnable=true, WrittenIn2msRunnable=false, ReadIn2msRunnable=false, ImplementationDataType=uint16, Size=1, InitialValue=0U, Min=0, Max=0.9999847412, Units=MotRev
          TSG31CMP0E: WrittenInMotCtrlRunnable=true, ReadInMotCtrlRunnable=false, WrittenIn2msRunnable=false, ReadIn2msRunnable=false, ImplementationDataType=uint32, Size=1, Min=0, Max=65535, Units=Cnt, InitialValue=4444U
          TSG31CMP12E: WrittenInMotCtrlRunnable=true, ReadInMotCtrlRunnable=false, WrittenIn2msRunnable=false, ReadIn2msRunnable=false, ImplementationDataType=uint32, Size=1, Min=0, Max=262143, Units=Cnt, InitialValue=4364U
          TSG31CMPUE: WrittenInMotCtrlRunnable=true, ReadInMotCtrlRunnable=false, WrittenIn2msRunnable=false, ReadIn2msRunnable=false, ImplementationDataType=uint32, Size=1, Min=0, Max=262143, Units=Cnt, InitialValue=4444U
          TSG31CMPVE: WrittenInMotCtrlRunnable=true, ReadInMotCtrlRunnable=false, WrittenIn2msRunnable=false, ReadIn2msRunnable=false, ImplementationDataType=uint32, Size=1, Min=0, Max=262143, Units=Cnt, InitialValue=4444U
          TSG31CMPWE: WrittenInMotCtrlRunnable=true, ReadInMotCtrlRunnable=false, WrittenIn2msRunnable=false, ReadIn2msRunnable=false, ImplementationDataType=uint32, Size=1, Min=0, Max=262143, Units=Cnt, InitialValue=4444U
          TSG31DCMP0E: WrittenInMotCtrlRunnable=true, ReadInMotCtrlRunnable=false, WrittenIn2msRunnable=false, ReadIn2msRunnable=false, ImplementationDataType=uint32, Size=1, Min=0, Max=262143, Units=Cnt, InitialValue=3964U
          MotAg0MeclRollgCntr: ImplementationDataType=uint8, Size=1, InitialValue=0U, Min=0, Max=255, Units=Cnt, ReadIn2msRunnable=false, ReadInMotCtrlRunnable=false, WrittenIn2msRunnable=true, WrittenInMotCtrlRunnable=false
          CmuOffs: WrittenInMotCtrlRunnable=true, ReadInMotCtrlRunnable=false, WrittenIn2msRunnable=false, ReadIn2msRunnable=false, ImplementationDataType=uint32, Size=1, InitialValue=0U, Min=0, Max=71429, Units=NanoSec
          PhaOnTiSumA: WrittenInMotCtrlRunnable=true, ReadInMotCtrlRunnable=false, WrittenIn2msRunnable=false, ReadIn2msRunnable=true, ImplementationDataType=uint32, Size=1, InitialValue=0U, Min=0, Max=4294967295, Units=NanoSec
          PhaOnTiSumB: WrittenInMotCtrlRunnable=true, ReadInMotCtrlRunnable=false, WrittenIn2msRunnable=false, ReadIn2msRunnable=true, ImplementationDataType=uint32, Size=1, InitialValue=0U, Min=0, Max=4294967295, Units=NanoSec
          PhaOnTiSumC: WrittenInMotCtrlRunnable=true, ReadInMotCtrlRunnable=false, WrittenIn2msRunnable=false, ReadIn2msRunnable=true, ImplementationDataType=uint32, Size=1, InitialValue=0U, Min=0, Max=4294967295, Units=NanoSec
          MotCurrQaxCmdFinal: WrittenInMotCtrlRunnable=true, ReadInMotCtrlRunnable=false, WrittenIn2msRunnable=false, ReadIn2msRunnable=false, ImplementationDataType=float32, Size=1, InitialValue=0.0F, Min=-200, Max=200, Units=Ampr
          MotVltgDax: WrittenInMotCtrlRunnable=true, ReadInMotCtrlRunnable=false, WrittenIn2msRunnable=false, ReadIn2msRunnable=false, ImplementationDataType=float32, Size=1, InitialValue=0.0F, Min=-26.5, Max=26.5, Units=Volt
          MotVltgQax: WrittenInMotCtrlRunnable=true, ReadInMotCtrlRunnable=false, WrittenIn2msRunnable=false, ReadIn2msRunnable=false, ImplementationDataType=float32, Size=1, InitialValue=0.0F, Min=-26.5, Max=26.5, Units=Volt
          EcuTFild: WrittenInMotCtrlRunnable=false, ReadInMotCtrlRunnable=true, WrittenIn2msRunnable=true, ImplementationDataType=float32, Size=1, InitialValue=25.0F, Min=-50, Max=150, Units=DegCgrd, ReadIn2msRunnable=true
          CurrMeasCorrlnSts: WrittenInMotCtrlRunnable=false, ReadInMotCtrlRunnable=true, WrittenIn2msRunnable=true, ReadIn2msRunnable=false, ImplementationDataType=uint8, Size=1, InitialValue=63U, Min=0, Max=63, Units=Cnt
          MotAgMecl0Polarity: WrittenInMotCtrlRunnable=false, ReadInMotCtrlRunnable=true, WrittenIn2msRunnable=true, ReadIn2msRunnable=false, ImplementationDataType=sint8, Size=1, InitialValue=1, Min=-1, Max=1, Units=Uls
          MotAg0ErrReg: WrittenInMotCtrlRunnable=true, ReadInMotCtrlRunnable=false, WrittenIn2msRunnable=false, ReadIn2msRunnable=false, ImplementationDataType=uint32, Size=1, InitialValue=0U, Min=0, Max=67108863, Units=Cnt
          MotAg0ParFltCnt: WrittenInMotCtrlRunnable=true, ReadInMotCtrlRunnable=false, WrittenIn2msRunnable=false, ReadIn2msRunnable=false, ImplementationDataType=uint16, Size=1, InitialValue=0U, Min=0, Max=65535, Units=Cnt
          MotAgCumvAlgndMrfRev: WrittenInMotCtrlRunnable=true, ReadInMotCtrlRunnable=false, WrittenIn2msRunnable=false, ReadIn2msRunnable=true, ImplementationDataType=sint32, Size=1, InitialValue=0, Max=32767.99998, Units=MotRev, Min=-32768
          MotAgBuf: WrittenInMotCtrlRunnable=true, WrittenIn2msRunnable=false, ReadIn2msRunnable=true, ImplementationDataType=uint16, Size=8, Min=0, Max=0.9999847412, Units=MotRev, InitialValue=0U, 0U, 0U, 0U, 0U, 0U, 0U, 0U, ReadInMotCtrlRunnable=true
          MotAgBufIdx: WrittenInMotCtrlRunnable=true, ReadInMotCtrlRunnable=false, WrittenIn2msRunnable=false, ReadIn2msRunnable=true, ImplementationDataType=uint8, Size=1, InitialValue=0U, Min=0, Max=7, Units=Cnt
          MotAgTiBuf: WrittenInMotCtrlRunnable=true, WrittenIn2msRunnable=false, ReadIn2msRunnable=true, ImplementationDataType=uint32, Size=8, Min=0, Max=4294967295, InitialValue=0U, 62U, 125U, 187U, 250U, 312U, 375U, 437U, ReadInMotCtrlRunnable=true, Units=MicroSec
          MotCurrCorrdA: WrittenInMotCtrlRunnable=true, ReadInMotCtrlRunnable=true, WrittenIn2msRunnable=false, ReadIn2msRunnable=true, ImplementationDataType=float32, Size=1, InitialValue=0.0F, Min=-200, Max=200, Units=Ampr
          MotCurrCorrdB: WrittenInMotCtrlRunnable=true, ReadInMotCtrlRunnable=true, WrittenIn2msRunnable=false, ReadIn2msRunnable=true, ImplementationDataType=float32, Size=1, InitialValue=0.0F, Min=-200, Max=200, Units=Ampr
          MotCurrCorrdC: WrittenInMotCtrlRunnable=true, ReadInMotCtrlRunnable=true, WrittenIn2msRunnable=false, ReadIn2msRunnable=true, ImplementationDataType=float32, Size=1, InitialValue=0.0F, Min=-200, Max=200, Units=Ampr
          MotCurrCorrdD: WrittenInMotCtrlRunnable=true, ReadInMotCtrlRunnable=true, WrittenIn2msRunnable=false, ReadIn2msRunnable=true, ImplementationDataType=float32, Size=1, InitialValue=0.0F, Min=-200, Max=200, Units=Ampr
          MotCurrCorrdE: WrittenInMotCtrlRunnable=true, ReadInMotCtrlRunnable=true, WrittenIn2msRunnable=false, ReadIn2msRunnable=true, ImplementationDataType=float32, Size=1, InitialValue=0.0F, Min=-200, Max=200, Units=Ampr
          MotCurrCorrdF: WrittenInMotCtrlRunnable=true, ReadInMotCtrlRunnable=true, WrittenIn2msRunnable=false, ReadIn2msRunnable=true, ImplementationDataType=float32, Size=1, InitialValue=0.0F, Min=-200, Max=200, Units=Ampr
          MotCurrQlfr1: WrittenInMotCtrlRunnable=false, ReadInMotCtrlRunnable=true, WrittenIn2msRunnable=true, ImplementationDataType=uint8, Size=1, InitialValue=SIGQLFR_NORES, Min=0, Max=2, Units=Cnt, ReadIn2msRunnable=true, EnumerationNameReference=SigQlfr1
          MotCurrQlfr2: WrittenInMotCtrlRunnable=false, ReadInMotCtrlRunnable=true, WrittenIn2msRunnable=true, ImplementationDataType=uint8, Size=1, InitialValue=SIGQLFR_NORES, Min=0, Max=2, Units=Cnt, ReadIn2msRunnable=true, EnumerationNameReference=SigQlfr1
          MotCurrRollgCntr1: WrittenInMotCtrlRunnable=true, ReadInMotCtrlRunnable=true, WrittenIn2msRunnable=false, ReadIn2msRunnable=true, ImplementationDataType=uint8, Size=1, InitialValue=0U, Min=0, Max=255, Units=Cnt
          MotCurrRollgCntr2: WrittenInMotCtrlRunnable=true, ReadInMotCtrlRunnable=true, WrittenIn2msRunnable=false, ReadIn2msRunnable=true, ImplementationDataType=uint8, Size=1, InitialValue=0U, Min=0, Max=255, Units=Cnt
          IvtrLoaMtgtnEna: WrittenInMotCtrlRunnable=false, ReadInMotCtrlRunnable=true, WrittenIn2msRunnable=true, ImplementationDataType=boolean, Size=1, InitialValue=FALSE, Min=0, Max=1, Units=Cnt, ReadIn2msRunnable=true
          MotAgElecDly: WrittenInMotCtrlRunnable=false, ReadInMotCtrlRunnable=true, WrittenIn2msRunnable=true, ReadIn2msRunnable=false, ImplementationDataType=float32, Size=1, InitialValue=0.0F, Units=MotRad, Max=1.5, Min=-1.5
          MotCurrDaxCmd: WrittenInMotCtrlRunnable=false, ReadInMotCtrlRunnable=true, WrittenIn2msRunnable=true, ReadIn2msRunnable=true, ImplementationDataType=float32, Size=1, InitialValue=0.0F, Min=0, Max=200, Units=Ampr
          MotCurrDaxMax: WrittenInMotCtrlRunnable=false, ReadInMotCtrlRunnable=true, WrittenIn2msRunnable=true, ReadIn2msRunnable=false, ImplementationDataType=float32, Size=1, InitialValue=0.0F, Min=0, Max=200, Units=Ampr
          CurrMeasLoaMtgtnEna: WrittenInMotCtrlRunnable=false, ReadInMotCtrlRunnable=true, WrittenIn2msRunnable=true, ImplementationDataType=boolean, Size=1, InitialValue=FALSE, Min=0, Max=1, Units=Cnt, ReadIn2msRunnable=true
          MotCurrQaxCmd: WrittenInMotCtrlRunnable=false, ReadInMotCtrlRunnable=true, WrittenIn2msRunnable=true, ReadIn2msRunnable=true, ImplementationDataType=float32, Size=1, InitialValue=0.0F, Min=-200, Max=200, Units=Ampr
          MotCurrQaxCoggCmd: WrittenInMotCtrlRunnable=true, ReadInMotCtrlRunnable=true, WrittenIn2msRunnable=false, ReadIn2msRunnable=false, ImplementationDataType=float32, Size=1, InitialValue=0.0F, Min=-6, Max=6, Units=Ampr
          MotCurrQaxRplCmd: WrittenInMotCtrlRunnable=true, ReadInMotCtrlRunnable=true, WrittenIn2msRunnable=false, ReadIn2msRunnable=false, ImplementationDataType=float32, Size=1, InitialValue=0.0F, Min=-29, Max=29, Units=Ampr
          MotDampgDax: WrittenInMotCtrlRunnable=false, ReadInMotCtrlRunnable=true, WrittenIn2msRunnable=true, ReadIn2msRunnable=false, ImplementationDataType=float32, Size=1, InitialValue=0.0F, Units=Ohm, Max=5.5, Min=-0.11
          MotDampgQax: WrittenInMotCtrlRunnable=false, ReadInMotCtrlRunnable=true, WrittenIn2msRunnable=true, ReadIn2msRunnable=false, ImplementationDataType=float32, Size=1, InitialValue=0.0F, Units=Ohm, Max=5.5, Min=-0.11
          MotIntglGainDax: WrittenInMotCtrlRunnable=false, ReadInMotCtrlRunnable=true, WrittenIn2msRunnable=true, ReadIn2msRunnable=false, ImplementationDataType=float32, Size=1, InitialValue=0.0F, Min=0, Units=Ohm, Max=0.6
          MotIntglGainQax: WrittenInMotCtrlRunnable=false, ReadInMotCtrlRunnable=true, WrittenIn2msRunnable=true, ReadIn2msRunnable=false, ImplementationDataType=float32, Size=1, InitialValue=0.0F, Min=0, Units=Ohm, Max=0.6
          MotPropGainDax: WrittenInMotCtrlRunnable=false, ReadInMotCtrlRunnable=true, WrittenIn2msRunnable=true, ReadIn2msRunnable=false, ImplementationDataType=float32, Size=1, InitialValue=0.0F, Min=0, Max=2.25, Units=Ohm
          MotPropGainQax: WrittenInMotCtrlRunnable=false, ReadInMotCtrlRunnable=true, WrittenIn2msRunnable=true, ReadIn2msRunnable=false, ImplementationDataType=float32, Size=1, InitialValue=0.0F, Min=0, Max=2.25, Units=Ohm
          MotReacncDax: WrittenInMotCtrlRunnable=false, ReadInMotCtrlRunnable=true, WrittenIn2msRunnable=true, ReadIn2msRunnable=false, ImplementationDataType=float32, Size=1, InitialValue=0.0F, Units=Ohm, Max=2.87607, Min=-2.87607
          MotReacncQax: WrittenInMotCtrlRunnable=false, ReadInMotCtrlRunnable=true, WrittenIn2msRunnable=true, ReadIn2msRunnable=false, ImplementationDataType=float32, Size=1, InitialValue=0.0F, Units=Ohm, Max=2.87607, Min=-2.87607
          MotVltgDaxFf: WrittenInMotCtrlRunnable=false, ReadInMotCtrlRunnable=true, WrittenIn2msRunnable=true, ReadIn2msRunnable=false, ImplementationDataType=float32, Size=1, InitialValue=0.0F, Min=-26.5, Max=26.5, Units=Volt
          MotVltgQaxFf: WrittenInMotCtrlRunnable=false, ReadInMotCtrlRunnable=true, WrittenIn2msRunnable=true, ReadIn2msRunnable=false, ImplementationDataType=float32, Size=1, InitialValue=0.0F, Units=Volt, Max=101.25, Min=-101.25
          MotAg0VltgFltCnt: WrittenInMotCtrlRunnable=true, WrittenIn2msRunnable=false, ImplementationDataType=uint16, Size=1, InitialValue=0U, Min=0, Max=65535, Units=Cnt, ReadIn2msRunnable=false, ReadInMotCtrlRunnable=true
          MotAg1RawRes: ReadInMotCtrlRunnable=true, WrittenIn2msRunnable=false, ReadIn2msRunnable=false, ImplementationDataType=uint32, Size=3, Min=0, Max=67108863, Units=Cnt, InitialValue=0U, 0U, 0U, WrittenInMotCtrlRunnable=false
          MotAgMecl1Polarity: WrittenInMotCtrlRunnable=false, ReadInMotCtrlRunnable=true, WrittenIn2msRunnable=true, ReadIn2msRunnable=false, ImplementationDataType=sint8, Size=1, InitialValue=1, Min=-1, Max=1, Units=Uls
          MotAg1ErrReg: WrittenInMotCtrlRunnable=true, ReadInMotCtrlRunnable=false, WrittenIn2msRunnable=false, ReadIn2msRunnable=false, ImplementationDataType=uint32, Size=1, InitialValue=0U, Min=0, Max=67108863, Units=Cnt
          MotAg1Mecl: WrittenInMotCtrlRunnable=true, WrittenIn2msRunnable=false, ImplementationDataType=uint16, Size=1, InitialValue=0U, Min=0, Max=0.9999847412, Units=MotRev, ReadInMotCtrlRunnable=false, ReadIn2msRunnable=true
          MotAg1MeclRollgCntr: ImplementationDataType=uint8, Size=1, InitialValue=0U, Min=0, Max=255, Units=Cnt, ReadIn2msRunnable=false, ReadInMotCtrlRunnable=true, WrittenIn2msRunnable=true, WrittenInMotCtrlRunnable=false
          MotAg1ParFltCnt: WrittenInMotCtrlRunnable=true, ReadInMotCtrlRunnable=false, WrittenIn2msRunnable=false, ReadIn2msRunnable=false, ImplementationDataType=uint16, Size=1, InitialValue=0U, Min=0, Max=65535, Units=Cnt
          MotAg1VltgFltCnt: WrittenInMotCtrlRunnable=true, ReadInMotCtrlRunnable=false, WrittenIn2msRunnable=false, ReadIn2msRunnable=false, ImplementationDataType=uint16, Size=1, InitialValue=0U, Min=0, Max=65535, Units=Cnt
          MotAgMeclCorrlnSt: WrittenInMotCtrlRunnable=false, WrittenIn2msRunnable=true, ReadIn2msRunnable=false, ImplementationDataType=uint8, Size=1, Min=0, Units=Cnt, ReadInMotCtrlRunnable=false, Max=3, InitialValue=3U
          MotAg0MeclQlfr: WrittenInMotCtrlRunnable=false, WrittenIn2msRunnable=true, ImplementationDataType=uint8, Size=1, InitialValue=SIGQLFR_NORES, Min=0, Max=2, Units=Cnt, ReadIn2msRunnable=false, ReadInMotCtrlRunnable=false, EnumerationNameReference=SigQlfr1
          MotAg1MeclQlfr: WrittenInMotCtrlRunnable=false, WrittenIn2msRunnable=true, ImplementationDataType=uint8, Size=1, InitialValue=SIGQLFR_NORES, Min=0, Max=2, Units=Cnt, ReadIn2msRunnable=false, ReadInMotCtrlRunnable=true, EnumerationNameReference=SigQlfr1
          Ntc5DErrCnt: WrittenInMotCtrlRunnable=true, ReadInMotCtrlRunnable=false, WrittenIn2msRunnable=false, ReadIn2msRunnable=true, ImplementationDataType=uint16, Size=1, InitialValue=0U, Min=0, Max=65535, Units=Cnt
          Ntc6DErrCnt: WrittenInMotCtrlRunnable=true, ReadInMotCtrlRunnable=false, WrittenIn2msRunnable=false, ReadIn2msRunnable=true, ImplementationDataType=uint16, Size=1, InitialValue=0U, Min=0, Max=65535, Units=Cnt
          CurrMeasWrmIninTestCmpl: WrittenInMotCtrlRunnable=false, ReadInMotCtrlRunnable=true, WrittenIn2msRunnable=true, ImplementationDataType=boolean, Size=1, InitialValue=FALSE, Min=0, Max=1, Units=Cnt, ReadIn2msRunnable=true
        6 x SignalMapping:
          MotAg0MeclQlfrMap: OutputSignalName=MotAg0MeclQlfr, InputSignalName=MotAgAMeclQlfr
          MotAg1MeclQlfrMap: OutputSignalName=MotAg1MeclQlfr, InputSignalName=MotAgBMeclQlfr
          MotAg0MeclMap: OutputSignalName=MotAg0Mecl, InputSignalName=MotAgAMecl
          MotAg1MeclMap: OutputSignalName=MotAg1Mecl, InputSignalName=MotAgBMecl
          MotAg0MeclRollgCntrMap: OutputSignalName=MotAg0MeclRollgCntr, InputSignalName=MotAgAMeclRollgCntr
          MotAg1MeclRollgCntrMap: OutputSignalName=MotAg1MeclRollgCntr, InputSignalName=MotAgBMeclRollgCntr
        37 x Signal:
          MotAgElecDlyRpl: WrittenInMotCtrlRunnable=false, ReadInMotCtrlRunnable=true, WrittenIn2msRunnable=true, ReadIn2msRunnable=false, ImplementationDataType=float32, Size=1, InitialValue=0.0F, Min=-1.62, Max=1.62, Units=MotRad
          MotCurrQaxToMotTqGain: WrittenInMotCtrlRunnable=false, ReadInMotCtrlRunnable=true, WrittenIn2msRunnable=true, ReadIn2msRunnable=false, ImplementationDataType=float32, Size=1, InitialValue=0.021651F, Units=VoltPerMotRadPerSec, Max=0.406952, Min=0.021651
          MotTqRplCoggOrder1Mgn: WrittenInMotCtrlRunnable=false, ReadInMotCtrlRunnable=true, WrittenIn2msRunnable=true, ReadIn2msRunnable=false, ImplementationDataType=float32, Size=1, Max=0.5, Units=MotNwtMtr, InitialValue=0.0F, Min=0
          MotTqRplCoggOrder1Pha: WrittenInMotCtrlRunnable=false, ReadInMotCtrlRunnable=true, WrittenIn2msRunnable=true, ReadIn2msRunnable=false, ImplementationDataType=float32, Size=1, Min=0, Max=6.2831853, Units=MotRad, InitialValue=0.0F
          MotTqRplCoggOrder2Mgn: WrittenInMotCtrlRunnable=false, ReadInMotCtrlRunnable=true, WrittenIn2msRunnable=true, ReadIn2msRunnable=false, ImplementationDataType=float32, Size=1, Max=0.5, Units=MotNwtMtr, InitialValue=0.0F, Min=0
          MotTqRplCoggOrder2Pha: WrittenInMotCtrlRunnable=false, ReadInMotCtrlRunnable=true, WrittenIn2msRunnable=true, ReadIn2msRunnable=false, ImplementationDataType=float32, Size=1, Min=0, Max=6.2831853, Units=MotRad, InitialValue=0.0F
          MotTqRplCoggOrder3Mgn: WrittenInMotCtrlRunnable=false, ReadInMotCtrlRunnable=true, WrittenIn2msRunnable=true, ReadIn2msRunnable=false, ImplementationDataType=float32, Size=1, Max=0.5, Units=MotNwtMtr, InitialValue=0.0F, Min=0
          MotTqRplCoggOrder3Pha: WrittenInMotCtrlRunnable=false, ReadInMotCtrlRunnable=true, WrittenIn2msRunnable=true, ReadIn2msRunnable=false, ImplementationDataType=float32, Size=1, Min=0, Max=6.2831853, Units=MotRad, InitialValue=0.0F
          MotCurrAdcVlyAAdcFaild: WrittenInMotCtrlRunnable=false, ReadInMotCtrlRunnable=true, WrittenIn2msRunnable=true, ReadIn2msRunnable=false, ImplementationDataType=boolean, Size=1, InitialValue=FALSE, Units=Cnt, Max=1, Min=0
          MotCurrAdcVlyBAdcFaild: WrittenInMotCtrlRunnable=false, ReadInMotCtrlRunnable=true, WrittenIn2msRunnable=true, ReadIn2msRunnable=false, ImplementationDataType=boolean, Size=1, InitialValue=FALSE, Units=Cnt, Max=1, Min=0
          MotCurrAdcVlyCAdcFaild: WrittenInMotCtrlRunnable=false, ReadInMotCtrlRunnable=true, WrittenIn2msRunnable=true, ReadIn2msRunnable=false, ImplementationDataType=boolean, Size=1, InitialValue=FALSE, Units=Cnt, Max=1, Min=0
          MotCurrAdcVlyDAdcFaild: WrittenInMotCtrlRunnable=false, ReadInMotCtrlRunnable=true, ReadIn2msRunnable=false, ImplementationDataType=boolean, Size=1, InitialValue=FALSE, Max=1, Min=0, Units=Uls, WrittenIn2msRunnable=false
          MotCurrAdcVlyEAdcFaild: WrittenInMotCtrlRunnable=false, ReadInMotCtrlRunnable=true, ReadIn2msRunnable=false, ImplementationDataType=boolean, Size=1, InitialValue=FALSE, Max=1, Min=0, Units=Uls, WrittenIn2msRunnable=false
          MotCurrAdcVlyFAdcFaild: WrittenInMotCtrlRunnable=false, ReadInMotCtrlRunnable=true, ReadIn2msRunnable=false, ImplementationDataType=boolean, Size=1, InitialValue=FALSE, Max=1, Min=0, Units=Uls, WrittenIn2msRunnable=false
          FastLoopCntr: WrittenInMotCtrlRunnable=true, ReadInMotCtrlRunnable=false, WrittenIn2msRunnable=false, ReadIn2msRunnable=true, ImplementationDataType=uint16, Size=1, InitialValue=0U, Min=0, Max=65535, Units=Cnt
          SlowLoopCntr: WrittenInMotCtrlRunnable=true, ReadInMotCtrlRunnable=false, WrittenIn2msRunnable=false, ReadIn2msRunnable=true, ImplementationDataType=uint16, Size=1, InitialValue=0U, Min=0, Max=65535, Units=Cnt
          LoopCntr2MilliSec: WrittenInMotCtrlRunnable=false, ReadInMotCtrlRunnable=true, WrittenIn2msRunnable=true, ReadIn2msRunnable=false, ImplementationDataType=uint16, Size=1, InitialValue=0U, Min=0, Max=65535, Units=Cnt
          AdcDiagcStrtPtrOutp: WrittenInMotCtrlRunnable=false, ReadInMotCtrlRunnable=true, WrittenIn2msRunnable=true, ImplementationDataType=uint8, Size=1, InitialValue=21U, Min=21, Max=23, Units=Cnt, ReadIn2msRunnable=true
          AdcDiagcEndPtrOutp: WrittenInMotCtrlRunnable=false, ReadInMotCtrlRunnable=true, WrittenIn2msRunnable=true, ImplementationDataType=uint8, Size=1, InitialValue=23U, Min=21, Max=23, Units=Cnt, ReadIn2msRunnable=true
          Adc0ScanGroup3Ref0: WrittenInMotCtrlRunnable=true, ReadInMotCtrlRunnable=false, WrittenIn2msRunnable=false, ReadIn2msRunnable=true, ImplementationDataType=float32, Size=1, InitialValue=0.0F, Min=0, Max=5, Units=Volt
          Adc0ScanGroup3Ref1: WrittenInMotCtrlRunnable=true, ReadInMotCtrlRunnable=false, WrittenIn2msRunnable=false, ReadIn2msRunnable=true, ImplementationDataType=float32, Size=1, InitialValue=0.0F, Min=0, Max=5, Units=Volt
          Adc0ScanGroup2Ref1: WrittenInMotCtrlRunnable=true, ReadInMotCtrlRunnable=false, WrittenIn2msRunnable=false, ReadIn2msRunnable=true, ImplementationDataType=float32, Size=1, InitialValue=0.0F, Min=0, Max=5, Units=Volt
          Adc0ScanGroup2Ref0: WrittenInMotCtrlRunnable=true, ReadInMotCtrlRunnable=false, WrittenIn2msRunnable=false, ReadIn2msRunnable=true, ImplementationDataType=float32, Size=1, InitialValue=0.0F, Min=0, Max=5, Units=Volt
          Adc0RawRes: WrittenInMotCtrlRunnable=false, ReadInMotCtrlRunnable=true, WrittenIn2msRunnable=false, ReadIn2msRunnable=false, ImplementationDataType=uint16, Size=24, InitialValue=0U, 0U, 0U, 0U, 0U, 0U, 0U, 0U, 0U, 0U, 0U, 0U, 0U, 0U, 0U, 0U, 0U, 0U, 0U, 0U, 0U, 0U, 0U, 0U, Min=0, Max=4095, Units=Cnt
          MotAgAMecl: WrittenInMotCtrlRunnable=false, ReadInMotCtrlRunnable=true, WrittenIn2msRunnable=false, ReadIn2msRunnable=true, ImplementationDataType=uint16, Size=1, InitialValue=0U, Min=0, Max=0.9999847412, Units=MotRev
          MotAgAMeclQlfr: WrittenInMotCtrlRunnable=false, ReadInMotCtrlRunnable=true, WrittenIn2msRunnable=false, ReadIn2msRunnable=true, ImplementationDataType=uint8, Size=1, InitialValue=SIGQLFR_NORES, Min=0, Max=2, Units=Cnt, EnumerationNameReference=SigQlfr1
          MotAgAMeclRollgCntr: WrittenInMotCtrlRunnable=false, ReadInMotCtrlRunnable=true, WrittenIn2msRunnable=false, ReadIn2msRunnable=true, ImplementationDataType=uint8, Size=1, InitialValue=0U, Min=0, Max=255, Units=Cnt
          MotAgBMecl: WrittenInMotCtrlRunnable=false, WrittenIn2msRunnable=false, ReadIn2msRunnable=true, ImplementationDataType=uint16, Size=1, InitialValue=0U, Min=0, Max=0.9999847412, Units=MotRev, ReadInMotCtrlRunnable=false
          MotAgBMeclQlfr: WrittenInMotCtrlRunnable=false, WrittenIn2msRunnable=false, ReadIn2msRunnable=true, ImplementationDataType=uint8, Size=1, InitialValue=SIGQLFR_NORES, Min=0, Max=2, Units=Cnt, ReadInMotCtrlRunnable=false, EnumerationNameReference=SigQlfr1
          MotAgBMeclRollgCntr: WrittenInMotCtrlRunnable=false, WrittenIn2msRunnable=false, ReadIn2msRunnable=true, ImplementationDataType=uint8, Size=1, InitialValue=0U, Min=0, Max=255, Units=Cnt, ReadInMotCtrlRunnable=false
          RegInpADCD0SGSR1: WrittenInMotCtrlRunnable=false, ReadInMotCtrlRunnable=true, WrittenIn2msRunnable=false, ReadIn2msRunnable=false, ImplementationDataType=uint8, Size=1, InitialValue=0U, Min=0, Max=255, Units=Cnt
          DualEcuMotCtrlMtgtnEna: WrittenInMotCtrlRunnable=false, ReadInMotCtrlRunnable=true, WrittenIn2msRunnable=false, ImplementationDataType=boolean, Size=1, InitialValue=FALSE, Min=0, Max=1, Units=Cnt, ReadIn2msRunnable=true
          MotBackEmfVltg: WrittenInMotCtrlRunnable=false, ReadInMotCtrlRunnable=true, ReadIn2msRunnable=false, ImplementationDataType=float32, Size=1, InitialValue=0.0F, Min=-101.25, Max=101.25, Units=Volt, WrittenIn2msRunnable=false
          MotInduDaxEstimdIvs: WrittenInMotCtrlRunnable=false, ReadInMotCtrlRunnable=true, WrittenIn2msRunnable=false, ReadIn2msRunnable=false, ImplementationDataType=float32, Size=1, Min=2440, Max=33334, Units=IvsHenry, InitialValue=8412.0F
          MotInduQaxEstimdIvs: WrittenInMotCtrlRunnable=false, ReadInMotCtrlRunnable=true, WrittenIn2msRunnable=false, ReadIn2msRunnable=false, ImplementationDataType=float32, Size=1, Min=2440, Max=33334, Units=IvsHenry, InitialValue=8412.0F
          MotREstimd: WrittenInMotCtrlRunnable=false, ReadInMotCtrlRunnable=true, WrittenIn2msRunnable=true, ReadIn2msRunnable=true, ImplementationDataType=float32, Size=1, InitialValue=0.005F, Min=0.005, Max=0.12565, Units=Ohm
          MotAgMeclCorrlnSts: WrittenInMotCtrlRunnable=false, ReadInMotCtrlRunnable=true, WrittenIn2msRunnable=false, ReadIn2msRunnable=false, ImplementationDataType=uint8, Size=1, InitialValue=3U, Min=0, Max=3, Units=Cnt
        MotAgMeclCorrlnStMap (SignalMapping): OutputSignalName=MotAgMeclCorrlnSt, InputSignalName=MotAgMeclCorrlnSts
        4 x Signal, all with Size=1:
          MotAg0Offs: WrittenInMotCtrlRunnable=false, ReadInMotCtrlRunnable=true, WrittenIn2msRunnable=true, ReadIn2msRunnable=false, ImplementationDataType=sint32, InitialValue=0, Min=-2147483648, Max=2147483647, Units=Cnt
          MotAg1Offs: WrittenInMotCtrlRunnable=false, ReadInMotCtrlRunnable=true, WrittenIn2msRunnable=true, ReadIn2msRunnable=false, ImplementationDataType=sint32, InitialValue=0, Min=-2147483648, Max=2147483647, Units=Cnt
          MotVltgDaxFild: WrittenInMotCtrlRunnable=true, ReadInMotCtrlRunnable=false, WrittenIn2msRunnable=false, ReadIn2msRunnable=true, ImplementationDataType=float32, InitialValue=0.0F, Min=-26.5, Max=26.5, Units=Volt
          MotVltgQaxFild: WrittenInMotCtrlRunnable=true, ReadInMotCtrlRunnable=false, WrittenIn2msRunnable=false, ReadIn2msRunnable=true, ImplementationDataType=float32, InitialValue=0.0F, Min=-26.5, Max=26.5, Units=Volt
      RunnableManagement:
        IncludeHeaders = CDD_GmG2kcaMcuCfg.h
        IncludeHeaders = CDD_TSG31CfgAndUse.h
        IncludeHeaders = CDD_CurrMeas.h
        IncludeHeaders = CDD_CurrMeasArbn.h
        IncludeHeaders = CDD_MotAgArbn.h
        IncludeHeaders = CDD_MotCurrRegVltgLimr.h
        IncludeHeaders = CDD_MotVel.h
        IncludeHeaders = CDD_MotAg0Meas.h
        IncludeHeaders = CDD_MotAgCmp.h
        IncludeHeaders = CDD_SinVltgGenn.h
        IncludeHeaders = CDD_MotAg1Meas.h
        IncludeHeaders = CDD_MotRplCoggCmd.h
        IncludeHeaders = CDD_McuDiagc.h
        IncludeHeaders = CDD_Adc0CfgAndUse.h
        IncludeHeaders = CurrReasbnDiagc.h
        16 x Runnable:
          TSG31CfgAndUsePer1: RunnableRate=MotorControl, SequenceOrder=14
          CurrMeasPer2: RunnableRate=MotorControlx2, SequenceOrder=6
          CurrMeasArbnPer1: RunnableRate=MotorControlx2, SequenceOrder=7
          MotAgArbnPer1: RunnableRate=MotorControl, SequenceOrder=3
          MotCurrRegVltgLimrPer1: RunnableRate=MotorControlx2, SequenceOrder=9
          MotVelPer1: RunnableRate=MotorControl, SequenceOrder=16
          MotAg0MeasPer1: RunnableRate=MotorControl, SequenceOrder=1
          MotAgCmpPer1: RunnableRate=MotorControl, SequenceOrder=4
          SinVltgGennPer1: RunnableRate=MotorControl, SequenceOrder=13
          SinVltgGennPer2: RunnableRate=MotorControl, SequenceOrder=15
          MotAg1MeasPer1: RunnableRate=MotorControl, SequenceOrder=2
          MotRplCoggCmdPer1: RunnableRate=MotorControlx2, SequenceOrder=8
          McuDiagcPer1: RunnableRate=MotorControlx2, SequenceOrder=10
          Adc0CfgAndUsePer1: RunnableRate=MotorControlx2, SequenceOrder=11
          GmG2kcaMcuCfgPer1: RunnableRate=MotorControl, SequenceOrder=5
          CurrReasbnDiagcPer1: RunnableRate=MotorControlx2, SequenceOrder=12
