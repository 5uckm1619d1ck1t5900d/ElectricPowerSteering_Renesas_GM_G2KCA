AUTOSAR XML (schema 4-0-3)
package /ActiveEcuC
  module config NvMProxy: implementation-config-variant=VARIANT-PRE-COMPILE, module-description=NvMProxy_Impl
    NvMProxyCommon: NvmProxyIncludes=DiagcMgr.h, NvMOsApplicationRef=Appl10
    63 x NvMProxyBlkSet:
      MotPrmNom: NvMBlkFlt=None, NvMProxyApplCallCbk=NULL_PTR, NvMBlkRef=MotPrmNom
      NvMConfigBlock: NvMBlkFlt=None, NvMProxyApplCallCbk=NULL_PTR, NvMBlkRef=NvMConfigBlock
      PolarityCfgSaved: NvMBlkFlt=NTC_0x0A, NvMProxyApplCallCbk=NULL_PTR, NvMBlkRef=PolarityCfgSaved
      Rte_NvmBlock_CDD_CurrMeas_CurrMeasEolGainCalSet: NvMBlkFlt=None, NvMProxyApplCallCbk=NULL_PTR, NvMBlkRef=Rte_NvmBlock_CDD_CurrMeas_CurrMeasEolGainCalSet
      Rte_NvmBlock_CDD_CurrMeas_CurrMeasEolOffsCalSet: NvMBlkFlt=None, NvMProxyApplCallCbk=NULL_PTR, NvMBlkRef=Rte_NvmBlock_CDD_CurrMeas_CurrMeasEolOffsCalSet
      Rte_NvmBlock_CDD_HwTq{0..3}Meas_HwTq{0..3}Offs: NvMBlkFlt=None, NvMProxyApplCallCbk=NULL_PTR, NvMBlkRef=Rte_NvmBlock_CDD_HwTq{0..3}Meas_HwTq{0..3}Offs
      Rte_NvmBlock_CDD_MotAg0Meas_MotAg0CoeffTbl: NvMBlkFlt=None, NvMProxyApplCallCbk=NULL_PTR, NvMBlkRef=Rte_NvmBlock_CDD_MotAg0Meas_MotAg0CoeffTbl
      Rte_NvmBlock_CDD_MotAg1Meas_MotAg1CoeffTbl: NvMBlkFlt=None, NvMProxyApplCallCbk=NULL_PTR, NvMBlkRef=Rte_NvmBlock_CDD_MotAg1Meas_MotAg1CoeffTbl
      Rte_NvmBlock_CDD_MotAgCmp_MotAgCmpMotAgBackEmf: NvMBlkFlt=NTC_0x0A, NvMProxyApplCallCbk=NULL_PTR, NvMBlkRef=Rte_NvmBlock_CDD_MotAgCmp_MotAgCmpMotAgBackEmf
      Rte_NvmBlock_CmnMfgSrv_CcaHwPartNr: NvMBlkFlt=None, NvMProxyApplCallCbk=NULL_PTR, NvMBlkRef=Rte_NvmBlock_CmnMfgSrv_CcaHwPartNr
      Rte_NvmBlock_CmnMfgSrv_CcaSerlNr: NvMBlkFlt=None, NvMProxyApplCallCbk=NULL_PTR, NvMBlkRef=Rte_NvmBlock_CmnMfgSrv_CcaSerlNr
      Rte_NvmBlock_CmnMfgSrv_DiRestore: NvMBlkFlt=None, NvMProxyApplCallCbk=NULL_PTR, NvMBlkRef=Rte_NvmBlock_CmnMfgSrv_DiRestore
      Rte_NvmBlock_CmnMfgSrv_EpsSysSerlNr: NvMBlkFlt=None, NvMProxyApplCallCbk=NULL_PTR, NvMBlkRef=Rte_NvmBlock_CmnMfgSrv_EpsSysSerlNr
      Rte_NvmBlock_CmnMfgSrv_MfgTmpBuf{0..4}: NvMBlkFlt=None, NvMProxyApplCallCbk=NULL_PTR, NvMBlkRef=Rte_NvmBlock_CmnMfgSrv_MfgTmpBuf{0..4}
      Rte_NvmBlock_DiagcMgr_DiagcMgrNtcFltAry: NvMBlkFlt=None, NvMProxyApplCallCbk=RestoreNtcFltAryDft, NvMBlkRef=Rte_NvmBlock_DiagcMgr_DiagcMgrNtcFltAry
      Rte_NvmBlock_DutyCycThermProtn_FilStVal: NvMBlkFlt=None, NvMProxyApplCallCbk=NULL_PTR, NvMBlkRef=Rte_NvmBlock_DutyCycThermProtn_FilStVal
      Rte_NvmBlock_EotLrng_EotNvmData: NvMBlkFlt=None, NvMProxyApplCallCbk=NULL_PTR, NvMBlkRef=Rte_NvmBlock_EotLrng_EotNvmData
      Rte_NvmBlock_HwAg0Meas_HwAg0Offs: NvMBlkFlt=None, NvMProxyApplCallCbk=NULL_PTR, NvMBlkRef=Rte_NvmBlock_HwAg0Meas_HwAg0Offs
      Rte_NvmBlock_HwAg1Meas_HwAg1Offs: NvMBlkFlt=None, NvMProxyApplCallCbk=NULL_PTR, NvMBlkRef=Rte_NvmBlock_HwAg1Meas_HwAg1Offs
      Rte_NvmBlock_HwTqCorrln_HwTqChACmnModCmpLpFilSt: NvMBlkFlt=None, NvMProxyApplCallCbk=NULL_PTR, NvMBlkRef=Rte_NvmBlock_HwTqCorrln_HwTqChACmnModCmpLpFilSt
      Rte_NvmBlock_HwTqCorrln_HwTqChBCmnModCmpLpFilSt: NvMBlkFlt=None, NvMProxyApplCallCbk=NULL_PTR, NvMBlkRef=Rte_NvmBlock_HwTqCorrln_HwTqChBCmnModCmpLpFilSt
      Rte_NvmBlock_NvMProxy_NvMProxyClsChkBlk: NvMBlkFlt=None, NvMProxyApplCallCbk=NULL_PTR, NvMBlkRef=Rte_NvmBlock_NvMProxy_ShtdwnClsChk
      Rte_NvmBlock_PartNr_PartNrBasMdlPartNr: NvMBlkFlt=None, NvMProxyApplCallCbk=NULL_PTR, NvMBlkRef=Rte_NvmBlock_PartNr_PartNrBasMdlPartNr
      Rte_NvmBlock_PartNr_PartNrCalProgdSts: NvMBlkFlt=None, NvMProxyApplCallCbk=NULL_PTR, NvMBlkRef=Rte_NvmBlock_PartNr_PartNrCalProgdSts
      Rte_NvmBlock_PartNr_PartNrCcaMfgTrakg: NvMBlkFlt=None, NvMProxyApplCallCbk=NULL_PTR, NvMBlkRef=Rte_NvmBlock_PartNr_PartNrCcaMfgTrakg
      Rte_NvmBlock_PartNr_PartNrCtrlPidSeedKey: NvMBlkFlt=None, NvMProxyApplCallCbk=NULL_PTR, NvMBlkRef=Rte_NvmBlock_PartNr_PartNrCtrlPidSeedKey
      Rte_NvmBlock_PartNr_PartNrCustMfgEnaCntr: NvMBlkFlt=None, NvMProxyApplCallCbk=NULL_PTR, NvMBlkRef=Rte_NvmBlock_PartNr_PartNrCustMfgEnaCntr
      Rte_NvmBlock_PartNr_PartNrDataUniversalNrSysId: NvMBlkFlt=None, NvMProxyApplCallCbk=NULL_PTR, NvMBlkRef=Rte_NvmBlock_PartNr_PartNrDataUniversalNrSysId
      Rte_NvmBlock_PartNr_PartNrEndMdlPartNr: NvMBlkFlt=None, NvMProxyApplCallCbk=NULL_PTR, NvMBlkRef=Rte_NvmBlock_PartNr_PartNrEndMdlPartNr
      Rte_NvmBlock_PartNr_PartNrNxtrMfgTrakg: NvMBlkFlt=None, NvMProxyApplCallCbk=NULL_PTR, NvMBlkRef=Rte_NvmBlock_PartNr_PartNrNxtrMfgTrakg
      Rte_NvmBlock_PartNr_PartNrProgmDate: NvMBlkFlt=None, NvMProxyApplCallCbk=NULL_PTR, NvMBlkRef=Rte_NvmBlock_PartNr_PartNrProgmDate
      Rte_NvmBlock_PartNr_PartNrProgmSessionSeedKey: NvMBlkFlt=None, NvMProxyApplCallCbk=NULL_PTR, NvMBlkRef=Rte_NvmBlock_PartNr_PartNrProgmSessionSeedKey
      Rte_NvmBlock_PartNr_PartNrRepairShopCod: NvMBlkFlt=None, NvMProxyApplCallCbk=NULL_PTR, NvMBlkRef=Rte_NvmBlock_PartNr_PartNrRepairShopCod
      Rte_NvmBlock_PartNr_PartNrSysCodVersNr: NvMBlkFlt=None, NvMProxyApplCallCbk=NULL_PTR, NvMBlkRef=Rte_NvmBlock_PartNr_PartNrSysCodVersNr
      Rte_NvmBlock_PartNr_PartNrSysName: NvMBlkFlt=None, NvMProxyApplCallCbk=NULL_PTR, NvMBlkRef=Rte_NvmBlock_PartNr_PartNrSysName
      Rte_NvmBlock_PartNr_PartNrVinData: NvMBlkFlt=None, NvMProxyApplCallCbk=NULL_PTR, NvMBlkRef=Rte_NvmBlock_PartNr_PartNrVinData
      Rte_NvmBlock_PullCmpActv_PullCmpLongTerm: NvMBlkFlt=None, NvMProxyApplCallCbk=NULL_PTR, NvMBlkRef=Rte_NvmBlock_PullCmpActv_PullCmpLongTerm
      Rte_NvmBlock_SnsrOffsLrng_SnsrOffsLrnd: NvMBlkFlt=None, NvMProxyApplCallCbk=NULL_PTR, NvMBlkRef=Rte_NvmBlock_SnsrOffsLrng_SnsrOffsLrnd
      Rte_NvmBlock_GmOvrlStMgr_GmLoaIgnCntr: NvMBlkFlt=None, NvMProxyApplCallCbk=NULL_PTR, NvMBlkRef=Rte_NvmBlock_GmOvrlStMgr_GmLoaIgnCntr
      Rte_NvmBlock_MotRplCoggCfg_MotRplCoggPrm: NvMBlkFlt=None, NvMProxyApplCallCbk=NULL_PTR, NvMBlkRef=Rte_NvmBlock_MotRplCoggCfg_MotRplCoggPrm
      Rte_NvmBlock_CDD_MotRplCoggCmd_MotCoggCmdY: NvMBlkFlt=None, NvMProxyApplCallCbk=NULL_PTR, NvMBlkRef=Rte_NvmBlock_CDD_MotRplCoggCmd_MotCoggCmdY
      Rte_NvmBlock_StHlthSigStc_SigStcHistDataAry: NvMBlkFlt=None, NvMProxyApplCallCbk=NULL_PTR, NvMBlkRef=Rte_NvmBlock_StHlthSigStc_SigStcHistDataAry
      Rte_NvmBlock_WhlImbRejctn_MaxCompPerc: NvMBlkFlt=None, NvMProxyApplCallCbk=NULL_PTR, NvMBlkRef=Rte_NvmBlock_WhlImbRejctn_MaxCompPerc
      Rte_NvmBlock_WhlImbRejctn_ActvCmpBand3: NvMBlkFlt=None, NvMProxyApplCallCbk=NULL_PTR, NvMBlkRef=Rte_NvmBlock_WhlImbRejctn_ActvCmpBand3
      Rte_NvmBlock_WhlImbRejctn_ActvCmpBand1: NvMBlkFlt=None, NvMProxyApplCallCbk=NULL_PTR, NvMBlkRef=Rte_NvmBlock_WhlImbRejctn_ActvCmpBand1
      Rte_NvmBlock_WhlImbRejctn_RiPeakPrev: NvMBlkFlt=None, NvMProxyApplCallCbk=NULL_PTR, NvMBlkRef=Rte_NvmBlock_WhlImbRejctn_RiPeakPrev
      Rte_NvmBlock_WhlImbRejctn_LePeakPrev: NvMBlkFlt=None, NvMProxyApplCallCbk=NULL_PTR, NvMBlkRef=Rte_NvmBlock_WhlImbRejctn_LePeakPrev
      Rte_NvmBlock_WhlImbRejctn_ActvCmpBand2: NvMBlkFlt=None, NvMProxyApplCallCbk=NULL_PTR, NvMBlkRef=Rte_NvmBlock_WhlImbRejctn_ActvCmpBand2
      Rte_NvmBlock_HwAgVehCentrTrim_HwAgTrimData: NvMBlkFlt=None, NvMProxyApplCallCbk=NULL_PTR, NvMBlkRef=Rte_NvmBlock_HwAgVehCentrTrim_HwAgTrimData
      Rte_NvmBlock_Bootloader_EcuId: NvMBlkFlt=None, NvMProxyApplCallCbk=NULL_PTR, NvMBlkRef=Rte_NvmBlock_Bootloader_EcuId
      Rte_NvmBlock_Bootloader_SBAT: NvMBlkFlt=None, NvMProxyApplCallCbk=NULL_PTR, NvMBlkRef=Rte_NvmBlock_Bootloader_SBAT
      Rte_NvmBlock_CustDiagc_GmIgnCntr: NvMBlkFlt=None, NvMProxyApplCallCbk=NULL_PTR, NvMBlkRef=Rte_NvmBlock_CustDiagc_GmIgnCntr
      Rte_NvmBlock_GmMsg778BusHiSpd_DtcTrigStsAry: NvMBlkFlt=None, NvMProxyApplCallCbk=NULL_PTR, NvMBlkRef=Rte_NvmBlock_GmMsg778BusHiSpd_DtcTrigStsAry
      Rte_NvmBlock_DiagcMgr_SnpshtDataAry: NvMBlkFlt=None, NvMProxyApplCallCbk=RestoreSnpshtAryDft, NvMBlkRef=Rte_NvmBlock_DiagcMgr_SnpshtDataAry
      Rte_NvmBlock_HwAgSnsrls_StordLstPrm: NvMBlkFlt=None, NvMProxyApplCallCbk=NULL_PTR, NvMBlkRef=Rte_NvmBlock_HwAgSnsrls_StordLstPrm
      Rte_NvmBlock_EotLrng_MaxHwAgCwAndCcw: NvMBlkFlt=None, NvMProxyApplCallCbk=NULL_PTR, NvMBlkRef=Rte_NvmBlock_EotLrng_MaxHwAgCwAndCcw
