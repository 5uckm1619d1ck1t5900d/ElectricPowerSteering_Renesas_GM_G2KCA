AUTOSAR XML (schema 4-0-3)
package /ActiveEcuC
  module config NxtrSwIds: implementation-config-variant=VARIANT-PRE-COMPILE
    NxtrSwIdsGeneral: SwRelNr=G2KCA, SwRelVer=01.01.00, PrototypeBuild=false, PsrId=974, PsrRev=A
