AUTOSAR XML (schema 4-0-3)
package /ActiveEcuC
  module config Port: implementation-config-variant=VARIANT-POST-BUILD-LOADABLE, module-description=Port_Impl
    PortConfigSet
      PortContainer: PortNumberOfPortPins=1
        PortPin:
          PortPinDirection = PORT_PIN_IN
          PortPinDirectionChangeable = false
          PortPinId = 1
          PortPinInitialMode = PORT_PIN_MODE_ADC
          PortPinLevelValue = PORT_PIN_LEVEL_HIGH
          PortPinMode = PORT_PIN_MODE_ADC
          PortPinModeChangeable = false
      PortFilterGroupConfig
        PortDigitalFilterGroup20: PortSameLevelSamples=TWO_SAMPLES, PortSamplingClockFrequency=DNFATCKI_DIV_BY_1, PortDigitalFilterEnableInput0=BYPASSED
        PortDigitalFilterGroup21: PortSameLevelSamples=TWO_SAMPLES, PortSamplingClockFrequency=DNFATCKI_DIV_BY_1, PortDigitalFilterEnableInput0=BYPASSED
        PortDigitalFilterGroup{23..26}: PortSameLevelSamples=TWO_SAMPLES, PortSamplingClockFrequency=DNFATCKI_DIV_BY_1, PortDigitalFilterEnableInput0=BYPASSED
        PortDigitalFilterGroup32:
          PortSameLevelSamples = TWO_SAMPLES
          PortSamplingClockFrequency = DNFATCKI_DIV_BY_1
          PortDigitalFilterEnableInput0 = BYPASSED
          PortDigitalFilterEnableInput1 = BYPASSED
        PortDigitalFilterGroup35:
          PortSameLevelSamples = TWO_SAMPLES
          PortSamplingClockFrequency = DNFATCKI_DIV_BY_1
          PortDigitalFilterEnableInput0 = BYPASSED
          PortDigitalFilterEnableInput1 = BYPASSED
      PortGroup0
        PortPin0:
          PortPinDirectionChangeable = false
          PortPinDioAltModeChangeable = false
          PortPinModeChangeable = false
          PortPinLevelValue = PORT_PIN_LEVEL_LOW
          PortPinInitialMode = TAUJ0I1_ALT1_IN
          PortPinDirection = PORT_PIN_IN
          PortInputBufferControl = false
          PortBiDirectionControl = false
          PortPullUpOption = false
          PortPullDownOption = false
          PortOpenDrainControl_Expansion = OpenDrain_N_Channel
          PortOutputLevelInversion = false
          PortDriveStrengthControl = SLOW
          PortUnlimitedCurrentControl = SLOW
        PortPin1:
          PortPinDirectionChangeable = false
          PortPinDioAltModeChangeable = false
          PortPinModeChangeable = true
          PortPinLevelValue = PORT_PIN_LEVEL_HIGH
          PortPinInitialMode = DIO
          PortPinDirection = PORT_PIN_IN
          PortInputBufferControl = false
          PortBiDirectionControl = true
          PortPullUpOption = false
          PortPullDownOption = false
          PortOpenDrainControl_Expansion = OpenDrain_N_Channel
          PortOutputLevelInversion = false
          PortDriveStrengthControl = SLOW
          PortUnlimitedCurrentControl = SLOW
        PortPin2:
          PortPinDirectionChangeable = false
          PortPinDioAltModeChangeable = false
          PortPinModeChangeable = false
          PortPinLevelValue = PORT_PIN_LEVEL_LOW
          PortPinInitialMode = SCI30RX_ALT1_IN
          PortPinDirection = PORT_PIN_IN
          PortInputBufferControl = false
          PortBiDirectionControl = false
          PortPullUpOption = true
          PortPullDownOption = false
          PortOpenDrainControl_Expansion = OpenDrain_N_Channel
          PortOutputLevelInversion = false
          PortDriveStrengthControl = SLOW
          PortUnlimitedCurrentControl = SLOW
        PortPin3:
          PortPinDirectionChangeable = false
          PortPinDioAltModeChangeable = false
          PortPinModeChangeable = false
          PortPinLevelValue = PORT_PIN_LEVEL_LOW
          PortPinInitialMode = DIO
          PortPinDirection = PORT_PIN_IN
          PortInputBufferControl = false
          PortBiDirectionControl = false
          PortPullUpOption = false
          PortPullDownOption = false
          PortOpenDrainControl_Expansion = OpenDrain_N_Channel
          PortOutputLevelInversion = false
          PortDriveStrengthControl = SLOW
          PortUnlimitedCurrentControl = SLOW
          PortInputSelection = TYPE_1_SUPP_PISA
        PortPin4:
          PortPinDirectionChangeable = false
          PortPinDioAltModeChangeable = false
          PortPinModeChangeable = false
          PortPinLevelValue = PORT_PIN_LEVEL_LOW
          PortPinInitialMode = DIO
          PortPinDirection = PORT_PIN_IN
          PortInputBufferControl = false
          PortBiDirectionControl = false
          PortPullUpOption = false
          PortPullDownOption = false
          PortOpenDrainControl_Expansion = OpenDrain_N_Channel
          PortOutputLevelInversion = false
          PortDriveStrengthControl = SLOW
          PortUnlimitedCurrentControl = SLOW
          PortInputSelection = TYPE_1_SUPP_PISA
        PortPin5:
          PortPinDirectionChangeable = false
          PortPinDioAltModeChangeable = false
          PortPinModeChangeable = false
          PortPinLevelValue = PORT_PIN_LEVEL_LOW
          PortPinInitialMode = DIO
          PortPinDirection = PORT_PIN_IN
          PortInputBufferControl = false
          PortBiDirectionControl = false
          PortPullUpOption = false
          PortPullDownOption = false
          PortOpenDrainControl_Expansion = OpenDrain_N_Channel
          PortOutputLevelInversion = false
          PortDriveStrengthControl = SLOW
          PortUnlimitedCurrentControl = SLOW
          PortInputSelection = TYPE_1_SUPP_PISA
        PortPin6:
          PortPinDirectionChangeable = false
          PortPinDioAltModeChangeable = false
          PortPinModeChangeable = false
          PortPinLevelValue = PORT_PIN_LEVEL_LOW
          PortPinInitialMode = DIO
          PortPinDirection = PORT_PIN_IN
          PortInputBufferControl = false
          PortBiDirectionControl = false
          PortPullUpOption = false
          PortPullDownOption = false
          PortOpenDrainControl_Expansion = OpenDrain_N_Channel
          PortOutputLevelInversion = false
          PortDriveStrengthControl = SLOW
          PortUnlimitedCurrentControl = SLOW
          PortInputSelection = TYPE_1_SUPP_PISA
        PortPin7:
          PortPinDirectionChangeable = false
          PortPinDioAltModeChangeable = false
          PortPinModeChangeable = false
          PortPinLevelValue = PORT_PIN_LEVEL_LOW
          PortPinInitialMode = DIO
          PortPinDirection = PORT_PIN_IN
          PortInputBufferControl = false
          PortBiDirectionControl = false
          PortPullUpOption = false
          PortPullDownOption = false
          PortOpenDrainControl_Expansion = OpenDrain_N_Channel
          PortOutputLevelInversion = false
          PortDriveStrengthControl = SLOW
          PortUnlimitedCurrentControl = SLOW
          PortInputSelection = TYPE_1_SUPP_PISA
        PortPin8:
          PortPinDirectionChangeable = false
          PortPinDioAltModeChangeable = false
          PortPinModeChangeable = false
          PortPinLevelValue = PORT_PIN_LEVEL_LOW
          PortPinInitialMode = DIO
          PortPinDirection = PORT_PIN_IN
          PortInputBufferControl = true
          PortBiDirectionControl = false
          PortPullUpOption = false
          PortPullDownOption = false
          PortOpenDrainControl_Expansion = OpenDrain_PushPull
          PortOutputLevelInversion = false
          PortDriveStrengthControl = SLOW
          PortUnlimitedCurrentControl = SLOW
          PortInputSelection = TYPE_1_SUPP_PISA
        PortPin9:
          PortPinDirectionChangeable = false
          PortPinDioAltModeChangeable = false
          PortPinModeChangeable = false
          PortPinLevelValue = PORT_PIN_LEVEL_LOW
          PortPinInitialMode = DIO
          PortPinDirection = PORT_PIN_IN
          PortInputBufferControl = false
          PortBiDirectionControl = false
          PortPullUpOption = false
          PortPullDownOption = false
          PortOpenDrainControl_Expansion = OpenDrain_N_Channel
          PortOutputLevelInversion = false
          PortDriveStrengthControl = SLOW
          PortUnlimitedCurrentControl = SLOW
          PortInputSelection = TYPE_1_SUPP_PISA
        PortPin10:
          PortPinDirectionChangeable = false
          PortPinDioAltModeChangeable = false
          PortPinModeChangeable = false
          PortPinLevelValue = PORT_PIN_LEVEL_LOW
          PortPinInitialMode = DIO
          PortPinDirection = PORT_PIN_IN
          PortInputBufferControl = false
          PortBiDirectionControl = false
          PortPullUpOption = false
          PortPullDownOption = false
          PortOpenDrainControl_Expansion = OpenDrain_PushPull
          PortOutputLevelInversion = false
          PortDriveStrengthControl = SLOW
          PortUnlimitedCurrentControl = SLOW
        PortPin11:
          PortPinDirectionChangeable = false
          PortPinDioAltModeChangeable = false
          PortPinModeChangeable = false
          PortPinLevelValue = PORT_PIN_LEVEL_LOW
          PortPinInitialMode = DIO
          PortPinDirection = PORT_PIN_IN
          PortInputBufferControl = false
          PortBiDirectionControl = false
          PortPullUpOption = false
          PortPullDownOption = false
          PortOpenDrainControl_Expansion = OpenDrain_PushPull
          PortOutputLevelInversion = false
          PortDriveStrengthControl = SLOW
          PortUnlimitedCurrentControl = SLOW
        PortPin12:
          PortPinDirectionChangeable = false
          PortPinDioAltModeChangeable = false
          PortPinModeChangeable = false
          PortPinLevelValue = PORT_PIN_LEVEL_LOW
          PortPinInitialMode = DIO
          PortPinDirection = PORT_PIN_IN
          PortInputBufferControl = false
          PortBiDirectionControl = false
          PortPullUpOption = false
          PortPullDownOption = false
          PortOpenDrainControl_Expansion = OpenDrain_PushPull
          PortOutputLevelInversion = false
          PortDriveStrengthControl = SLOW
          PortUnlimitedCurrentControl = SLOW
        PortPin13:
          PortPinDirectionChangeable = false
          PortPinDioAltModeChangeable = false
          PortPinModeChangeable = false
          PortPinLevelValue = PORT_PIN_LEVEL_HIGH
          PortPinInitialMode = DIO
          PortPinDirection = PORT_PIN_OUT
          PortInputBufferControl = false
          PortBiDirectionControl = false
          PortPullUpOption = false
          PortPullDownOption = false
          PortOpenDrainControl_Expansion = OpenDrain_PushPull
          PortOutputLevelInversion = false
          PortDriveStrengthControl = SLOW
          PortUnlimitedCurrentControl = SLOW
          PortInputSelection = TYPE_1_SUPP_PISA
        PortPin14:
          PortPinDirectionChangeable = false
          PortPinDioAltModeChangeable = false
          PortPinModeChangeable = false
          PortPinLevelValue = PORT_PIN_LEVEL_LOW
          PortPinInitialMode = DIO
          PortPinDirection = PORT_PIN_IN
          PortInputBufferControl = true
          PortBiDirectionControl = false
          PortPullUpOption = false
          PortPullDownOption = false
          PortOpenDrainControl_Expansion = OpenDrain_N_Channel
          PortOutputLevelInversion = false
          PortDriveStrengthControl = SLOW
          PortUnlimitedCurrentControl = SLOW
      PortGroup1
        PortPin0:
          PortPinDirectionChangeable = false
          PortPinDioAltModeChangeable = false
          PortPinModeChangeable = false
          PortPinLevelValue = PORT_PIN_LEVEL_LOW
          PortPinInitialMode = DIO
          PortPinDirection = PORT_PIN_IN
          PortInputBufferControl = false
          PortBiDirectionControl = false
          PortPullUpOption = false
          PortPullDownOption = false
          PortOpenDrainControl_Expansion = OpenDrain_N_Channel
          PortOutputLevelInversion = false
          PortDriveStrengthControl = SLOW
          PortUnlimitedCurrentControl = SLOW
        PortPin1:
          PortPinDirectionChangeable = false
          PortPinDioAltModeChangeable = false
          PortPinModeChangeable = false
          PortPinLevelValue = PORT_PIN_LEVEL_LOW
          PortPinInitialMode = CSIH2CSS0_ALT4_OUT
          PortPinDirection = PORT_PIN_OUT
          PortInputBufferControl = false
          PortBiDirectionControl = false
          PortPullUpOption = false
          PortPullDownOption = false
          PortOpenDrainControl_Expansion = OpenDrain_PushPull
          PortOutputLevelInversion = false
          PortDriveStrengthControl = SLOW
          PortUnlimitedCurrentControl = SLOW
          PortInputSelection = TYPE_1_SUPP_PISA
        PortPin2:
          PortPinDirectionChangeable = false
          PortPinDioAltModeChangeable = false
          PortPinModeChangeable = false
          PortPinLevelValue = PORT_PIN_LEVEL_LOW
          PortPinInitialMode = CSIH2SI_ALT4_IN
          PortPinDirection = PORT_PIN_IN
          PortInputBufferControl = false
          PortBiDirectionControl = false
          PortPullUpOption = false
          PortPullDownOption = false
          PortOpenDrainControl_Expansion = OpenDrain_N_Channel
          PortOutputLevelInversion = false
          PortDriveStrengthControl = SLOW
          PortUnlimitedCurrentControl = SLOW
          PortInputSelection = TYPE_1_SUPP_PISA
        PortPin3:
          PortPinDirectionChangeable = false
          PortPinDioAltModeChangeable = false
          PortPinModeChangeable = false
          PortPinLevelValue = PORT_PIN_LEVEL_LOW
          PortPinInitialMode = CSIH2SO_ALT4_OUT
          PortPinDirection = PORT_PIN_OUT
          PortInputBufferControl = false
          PortBiDirectionControl = false
          PortIpControl = false
          PortPullUpOption = false
          PortPullDownOption = false
          PortOpenDrainControl_Expansion = OpenDrain_PushPull
          PortOutputLevelInversion = false
          PortDriveStrengthControl = SLOW
          PortUnlimitedCurrentControl = SLOW
          PortInputSelection = TYPE_1_SUPP_PISA
        PortPin4:
          PortPinDirectionChangeable = false
          PortPinDioAltModeChangeable = false
          PortPinModeChangeable = false
          PortPinLevelValue = PORT_PIN_LEVEL_LOW
          PortPinInitialMode = CSIH3SCO_ALT6_OUT
          PortPinDirection = PORT_PIN_OUT
          PortInputBufferControl = false
          PortBiDirectionControl = false
          PortIpControl = false
          PortPullUpOption = false
          PortPullDownOption = false
          PortOpenDrainControl_Expansion = OpenDrain_PushPull
          PortOutputLevelInversion = false
          PortDriveStrengthControl = SLOW
          PortUnlimitedCurrentControl = SLOW
          PortInputSelection = TYPE_1_SUPP_PISA
      PortGroup2
        PortPin0:
          PortPinDirectionChangeable = false
          PortPinDioAltModeChangeable = false
          PortPinModeChangeable = false
          PortPinLevelValue = PORT_PIN_LEVEL_LOW
          PortPinInitialMode = RSCAN0RX0_ALT1_IN
          PortPinDirection = PORT_PIN_IN
          PortInputBufferControl = false
          PortBiDirectionControl = false
          PortPullUpOption = false
          PortPullDownOption = false
          PortOpenDrainControl_Expansion = OpenDrain_N_Channel
          PortOutputLevelInversion = false
          PortDriveStrengthControl = SLOW
          PortUnlimitedCurrentControl = SLOW
          PortInputSelection = TYPE_1_SUPP_PISA
        PortPin1:
          PortPinDirectionChangeable = false
          PortPinDioAltModeChangeable = false
          PortPinModeChangeable = false
          PortPinLevelValue = PORT_PIN_LEVEL_HIGH
          PortPinInitialMode = RSCAN0TX0_ALT1_OUT
          PortPinDirection = PORT_PIN_OUT
          PortInputBufferControl = false
          PortBiDirectionControl = false
          PortIpControl = false
          PortPullUpOption = false
          PortPullDownOption = false
          PortOpenDrainControl_Expansion = OpenDrain_PushPull
          PortOutputLevelInversion = false
          PortDriveStrengthControl = SLOW
          PortUnlimitedCurrentControl = SLOW
          PortInputSelection = TYPE_1_SUPP_PISA
        PortPin2:
          PortPinDirectionChangeable = false
          PortPinDioAltModeChangeable = false
          PortPinModeChangeable = false
          PortPinLevelValue = PORT_PIN_LEVEL_LOW
          PortPinInitialMode = CSIH2SCO_ALT2_OUT
          PortPinDirection = PORT_PIN_OUT
          PortInputBufferControl = false
          PortBiDirectionControl = false
          PortIpControl = false
          PortPullUpOption = false
          PortPullDownOption = false
          PortOpenDrainControl_Expansion = OpenDrain_PushPull
          PortOutputLevelInversion = false
          PortDriveStrengthControl = SLOW
          PortUnlimitedCurrentControl = SLOW
          PortInputSelection = TYPE_1_SUPP_PISA
        PortPin3:
          PortPinDirectionChangeable = false
          PortPinDioAltModeChangeable = false
          PortPinModeChangeable = false
          PortPinLevelValue = PORT_PIN_LEVEL_HIGH
          PortPinInitialMode = RSCAN0TX1_ALT1_OUT
          PortPinDirection = PORT_PIN_OUT
          PortInputBufferControl = false
          PortBiDirectionControl = false
          PortIpControl = false
          PortPullUpOption = false
          PortPullDownOption = false
          PortOpenDrainControl_Expansion = OpenDrain_PushPull
          PortOutputLevelInversion = false
          PortDriveStrengthControl = SLOW
          PortUnlimitedCurrentControl = SLOW
        PortPin4:
          PortPinDirectionChangeable = false
          PortPinDioAltModeChangeable = false
          PortPinModeChangeable = false
          PortPinLevelValue = PORT_PIN_LEVEL_HIGH
          PortPinInitialMode = DIO
          PortPinDirection = PORT_PIN_OUT
          PortInputBufferControl = false
          PortBiDirectionControl = false
          PortPullUpOption = false
          PortPullDownOption = false
          PortOpenDrainControl_Expansion = OpenDrain_PushPull
          PortOutputLevelInversion = false
          PortDriveStrengthControl = SLOW
          PortUnlimitedCurrentControl = SLOW
        PortPin5:
          PortPinDirectionChangeable = false
          PortPinDioAltModeChangeable = false
          PortPinModeChangeable = false
          PortPinLevelValue = PORT_PIN_LEVEL_LOW
          PortPinInitialMode = CSIH3SO_ALT4_OUT
          PortPinDirection = PORT_PIN_OUT
          PortInputBufferControl = false
          PortBiDirectionControl = false
          PortIpControl = false
          PortPullUpOption = false
          PortPullDownOption = false
          PortOpenDrainControl_Expansion = OpenDrain_PushPull
          PortOutputLevelInversion = false
          PortDriveStrengthControl = SLOW
          PortUnlimitedCurrentControl = SLOW
          PortInputSelection = TYPE_1_SUPP_PISA
        PortPin6:
          PortPinDirectionChangeable = false
          PortPinDioAltModeChangeable = false
          PortPinModeChangeable = false
          PortPinLevelValue = PORT_PIN_LEVEL_LOW
          PortPinInitialMode = CSIH3SI_ALT4_IN
          PortPinDirection = PORT_PIN_IN
          PortInputBufferControl = false
          PortBiDirectionControl = false
          PortIpControl = false
          PortPullUpOption = false
          PortPullDownOption = false
          PortOpenDrainControl_Expansion = OpenDrain_N_Channel
          PortOutputLevelInversion = false
          PortDriveStrengthControl = SLOW
          PortUnlimitedCurrentControl = SLOW
        PortPin7:
          PortPinDirectionChangeable = false
          PortPinDioAltModeChangeable = false
          PortPinModeChangeable = false
          PortPinLevelValue = PORT_PIN_LEVEL_LOW
          PortPinInitialMode = CSIH1SI_ALT3_IN
          PortPinDirection = PORT_PIN_OUT
          PortInputBufferControl = false
          PortBiDirectionControl = false
          PortIpControl = false
          PortPullUpOption = false
          PortPullDownOption = false
          PortOpenDrainControl_Expansion = OpenDrain_N_Channel
          PortOutputLevelInversion = false
          PortDriveStrengthControl = SLOW
          PortUnlimitedCurrentControl = SLOW
          PortInputSelection = TYPE_1_SUPP_PISA
        PortPin8:
          PortPinDirectionChangeable = false
          PortPinDioAltModeChangeable = false
          PortPinModeChangeable = false
          PortPinLevelValue = PORT_PIN_LEVEL_LOW
          PortPinInitialMode = CSIH1SO_ALT3_OUT
          PortPinDirection = PORT_PIN_OUT
          PortInputBufferControl = false
          PortBiDirectionControl = false
          PortIpControl = false
          PortPullUpOption = false
          PortPullDownOption = false
          PortOpenDrainControl_Expansion = OpenDrain_PushPull
          PortOutputLevelInversion = false
          PortDriveStrengthControl = SLOW
          PortUnlimitedCurrentControl = SLOW
        PortPin9:
          PortPinDirectionChangeable = false
          PortPinDioAltModeChangeable = false
          PortPinModeChangeable = false
          PortPinLevelValue = PORT_PIN_LEVEL_LOW
          PortPinInitialMode = CSIH1SCO_ALT3_OUT
          PortPinDirection = PORT_PIN_OUT
          PortInputBufferControl = false
          PortBiDirectionControl = false
          PortIpControl = false
          PortPullUpOption = false
          PortPullDownOption = false
          PortOpenDrainControl_Expansion = OpenDrain_PushPull
          PortOutputLevelInversion = false
          PortDriveStrengthControl = SLOW
          PortUnlimitedCurrentControl = SLOW
        PortPin10:
          PortPinDirectionChangeable = false
          PortPinDioAltModeChangeable = false
          PortPinModeChangeable = false
          PortPinLevelValue = PORT_PIN_LEVEL_LOW
          PortPinInitialMode = DIO
          PortPinDirection = PORT_PIN_IN
          PortInputBufferControl = false
          PortBiDirectionControl = false
          PortPullUpOption = false
          PortPullDownOption = false
          PortOpenDrainControl_Expansion = OpenDrain_N_Channel
          PortOutputLevelInversion = false
          PortDriveStrengthControl = SLOW
          PortUnlimitedCurrentControl = SLOW
        PortPin11:
          PortPinDirectionChangeable = false
          PortPinDioAltModeChangeable = false
          PortPinModeChangeable = false
          PortPinLevelValue = PORT_PIN_LEVEL_LOW
          PortPinInitialMode = DIO
          PortPinDirection = PORT_PIN_IN
          PortInputBufferControl = false
          PortBiDirectionControl = false
          PortPullUpOption = false
          PortPullDownOption = false
          PortOpenDrainControl_Expansion = OpenDrain_N_Channel
          PortOutputLevelInversion = false
          PortDriveStrengthControl = SLOW
          PortUnlimitedCurrentControl = SLOW
        PortPin12:
          PortPinDirectionChangeable = false
          PortPinDioAltModeChangeable = false
          PortPinModeChangeable = false
          PortPinLevelValue = PORT_PIN_LEVEL_LOW
          PortPinInitialMode = DIO
          PortPinDirection = PORT_PIN_IN
          PortInputBufferControl = false
          PortBiDirectionControl = false
          PortIpControl = false
          PortPullUpOption = false
          PortPullDownOption = false
          PortOpenDrainControl_Expansion = OpenDrain_N_Channel
          PortOutputLevelInversion = false
          PortDriveStrengthControl = SLOW
          PortUnlimitedCurrentControl = SLOW
          PortInputSelection = TYPE_1_SUPP_PISA
        PortPin13:
          PortPinDirectionChangeable = false
          PortPinDioAltModeChangeable = false
          PortPinModeChangeable = false
          PortPinLevelValue = PORT_PIN_LEVEL_LOW
          PortPinInitialMode = DIO
          PortPinDirection = PORT_PIN_IN
          PortInputBufferControl = true
          PortBiDirectionControl = false
          PortPullUpOption = false
          PortPullDownOption = false
          PortOpenDrainControl_Expansion = OpenDrain_N_Channel
          PortOutputLevelInversion = false
          PortDriveStrengthControl = SLOW
          PortUnlimitedCurrentControl = SLOW
        PortPin14:
          PortPinDirectionChangeable = false
          PortPinDioAltModeChangeable = false
          PortPinModeChangeable = false
          PortPinLevelValue = PORT_PIN_LEVEL_LOW
          PortPinInitialMode = DIO
          PortPinDirection = PORT_PIN_IN
          PortInputBufferControl = false
          PortBiDirectionControl = false
          PortPullUpOption = false
          PortPullDownOption = false
          PortOpenDrainControl_Expansion = OpenDrain_N_Channel
          PortOutputLevelInversion = false
          PortDriveStrengthControl = SLOW
          PortUnlimitedCurrentControl = SLOW
        PortPin15:  # Annotation PLAIN_TEXT Not connected
          PortPinDirectionChangeable = false
          PortPinDioAltModeChangeable = false
          PortPinModeChangeable = false
          PortPinLevelValue = PORT_PIN_LEVEL_LOW
          PortPinInitialMode = DIO
          PortPinDirection = PORT_PIN_IN
          PortInputBufferControl = false
          PortBiDirectionControl = false
          PortPullDownOption = false
          PortOpenDrainControl_Expansion = OpenDrain_N_Channel
          PortOutputLevelInversion = false
          PortDriveStrengthControl = SLOW
          PortUnlimitedCurrentControl = SLOW
          PortPullUpOption = false
      PortGroup3
        PortPin0:  # Annotation PLAIN_TEXT Not connected
          PortPinDirectionChangeable = false
          PortPinDioAltModeChangeable = false
          PortPinModeChangeable = false
          PortPinLevelValue = PORT_PIN_LEVEL_LOW
          PortPinInitialMode = DIO
          PortPinDirection = PORT_PIN_IN
          PortInputBufferControl = false
          PortBiDirectionControl = false
          PortIpControl = false
          PortPullUpOption = false
          PortPullDownOption = false
          PortOpenDrainControl_Expansion = OpenDrain_N_Channel
          PortOutputLevelInversion = false
          PortDriveStrengthControl = SLOW
          PortUnlimitedCurrentControl = SLOW
          PortInputSelection = TYPE_1_SUPP_PISA
        PortPin1:  # Annotation PLAIN_TEXT Not connected
          PortPinDirectionChangeable = false
          PortPinDioAltModeChangeable = false
          PortPinModeChangeable = false
          PortPinLevelValue = PORT_PIN_LEVEL_LOW
          PortPinInitialMode = DIO
          PortPinDirection = PORT_PIN_IN
          PortInputBufferControl = false
          PortBiDirectionControl = false
          PortIpControl = false
          PortPullUpOption = false
          PortPullDownOption = false
          PortOpenDrainControl_Expansion = OpenDrain_N_Channel
          PortOutputLevelInversion = false
          PortDriveStrengthControl = SLOW
          PortUnlimitedCurrentControl = SLOW
          PortInputSelection = TYPE_1_SUPP_PISA
        PortPin2:  # Annotation PLAIN_TEXT Not connected
          PortPinDirectionChangeable = false
          PortPinDioAltModeChangeable = false
          PortPinModeChangeable = false
          PortPinLevelValue = PORT_PIN_LEVEL_LOW
          PortPinInitialMode = DIO
          PortPinDirection = PORT_PIN_IN
          PortInputBufferControl = false
          PortBiDirectionControl = false
          PortIpControl = false
          PortPullUpOption = false
          PortPullDownOption = false
          PortOpenDrainControl_Expansion = OpenDrain_N_Channel
          PortOutputLevelInversion = false
          PortDriveStrengthControl = SLOW
          PortUnlimitedCurrentControl = SLOW
        PortPin3:
          PortPinDirectionChangeable = false
          PortPinDioAltModeChangeable = true
          PortPinModeChangeable = true
          PortPinLevelValue = PORT_PIN_LEVEL_LOW
          PortPinInitialMode = CSIH3CSS4_ALT4_OUT
          PortPinDirection = PORT_PIN_OUT
          PortInputBufferControl = false
          PortBiDirectionControl = false
          PortPullUpOption = false
          PortPullDownOption = false
          PortOpenDrainControl_Expansion = OpenDrain_PushPull
          PortOutputLevelInversion = false
          PortDriveStrengthControl = SLOW
          PortUnlimitedCurrentControl = SLOW
        PortPin4:  # Annotation PLAIN_TEXT GTDRV_DIAG
          PortPinDirectionChangeable = false
          PortPinDioAltModeChangeable = false
          PortPinModeChangeable = false
          PortPinLevelValue = PORT_PIN_LEVEL_LOW
          PortPinInitialMode = DIO
          PortPinDirection = PORT_PIN_IN
          PortInputBufferControl = true
          PortBiDirectionControl = false
          PortPullUpOption = false
          PortPullDownOption = false
          PortOpenDrainControl_Expansion = OpenDrain_PushPull
          PortOutputLevelInversion = false
          PortDriveStrengthControl = SLOW
          PortUnlimitedCurrentControl = SLOW
        PortPin5:
          PortPinDirectionChangeable = false
          PortPinDioAltModeChangeable = false
          PortPinModeChangeable = false
          PortPinLevelValue = PORT_PIN_LEVEL_LOW
          PortPinInitialMode = DIO
          PortPinDirection = PORT_PIN_OUT
          PortInputBufferControl = false
          PortBiDirectionControl = false
          PortPullDownOption = false
          PortOpenDrainControl_Expansion = OpenDrain_PushPull
          PortOutputLevelInversion = false
          PortDriveStrengthControl = SLOW
          PortUnlimitedCurrentControl = SLOW
        PortPin6:
          PortPinDirectionChangeable = false
          PortPinDioAltModeChangeable = false
          PortPinModeChangeable = false
          PortPinLevelValue = PORT_PIN_LEVEL_LOW
          PortPinInitialMode = DIO
          PortPinDirection = PORT_PIN_IN
          PortInputBufferControl = true
          PortBiDirectionControl = false
          PortPullUpOption = false
          PortPullDownOption = false
          PortOpenDrainControl_Expansion = OpenDrain_PushPull
          PortOutputLevelInversion = false
          PortDriveStrengthControl = SLOW
          PortUnlimitedCurrentControl = SLOW
        PortPin7:
          PortPinDirectionChangeable = false
          PortPinDioAltModeChangeable = true
          PortPinModeChangeable = false
          PortPinLevelValue = PORT_PIN_LEVEL_LOW
          PortPinInitialMode = TSG31O1_ALT2_OUT
          PortPinDirection = PORT_PIN_OUT
          PortInputBufferControl = false
          PortBiDirectionControl = false
          PortIpControl = false
          PortPullUpOption = false
          PortPullDownOption = false
          PortOpenDrainControl_Expansion = OpenDrain_PushPull
          PortOutputLevelInversion = false
          PortDriveStrengthControl = SLOW
          PortUnlimitedCurrentControl = SLOW
        PortPin8:
          PortPinDirectionChangeable = false
          PortPinDioAltModeChangeable = true
          PortPinModeChangeable = false
          PortPinLevelValue = PORT_PIN_LEVEL_LOW
          PortPinInitialMode = TSG31O2_ALT2_OUT
          PortPinDirection = PORT_PIN_OUT
          PortInputBufferControl = false
          PortBiDirectionControl = false
          PortIpControl = false
          PortPullUpOption = false
          PortPullDownOption = false
          PortOpenDrainControl_Expansion = OpenDrain_PushPull
          PortOutputLevelInversion = false
          PortDriveStrengthControl = SLOW
          PortUnlimitedCurrentControl = SLOW
        PortPin9:
          PortPinDirectionChangeable = false
          PortPinDioAltModeChangeable = true
          PortPinModeChangeable = false
          PortPinLevelValue = PORT_PIN_LEVEL_LOW
          PortPinInitialMode = TSG31O3_ALT2_OUT
          PortPinDirection = PORT_PIN_OUT
          PortInputBufferControl = false
          PortBiDirectionControl = false
          PortIpControl = false
          PortPullUpOption = false
          PortPullDownOption = false
          PortOpenDrainControl_Expansion = OpenDrain_PushPull
          PortOutputLevelInversion = false
          PortDriveStrengthControl = SLOW
          PortUnlimitedCurrentControl = SLOW
        PortPin10:
          PortPinDirectionChangeable = false
          PortPinDioAltModeChangeable = true
          PortPinModeChangeable = false
          PortPinLevelValue = PORT_PIN_LEVEL_LOW
          PortPinInitialMode = TSG31O4_ALT2_OUT
          PortPinDirection = PORT_PIN_OUT
          PortInputBufferControl = false
          PortBiDirectionControl = false
          PortIpControl = false
          PortPullUpOption = false
          PortPullDownOption = false
          PortOpenDrainControl_Expansion = OpenDrain_PushPull
          PortOutputLevelInversion = false
          PortDriveStrengthControl = SLOW
          PortUnlimitedCurrentControl = SLOW
        PortPin11:
          PortPinDirectionChangeable = false
          PortPinDioAltModeChangeable = false
          PortPinModeChangeable = false
          PortPinLevelValue = PORT_PIN_LEVEL_LOW
          PortPinInitialMode = TAUJ0I3_ALT1_IN
          PortPinDirection = PORT_PIN_IN
          PortInputBufferControl = false
          PortBiDirectionControl = false
          PortPullUpOption = false
          PortPullDownOption = false
          PortOpenDrainControl_Expansion = OpenDrain_N_Channel
          PortOutputLevelInversion = false
          PortDriveStrengthControl = SLOW
          PortUnlimitedCurrentControl = SLOW
        PortPin12:
          PortPinDirectionChangeable = false
          PortPinDioAltModeChangeable = true
          PortPinModeChangeable = false
          PortPinLevelValue = PORT_PIN_LEVEL_LOW
          PortPinInitialMode = TSG31O5_ALT2_OUT
          PortPinDirection = PORT_PIN_OUT
          PortInputBufferControl = false
          PortBiDirectionControl = false
          PortIpControl = false
          PortPullUpOption = false
          PortPullDownOption = false
          PortOpenDrainControl_Expansion = OpenDrain_PushPull
          PortOutputLevelInversion = false
          PortDriveStrengthControl = SLOW
          PortUnlimitedCurrentControl = SLOW
        PortPin13:
          PortPinDirectionChangeable = false
          PortPinDioAltModeChangeable = true
          PortPinModeChangeable = false
          PortPinLevelValue = PORT_PIN_LEVEL_LOW
          PortPinInitialMode = TSG31O6_ALT2_OUT
          PortPinDirection = PORT_PIN_OUT
          PortInputBufferControl = false
          PortBiDirectionControl = false
          PortIpControl = false
          PortPullUpOption = false
          PortPullDownOption = false
          PortOpenDrainControl_Expansion = OpenDrain_PushPull
          PortOutputLevelInversion = false
          PortDriveStrengthControl = SLOW
          PortUnlimitedCurrentControl = SLOW
          PortInputSelection = TYPE_1_SUPP_PISA
        PortPin14:
          PortPinDirectionChangeable = false
          PortPinDioAltModeChangeable = false
          PortPinModeChangeable = false
          PortPinLevelValue = PORT_PIN_LEVEL_LOW
          PortPinInitialMode = DIO
          PortPinDirection = PORT_PIN_IN
          PortInputBufferControl = false
          PortBiDirectionControl = false
          PortPullUpOption = false
          PortPullDownOption = false
          PortOpenDrainControl_Expansion = OpenDrain_N_Channel
          PortOutputLevelInversion = false
          PortDriveStrengthControl = SLOW
          PortUnlimitedCurrentControl = SLOW
      PortGroup4
        PortPin0:
          PortPinDirectionChangeable = false
          PortPinDioAltModeChangeable = false
          PortPinModeChangeable = false
          PortPinLevelValue = PORT_PIN_LEVEL_LOW
          PortPinInitialMode = ENCA0E0_ALT4_IN
          PortPinDirection = PORT_PIN_IN
          PortInputBufferControl = false
          PortBiDirectionControl = false
          PortIpControl = false
          PortPullUpOption = false
          PortPullDownOption = false
          PortOpenDrainControl_Expansion = OpenDrain_N_Channel
          PortOutputLevelInversion = false
          PortDriveStrengthControl = SLOW
          PortUnlimitedCurrentControl = SLOW
          PortInputSelection = TYPE_1_SUPP_PISA
        PortPin1:
          PortPinDirectionChangeable = false
          PortPinDioAltModeChangeable = false
          PortPinModeChangeable = false
          PortPinLevelValue = PORT_PIN_LEVEL_LOW
          PortPinInitialMode = ENCA0E_ALT4_IN
          PortPinDirection = PORT_PIN_IN
          PortInputBufferControl = false
          PortBiDirectionControl = false
          PortIpControl = false
          PortPullUpOption = false
          PortPullDownOption = false
          PortOpenDrainControl_Expansion = OpenDrain_N_Channel
          PortOutputLevelInversion = false
          PortDriveStrengthControl = SLOW
          PortUnlimitedCurrentControl = SLOW
          PortInputSelection = TYPE_1_SUPP_PISA
        PortPin2:  # Annotation PLAIN_TEXT Not connected
          PortPinDirectionChangeable = false
          PortPinDioAltModeChangeable = false
          PortPinModeChangeable = false
          PortPinLevelValue = PORT_PIN_LEVEL_LOW
          PortPinInitialMode = DIO
          PortPinDirection = PORT_PIN_IN
          PortInputBufferControl = false
          PortBiDirectionControl = false
          PortPullUpOption = false
          PortPullDownOption = false
          PortOpenDrainControl_Expansion = OpenDrain_N_Channel
          PortOutputLevelInversion = false
          PortDriveStrengthControl = SLOW
          PortUnlimitedCurrentControl = SLOW
          PortInputSelection = TYPE_1_SUPP_PISA
        PortPin3:
          PortPinDirectionChangeable = false
          PortPinDioAltModeChangeable = true
          PortPinModeChangeable = true
          PortPinLevelValue = PORT_PIN_LEVEL_LOW
          PortPinInitialMode = CSIH1CSS0_ALT4_OUT
          PortPinDirection = PORT_PIN_OUT
          PortInputBufferControl = false
          PortBiDirectionControl = false
          PortPullUpOption = false
          PortPullDownOption = false
          PortOpenDrainControl_Expansion = OpenDrain_PushPull
          PortOutputLevelInversion = false
          PortDriveStrengthControl = SLOW
          PortUnlimitedCurrentControl = SLOW
          PortInputSelection = TYPE_1_SUPP_PISA
        PortPin4:
          PortPinDirectionChangeable = false
          PortPinDioAltModeChangeable = false
          PortPinModeChangeable = false
          PortPinLevelValue = PORT_PIN_LEVEL_LOW
          PortPinInitialMode = ENCA1E0_ALT4_IN
          PortPinDirection = PORT_PIN_IN
          PortInputBufferControl = false
          PortBiDirectionControl = false
          PortPullUpOption = false
          PortPullDownOption = false
          PortOpenDrainControl_Expansion = OpenDrain_N_Channel
          PortOutputLevelInversion = false
          PortDriveStrengthControl = SLOW
          PortUnlimitedCurrentControl = SLOW
          PortInputSelection = TYPE_1_SUPP_PISA
        PortPin5:
          PortPinDirectionChangeable = false
          PortPinDioAltModeChangeable = false
          PortPinModeChangeable = false
          PortPinLevelValue = PORT_PIN_LEVEL_LOW
          PortPinInitialMode = ENCA1E1_ALT4_IN
          PortPinDirection = PORT_PIN_IN
          PortInputBufferControl = false
          PortBiDirectionControl = false
          PortIpControl = false
          PortPullUpOption = false
          PortPullDownOption = false
          PortOpenDrainControl_Expansion = OpenDrain_N_Channel
          PortOutputLevelInversion = false
          PortDriveStrengthControl = SLOW
          PortUnlimitedCurrentControl = SLOW
          PortInputSelection = TYPE_1_SUPP_PISA
        PortPin6:
          PortPinDirectionChangeable = false
          PortPinDioAltModeChangeable = false
          PortPinModeChangeable = false
          PortPinLevelValue = PORT_PIN_LEVEL_LOW
          PortPinInitialMode = SCI30TX_ALT2_OUT
          PortPinDirection = PORT_PIN_OUT
          PortInputBufferControl = false
          PortBiDirectionControl = false
          PortIpControl = false
          PortPullUpOption = false
          PortPullDownOption = false
          PortOpenDrainControl_Expansion = OpenDrain_PushPull
          PortOutputLevelInversion = false
          PortDriveStrengthControl = SLOW
          PortUnlimitedCurrentControl = SLOW
          PortInputSelection = TYPE_1_SUPP_PISA
        PortPin7:
          PortPinDirectionChangeable = false
          PortPinDioAltModeChangeable = false
          PortPinModeChangeable = false
          PortPinLevelValue = PORT_PIN_LEVEL_LOW
          PortPinInitialMode = RSCAN0RX1_ALT1_IN
          PortPinDirection = PORT_PIN_IN
          PortInputBufferControl = false
          PortBiDirectionControl = false
          PortPullUpOption = false
          PortPullDownOption = false
          PortOpenDrainControl_Expansion = OpenDrain_N_Channel
          PortOutputLevelInversion = false
          PortDriveStrengthControl = SLOW
          PortUnlimitedCurrentControl = SLOW
        PortPin8:  # Annotation PLAIN_TEXT Not connected
          PortPinDirectionChangeable = false
          PortPinDioAltModeChangeable = false
          PortPinModeChangeable = false
          PortPinLevelValue = PORT_PIN_LEVEL_LOW
          PortPinInitialMode = DIO
          PortPinDirection = PORT_PIN_IN
          PortInputBufferControl = false
          PortBiDirectionControl = false
          PortPullUpOption = false
          PortPullDownOption = false
          PortOpenDrainControl_Expansion = OpenDrain_N_Channel
          PortOutputLevelInversion = false
          PortDriveStrengthControl = SLOW
          PortUnlimitedCurrentControl = SLOW
        PortPin9:  # Annotation PLAIN_TEXT Not connected
          PortPinDirectionChangeable = false
          PortPinDioAltModeChangeable = false
          PortPinModeChangeable = false
          PortPinLevelValue = PORT_PIN_LEVEL_LOW
          PortPinInitialMode = DIO
          PortPinDirection = PORT_PIN_IN
          PortInputBufferControl = false
          PortBiDirectionControl = false
          PortPullUpOption = false
          PortPullDownOption = false
          PortOpenDrainControl_Expansion = OpenDrain_N_Channel
          PortOutputLevelInversion = false
          PortDriveStrengthControl = SLOW
          PortUnlimitedCurrentControl = SLOW
          PortInputSelection = TYPE_1_SUPP_PISA
        PortPin10:  # Annotation PLAIN_TEXT Not connected
          PortPinDirectionChangeable = false
          PortPinDioAltModeChangeable = false
          PortPinModeChangeable = false
          PortPinLevelValue = PORT_PIN_LEVEL_LOW
          PortPinInitialMode = DIO
          PortPinDirection = PORT_PIN_IN
          PortInputBufferControl = false
          PortBiDirectionControl = false
          PortPullUpOption = false
          PortPullDownOption = false
          PortOpenDrainControl_Expansion = OpenDrain_N_Channel
          PortOutputLevelInversion = false
          PortDriveStrengthControl = SLOW
          PortUnlimitedCurrentControl = SLOW
          PortInputSelection = TYPE_1_SUPP_PISA
        PortPin11:  # Annotation PLAIN_TEXT Not connected
          PortPinDirectionChangeable = false
          PortPinDioAltModeChangeable = false
          PortPinModeChangeable = false
          PortPinLevelValue = PORT_PIN_LEVEL_LOW
          PortPinInitialMode = DIO
          PortPinDirection = PORT_PIN_IN
          PortInputBufferControl = true
          PortBiDirectionControl = false
          PortPullUpOption = false
          PortPullDownOption = false
          PortOpenDrainControl_Expansion = OpenDrain_N_Channel
          PortOutputLevelInversion = false
          PortDriveStrengthControl = SLOW
          PortUnlimitedCurrentControl = SLOW
        PortPin12:  # Annotation PLAIN_TEXT Not connected
          PortPinDirectionChangeable = false
          PortPinDioAltModeChangeable = false
          PortPinModeChangeable = false
          PortPinLevelValue = PORT_PIN_LEVEL_LOW
          PortPinInitialMode = DIO
          PortPinDirection = PORT_PIN_IN
          PortInputBufferControl = false
          PortBiDirectionControl = false
          PortPullUpOption = false
          PortPullDownOption = false
          PortOpenDrainControl_Expansion = OpenDrain_N_Channel
          PortOutputLevelInversion = false
          PortDriveStrengthControl = SLOW
          PortUnlimitedCurrentControl = SLOW
          PortInputSelection = TYPE_1_SUPP_PISA
        PortPin13:  # Annotation PLAIN_TEXT Not connected
          PortPinDirectionChangeable = false
          PortPinDioAltModeChangeable = false
          PortPinModeChangeable = false
          PortPinLevelValue = PORT_PIN_LEVEL_LOW
          PortPinInitialMode = DIO
          PortPinDirection = PORT_PIN_IN
          PortInputBufferControl = false
          PortBiDirectionControl = false
          PortPullUpOption = false
          PortPullDownOption = false
          PortOpenDrainControl_Expansion = OpenDrain_N_Channel
          PortOutputLevelInversion = false
          PortDriveStrengthControl = SLOW
          PortUnlimitedCurrentControl = SLOW
          PortInputSelection = TYPE_1_SUPP_PISA
        PortPin14:  # Annotation PLAIN_TEXT Not connected
          PortPinDirectionChangeable = false
          PortPinDioAltModeChangeable = false
          PortPinModeChangeable = false
          PortPinLevelValue = PORT_PIN_LEVEL_LOW
          PortPinInitialMode = DIO
          PortPinDirection = PORT_PIN_IN
          PortInputBufferControl = false
          PortBiDirectionControl = false
          PortPullUpOption = false
          PortPullDownOption = false
          PortOpenDrainControl_Expansion = OpenDrain_N_Channel
          PortOutputLevelInversion = false
          PortDriveStrengthControl = SLOW
          PortUnlimitedCurrentControl = SLOW
      PortGroup5
        PortPin0:
          PortPinDirectionChangeable = false
          PortPinDioAltModeChangeable = false
          PortPinModeChangeable = false
          PortPinLevelValue = PORT_PIN_LEVEL_LOW
          PortPinInitialMode = CSIG0SI_ALT1_IN
          PortPinDirection = PORT_PIN_IN
          PortInputBufferControl = false
          PortBiDirectionControl = false
          PortPullUpOption = false
          PortPullDownOption = false
          PortOpenDrainControl_Expansion = OpenDrain_N_Channel
          PortOutputLevelInversion = false
          PortDriveStrengthControl = SLOW
          PortUnlimitedCurrentControl = SLOW
        PortPin1:
          PortPinDirectionChangeable = false
          PortPinDioAltModeChangeable = false
          PortPinModeChangeable = false
          PortPinLevelValue = PORT_PIN_LEVEL_LOW
          PortPinInitialMode = CSIG0SO_ALT1_OUT
          PortPinDirection = PORT_PIN_OUT
          PortInputBufferControl = false
          PortBiDirectionControl = false
          PortIpControl = false
          PortPullUpOption = false
          PortPullDownOption = false
          PortOpenDrainControl_Expansion = OpenDrain_PushPull
          PortOutputLevelInversion = false
          PortDriveStrengthControl = SLOW
          PortUnlimitedCurrentControl = SLOW
        PortPin2:  # Annotation PLAIN_TEXT nFAULT
          PortPinDirectionChangeable = false
          PortPinDioAltModeChangeable = false
          PortPinModeChangeable = false
          PortPinLevelValue = PORT_PIN_LEVEL_LOW
          PortPinInitialMode = DIO
          PortPinDirection = PORT_PIN_IN
          PortInputBufferControl = false
          PortBiDirectionControl = false
          PortIpControl = false
          PortPullUpOption = false
          PortPullDownOption = false
          PortOpenDrainControl_Expansion = OpenDrain_N_Channel
          PortOutputLevelInversion = false
          PortDriveStrengthControl = SLOW
          PortUnlimitedCurrentControl = SLOW
        PortPin3:  # Annotation PLAIN_TEXT Not connected
          PortPinDirectionChangeable = false
          PortPinDioAltModeChangeable = false
          PortPinModeChangeable = false
          PortPinLevelValue = PORT_PIN_LEVEL_LOW
          PortPinInitialMode = DIO
          PortPinDirection = PORT_PIN_IN
          PortInputBufferControl = false
          PortBiDirectionControl = false
          PortPullUpOption = false
          PortPullDownOption = false
          PortOpenDrainControl_Expansion = OpenDrain_N_Channel
          PortOutputLevelInversion = false
          PortDriveStrengthControl = SLOW
          PortUnlimitedCurrentControl = SLOW
        PortPin4:
          PortPinDirectionChangeable = false
          PortPinDioAltModeChangeable = false
          PortPinModeChangeable = false
          PortPinLevelValue = PORT_PIN_LEVEL_LOW
          PortPinInitialMode = CSIG0SCO_ALT1_OUT
          PortPinDirection = PORT_PIN_OUT
          PortInputBufferControl = false
          PortBiDirectionControl = false
          PortIpControl = false
          PortPullUpOption = false
          PortPullDownOption = false
          PortOpenDrainControl_Expansion = OpenDrain_PushPull
          PortOutputLevelInversion = false
          PortDriveStrengthControl = SLOW
          PortUnlimitedCurrentControl = SLOW
        PortPin5:
          PortPinDirectionChangeable = false
          PortPinDioAltModeChangeable = false
          PortPinModeChangeable = true
          PortPinLevelValue = PORT_PIN_LEVEL_HIGH
          PortPinInitialMode = DIO
          PortPinDirection = PORT_PIN_IN
          PortInputBufferControl = false
          PortBiDirectionControl = true
          PortPullUpOption = false
          PortPullDownOption = false
          PortOpenDrainControl_Expansion = OpenDrain_N_Channel
          PortOutputLevelInversion = false
          PortDriveStrengthControl = SLOW
          PortUnlimitedCurrentControl = SLOW
        PortPin6:  # Annotation PLAIN_TEXT CAN3_RX
          PortPinDirectionChangeable = false
          PortPinDioAltModeChangeable = false
          PortPinModeChangeable = false
          PortPinLevelValue = PORT_PIN_LEVEL_LOW
          PortPinInitialMode = RSCAN0RX2_ALT1_IN
          PortPinDirection = PORT_PIN_IN
          PortInputBufferControl = false
          PortBiDirectionControl = false
          PortPullUpOption = false
          PortPullDownOption = false
          PortOpenDrainControl_Expansion = OpenDrain_N_Channel
          PortOutputLevelInversion = false
          PortDriveStrengthControl = SLOW
          PortUnlimitedCurrentControl = SLOW
        PortPin7:  # Annotation PLAIN_TEXT CAN3_TX
          PortPinDirectionChangeable = false
          PortPinDioAltModeChangeable = false
          PortPinModeChangeable = false
          PortPinLevelValue = PORT_PIN_LEVEL_HIGH
          PortPinInitialMode = TAUD0I11_ALT3_IN
          PortPinDirection = PORT_PIN_OUT
          PortInputBufferControl = false
          PortBiDirectionControl = false
          PortPullUpOption = false
          PortPullDownOption = false
          PortOpenDrainControl_Expansion = OpenDrain_PushPull
          PortOutputLevelInversion = false
          PortDriveStrengthControl = SLOW
          PortUnlimitedCurrentControl = SLOW
        PortPin8:
          PortPinDirectionChangeable = false
          PortPinDioAltModeChangeable = false
          PortPinModeChangeable = true
          PortPinLevelValue = PORT_PIN_LEVEL_HIGH
          PortPinInitialMode = DIO
          PortPinDirection = PORT_PIN_IN
          PortInputBufferControl = false
          PortBiDirectionControl = true
          PortPullUpOption = false
          PortPullDownOption = false
          PortOpenDrainControl_Expansion = OpenDrain_N_Channel
          PortOutputLevelInversion = false
          PortDriveStrengthControl = SLOW
          PortUnlimitedCurrentControl = SLOW
        PortPin9:
          PortPinDirectionChangeable = false
          PortPinDioAltModeChangeable = false
          PortPinModeChangeable = false
          PortPinLevelValue = PORT_PIN_LEVEL_HIGH
          PortPinInitialMode = DIO
          PortPinDirection = PORT_PIN_OUT
          PortInputBufferControl = false
          PortBiDirectionControl = false
          PortPullUpOption = false
          PortPullDownOption = false
          PortOpenDrainControl_Expansion = OpenDrain_PushPull
          PortOutputLevelInversion = false
          PortDriveStrengthControl = SLOW
          PortUnlimitedCurrentControl = SLOW
        PortPin10:
          PortPinDirectionChangeable = false
          PortPinDioAltModeChangeable = false
          PortPinModeChangeable = false
          PortPinLevelValue = PORT_PIN_LEVEL_LOW
          PortPinInitialMode = DIO
          PortPinDirection = PORT_PIN_OUT
          PortInputBufferControl = false
          PortBiDirectionControl = false
          PortPullUpOption = false
          PortPullDownOption = false
          PortOpenDrainControl_Expansion = OpenDrain_PushPull
          PortOutputLevelInversion = false
          PortDriveStrengthControl = SLOW
          PortUnlimitedCurrentControl = SLOW
        PortPin11:
          PortPinDirectionChangeable = false
          PortPinDioAltModeChangeable = false
          PortPinModeChangeable = true
          PortPinLevelValue = PORT_PIN_LEVEL_HIGH
          PortPinInitialMode = DIO
          PortPinDirection = PORT_PIN_IN
          PortInputBufferControl = false
          PortBiDirectionControl = true
          PortPullUpOption = false
          PortPullDownOption = false
          PortOpenDrainControl_Expansion = OpenDrain_N_Channel
          PortOutputLevelInversion = false
          PortDriveStrengthControl = SLOW
          PortUnlimitedCurrentControl = SLOW
        PortPin12:
          PortPinDirectionChangeable = false
          PortPinDioAltModeChangeable = false
          PortPinModeChangeable = true
          PortPinLevelValue = PORT_PIN_LEVEL_HIGH
          PortPinInitialMode = DIO
          PortPinDirection = PORT_PIN_IN
          PortInputBufferControl = false
          PortBiDirectionControl = true
          PortPullUpOption = false
          PortPullDownOption = false
          PortOpenDrainControl_Expansion = OpenDrain_N_Channel
          PortOutputLevelInversion = false
          PortDriveStrengthControl = SLOW
          PortUnlimitedCurrentControl = SLOW
        PortPin13:  # Annotation PLAIN_TEXT Not connected
          PortPinDirectionChangeable = false
          PortPinDioAltModeChangeable = false
          PortPinModeChangeable = false
          PortPinLevelValue = PORT_PIN_LEVEL_LOW
          PortPinInitialMode = DIO
          PortPinDirection = PORT_PIN_IN
          PortInputBufferControl = false
          PortBiDirectionControl = false
          PortPullUpOption = false
          PortPullDownOption = false
          PortOpenDrainControl_Expansion = OpenDrain_N_Channel
          PortOutputLevelInversion = false
          PortDriveStrengthControl = SLOW
          PortUnlimitedCurrentControl = SLOW
        PortPin14:
          PortPinDirectionChangeable = false
          PortPinDioAltModeChangeable = false
          PortPinModeChangeable = false
          PortPinLevelValue = PORT_PIN_LEVEL_LOW
          PortPinInitialMode = TAUJ0I0_ALT1_IN
          PortPinDirection = PORT_PIN_IN
          PortInputBufferControl = false
          PortBiDirectionControl = false
          PortPullUpOption = false
          PortPullDownOption = false
          PortOpenDrainControl_Expansion = OpenDrain_N_Channel
          PortOutputLevelInversion = false
          PortDriveStrengthControl = SLOW
          PortUnlimitedCurrentControl = SLOW
        PortPin15:  # Annotation PLAIN_TEXT Not connected
          PortPinDirectionChangeable = false
          PortPinDioAltModeChangeable = false
          PortPinModeChangeable = false
          PortPinLevelValue = PORT_PIN_LEVEL_LOW
          PortPinInitialMode = DIO
          PortPinDirection = PORT_PIN_IN
          PortInputBufferControl = false
          PortBiDirectionControl = false
          PortPullUpOption = false
          PortPullDownOption = false
          PortOpenDrainControl_Expansion = OpenDrain_N_Channel
          PortOutputLevelInversion = false
          PortDriveStrengthControl = SLOW
          PortUnlimitedCurrentControl = SLOW
      PortGroupJtag0
        PortPin0:
          PortPinDirectionChangeable = false
          PortPinDioAltModeChangeable = false
          PortPinModeChangeable = false
          PortPinLevelValue = PORT_PIN_LEVEL_LOW
          PortPinInitialMode = DIO_SUPP_PFCE_PMCSR
          PortPinDirection = PORT_PIN_IN
          PortInputBufferControl = false
          PortBiDirectionControl = false
          PortPullUpOption = false
          PortPullDownOption = false
          PortOpenDrainControl_Expansion = OpenDrain_PushPull_SUPP_PODC
          PortDriveStrengthControl = SLOW
          PortUnlimitedCurrentControl = SLOW
          PortInputSelection = TYPE_1_SUPP_PISA
        PortPin1:
          PortPinDirectionChangeable = false
          PortPinDioAltModeChangeable = false
          PortPinModeChangeable = false
          PortPinLevelValue = PORT_PIN_LEVEL_LOW
          PortPinInitialMode = DIO_SUPP_PFCE_PMCSR
          PortPinDirection = PORT_PIN_IN
          PortInputBufferControl = false
          PortBiDirectionControl = false
          PortPullUpOption = false
          PortPullDownOption = false
          PortOpenDrainControl_Expansion = OpenDrain_PushPull_SUPP_PODC
          PortDriveStrengthControl = SLOW
          PortUnlimitedCurrentControl = SLOW
          PortInputSelection = TYPE_1_SUPP_PISA
        PortPin2:
          PortPinDirectionChangeable = false
          PortPinDioAltModeChangeable = false
          PortPinModeChangeable = false
          PortPinInitialMode = DIO_SUPP_PFCE_PMCSR
          PortPinDirection = PORT_PIN_IN
          PortInputBufferControl = false
          PortInputSelection = TYPE_1_SUPP_PISA
          PortPullDownOption = false
          PortPullUpOption = false
          PortPinLevelValue = PORT_PIN_LEVEL_LOW
        PortPin3:
          PortPinDirectionChangeable = false
          PortPinDioAltModeChangeable = false
          PortPinModeChangeable = false
          PortPinLevelValue = PORT_PIN_LEVEL_LOW
          PortPinInitialMode = DIO_SUPP_PFCE_PMCSR
          PortPinDirection = PORT_PIN_IN
          PortInputBufferControl = false
          PortBiDirectionControl = false
          PortPullUpOption = false
          PortPullDownOption = false
          PortOpenDrainControl_Expansion = OpenDrain_PushPull_SUPP_PODC
          PortDriveStrengthControl = SLOW
          PortUnlimitedCurrentControl = SLOW
          PortInputSelection = TYPE_1_SUPP_PISA
        PortPin4:
          PortPinDirectionChangeable = false
          PortPinDioAltModeChangeable = false
          PortPinModeChangeable = false
          PortPinLevelValue = PORT_PIN_LEVEL_LOW
          PortPinInitialMode = DIO_SUPP_PFCE_PMCSR
          PortPinDirection = PORT_PIN_IN
          PortInputBufferControl = false
          PortBiDirectionControl = false
          PortPullUpOption = false
          PortPullDownOption = false
        PortPin5:
          PortPinDirectionChangeable = false
          PortPinDioAltModeChangeable = false
          PortPinModeChangeable = false
          PortPinLevelValue = PORT_PIN_LEVEL_LOW
          PortPinInitialMode = DIO_SUPP_PFCE_PMCSR
          PortPinDirection = PORT_PIN_IN
          PortInputBufferControl = false
          PortBiDirectionControl = false
          PortPullUpOption = false
          PortPullDownOption = false
          PortOpenDrainControl_Expansion = OpenDrain_PushPull_SUPP_PODC
          PortDriveStrengthControl = SLOW
          PortUnlimitedCurrentControl = SLOW
          PortInputSelection = TYPE_1_SUPP_PISA
    PortGeneral:
      PortDevErrorDetect = true
      PortDemErrorDetect = false
      PortSetPinDirectionApi = true
      PortSetPinDefaultDirectionApi = true
      PortSetPinModeApi = true
      PortSetPinDefaultModeApi = true
      PortVersionInfoApi = true
      PortVersionCheckExternalModules = false
      PortDeviceName = R7F701319
      PortCriticalSectionProtection = true
      PortMaxMode = 6
      PortSetToDioAltModeApi = true
      PortLoopTimeout = 50
    PortDemEventParameterRefs: PORT_E_WRITE_TIMEOUT_FAILURE=PORT_E_WRITE_TIMEOUT_FAILURE
