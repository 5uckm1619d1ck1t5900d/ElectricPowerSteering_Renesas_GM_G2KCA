AUTOSAR XML (schema 4-0-3)
package /ActiveEcuC
  module config VrfyCritReg: implementation-config-variant=VARIANT-PRE-COMPILE
    4 x VrfyCritReg8bitPerSignallist:
      ADCD0SFTCR: Address=4294050752, Value=16, Mask=16
      ADCD0THER: Address=4294050864, Value=0, Mask=255
      ADCD1SFTCR: Address=4294054848, Value=16, Mask=16
      ADCD1THER: Address=4294054960, Value=0, Mask=255
    CFAPCTL (VrfyCritReg32bitPerSignallist): Address=4291174400, Value=0, Mask=4294967295
    CFECCCTL_PE1 (VrfyCritReg32bitInitSignallist): Address=4291175424, Mask=4294967295, Value=0
    CFECCCTL_VCI (VrfyCritReg32bitPerSignallist): Address=4291174912, Mask=4294967295, Value=0
    CFERRINT_PE1 (VrfyCritReg32bitInitSignallist): Address=4291175428, Value=7, Mask=4294967295
    CFERRINT_VCI (VrfyCritReg32bitPerSignallist): Address=4291174916, Mask=4294967295, Value=7
    CFSTSTCTL_PE1 (VrfyCritReg32bitInitSignallist): Address=4291175504, Value=0, Mask=4294967295
    CFSTSTCTL_VCI (VrfyCritReg32bitInitSignallist): Address=4291175248, Value=0, Mask=4294967295
    CLMA0CMPH (VrfyCritReg16bitInitSignallist): Address=4294476812, Value=145, Mask=65535
    CLMA0CMPL (VrfyCritReg16bitInitSignallist): Address=4294476808, Value=114, Mask=65535
    CLMA0CTL0 (VrfyCritReg8bitInitSignallist): Address=4294476800, Value=1, Mask=255
    CLMA1CMPH (VrfyCritReg16bitInitSignallist): Address=4294476844, Value=165, Mask=65535
    CLMA1CMPL (VrfyCritReg16bitInitSignallist): Address=4294476840, Value=155, Mask=65535
    CLMA1CTL0 (VrfyCritReg8bitInitSignallist): Address=4294476832, Value=1, Mask=255
    CLMA2CMPH (VrfyCritReg16bitInitSignallist): Address=4294476876, Value=145, Mask=65535
    CLMA2CMPL (VrfyCritReg16bitInitSignallist): Address=4294476872, Value=114, Mask=65535
    CLMA2CTL0 (VrfyCritReg8bitInitSignallist): Address=4294476864, Value=1, Mask=255
    CLMA3CMPH (VrfyCritReg16bitInitSignallist): Address=4294476908, Value=328, Mask=65535
    CLMA3CMPL (VrfyCritReg16bitInitSignallist): Address=4294476904, Value=312, Mask=65535
    CLMA3CTL0 (VrfyCritReg8bitInitSignallist): Address=4294476896, Value=1, Mask=255
    CVMDE (VrfyCritReg8bitPerSignallist): Address=4294453284, Value=3, Mask=3
    CVMREN (VrfyCritReg32bitInitSignallist): Address=4294453312, Value=3, Mask=3
    4 x VrfyCritReg8bitPerSignallist, all with Value=0, Mask=255:
      DNFA0ENL: Address=4290969612
      DNFA1ENL: Address=4290969868
      DNFA2ENL: Address=4290970124
      DNFA4ENL: Address=4290970636
    8 x VrfyCritReg16bitInitSignallist, all with Value=0, Mask=49311:
      ECCCSIH0TMC: Address=4291231748
      ECCCSIH1TMC: Address=4291231812
      ECCCSIH2TMC: Address=4291231876
      ECCCSIH3TMC: Address=4291231940
      ECCFLX0T0TMC: Address=4291240068
      ECCFLX0T1TMC: Address=4291240004
      ECCFLX0TMC: Address=4291239940
      ECCRCAN0TMC: Address=4291235844
    4 x VrfyCritReg32bitInitSignallist, all with Value=0:
      ECMDTMCFG0: Address=4292223048, Mask=4261404659
      ECMDTMCFG1: Address=4292223052, Mask=2039
      ECMDTMCFG2: Address=4292223056, Mask=4261404659
      ECMDTMCFG3: Address=4292223060, Mask=2039
    ECMDTMCMP (VrfyCritReg16bitInitSignallist): Address=4292223044, Value=65535, Mask=65535
    ECMDTMCTL (VrfyCritReg8bitInitSignallist): Address=4292223036, Value=0, Mask=2
    ECMDTMR (VrfyCritReg16bitInitSignallist): Address=4292223040, Value=0, Mask=65535
    ECMEMK0 (VrfyCritReg32bitInitSignallist): Address=4292223004, Mask=4261404659, Value=3357360128
    ECMEMK1 (VrfyCritReg32bitInitSignallist): Address=4292223008, Mask=536872951, Value=536872436
    ECMEPCFG (VrfyCritReg8bitInitSignallist): Address=4292222976, Value=0, Mask=1
    6 x VrfyCritReg32bitInitSignallist:
      ECMIRCFG0: Address=4292222996, Value=2, Mask=4261404659
      ECMIRCFG1: Address=4292223000, Value=0, Mask=536872951
      ECMMICFG0: Address=4292222980, Mask=4261404659, Value=0
      ECMMICFG1: Address=4292222984, Mask=2039, Value=20
      ECMNMICFG0: Address=4292222988, Value=568332273, Mask=4261404659
      ECMNMICFG1: Address=4292222992, Value=3, Mask=2039
    3 x VrfyCritReg16bitPerSignallist:
      EIC16: Address=4294896160, Value=1, Mask=65
      EIC8: Address=4294896144, Value=67, Mask=67
      EIC9: Address=4294896146, Value=66, Mask=66
    4 x VrfyCritReg8bitPerSignallist, all with Mask=255:
      ENCA0TE: Address=4293394452, Value=1
      ENCA1TE: Address=4293398548, Value=1
      FCLA1CTL7: Address=4290986044, Value=0
      FCLA2CTL0: Address=4290986048, Value=0
    FRTEINT (VrfyCritReg8bitInitSignallist): Address=4288741532, Value=3, Mask=255
    FSGD0ADPROT0 (VrfyCritReg32bitPerSignallist): Address=4291084288, Value=67501663, Mask=4294967295
    FSGD0ADPROT1 (VrfyCritReg32bitPerSignallist): Address=4291084292, Value=101056095, Mask=4294967295
    59 x VrfyCritReg32bitInitSignallist, all with Mask=4294967295:
      FSGD1ADPROT0: Address=4292726784, Value=2248539743
      FSGD1ADPROT1: Address=4292726788, Value=2248539743
      FSGD1ADPROT10: Address=4292726824, Value=2248539743
      FSGD1ADPROT11: Address=4292726828, Value=2248539743
      FSGD1ADPROT12: Address=4292726832, Value=2248539743
      FSGD1ADPROT13: Address=4292726836, Value=2248539743
      FSGD1ADPROT14: Address=4292726840, Value=2248539743
      FSGD1ADPROT2: Address=4292726792, Value=2248539743
      FSGD1ADPROT3: Address=4292726796, Value=2248539743
      FSGD1ADPROT4: Address=4292726800, Value=2248539743
      FSGD1ADPROT5: Address=4292726804, Value=2248539743
      FSGD1ADPROT6: Address=4292726808, Value=2248539743
      FSGD1ADPROT7: Address=4292726812, Value=2248539743
      FSGD1ADPROT8: Address=4292726816, Value=2248539871
      FSGD1ADPROT9: Address=4292726820, Value=2248539743
      FSGD1BDPROT0: Address=4292726912, Value=2248539743
      FSGD1BDPROT1: Address=4292726916, Value=2248539743
      FSGD1BDPROT10: Address=4292726952, Value=2248539743
      FSGD1BDPROT11: Address=4292726956, Value=2248539743
      FSGD1BDPROT12: Address=4292726960, Value=2248539743
      FSGD1BDPROT13: Address=4292726964, Value=2248539743
      FSGD1BDPROT14: Address=4292726968, Value=2248539743
      FSGD1BDPROT2: Address=4292726920, Value=2214985311
      FSGD1BDPROT3: Address=4292726924, Value=2248539743
      FSGD1BDPROT4: Address=4292726928, Value=2248539743
      FSGD1BDPROT5: Address=4292726932, Value=2248539743
      FSGD1BDPROT6: Address=4292726936, Value=2248539743
      FSGD1BDPROT7: Address=4292726940, Value=2248539743
      FSGD1BDPROT8: Address=4292726944, Value=2248539743
      FSGD1BDPROT9: Address=4292726948, Value=2248539743
      FSGD2ADPROT0: Address=4294524928, Value=2248539743
      FSGD2ADPROT1: Address=4294524932, Value=2248539743
      FSGD2ADPROT10: Address=4294524968, Value=2248539743
      FSGD2ADPROT11: Address=4294524972, Value=2248540127
      FSGD2ADPROT12: Address=4294524976, Value=2248539743
      FSGD2ADPROT13: Address=4294524980, Value=2248539743
      FSGD2ADPROT14: Address=4294524984, Value=2248539743
      FSGD2ADPROT15: Address=4294524988, Value=2248540127
      FSGD2ADPROT2: Address=4294524936, Value=2214985311
      FSGD2ADPROT3: Address=4294524940, Value=2214985311
      FSGD2ADPROT4: Address=4294524944, Value=2214985311
      FSGD2ADPROT5: Address=4294524948, Value=2214985311
      FSGD2ADPROT6: Address=4294524952, Value=2214985311
      FSGD2ADPROT7: Address=4294524956, Value=2248539743
      FSGD2ADPROT8: Address=4294524960, Value=2248539743
      FSGD2ADPROT9: Address=4294524964, Value=2248539743
      FSGD3ADPROT0: Address=4291035136, Value=2214985311
      FSGD3ADPROT1: Address=4291035140, Value=2214985311
      FSGD3ADPROT10: Address=4291035176, Value=2248539999
      FSGD3ADPROT11: Address=4291035180, Value=2248539999
      FSGD3ADPROT2: Address=4291035144, Value=2214985311
      FSGD3ADPROT3: Address=4291035148, Value=2248539743
      FSGD3ADPROT4: Address=4291035152, Value=2248539743
      FSGD3ADPROT5: Address=4291035156, Value=2214985311
      FSGD3ADPROT6: Address=4291035160, Value=2214985311
      FSGD3ADPROT7: Address=4291035164, Value=2214985311
      FSGD3ADPROT8: Address=4291035168, Value=2214985311
      FSGD3ADPROT9: Address=4291035172, Value=2214985311
      FSGD5ADPROT0: Address=4294508544, Value=2248539743
    3 x VrfyCritReg32bitPerSignallist:
      IDECCCTL_PE1: Address=4291167232, Value=0, Mask=4294967295
      IDERRINT_PE1: Address=4291167236, Value=3, Mask=4294967295
      IMR0: Address=4294896368, Value=65536, Mask=66304
    5 x VrfyCritReg8bitInitSignallist, all with Mask=255:
      IPGENUM: Address=4294893581, Value=3
      IPGPMTUM0: Address=4294893600, Value=51
      IPGPMTUM2: Address=4294893602, Value=17
      IPGPMTUM3: Address=4294893603, Value=16
      IPGPMTUM4: Address=4294893604, Value=1
    4 x VrfyCritReg32bitPerSignallist, all with Mask=4294967295:
      ITECCCTL_PE1: Address=4291171328, Value=0
      ITERRINT_PE1: Address=4291171332, Value=3
      LRECCCTL_PE1: Address=4291187712, Value=0
      LRERRINT_PE1: Address=4291187716, Value=3
    LVICNT (VrfyCritReg32bitInitSignallist): Address=4294454272, Value=0, Mask=7
    MODER (VrfyCritReg8bitInitSignallist): Address=4291630068, Value=3, Mask=255
    OPBT0 (VrfyCritReg32bitPerSignallist): Address=4291625008, Value=2147483643, Mask=4294967295
    OPBT2 (VrfyCritReg32bitPerSignallist): Address=4291625016, Value=3221225471, Mask=4294967295
    8 x VrfyCritReg32bitInitSignallist, all with Mask=4294967295:
      PEGG0BA: Address=4294895236, Value=4273991829
      PEGG0MK: Address=4294895232, Value=0
      PEGG1BA: Address=4294895252, Value=4273864915
      PEGG1MK: Address=4294895248, Value=126976
      PEGG2BA: Address=4294895268, Value=0
      PEGG2MK: Address=4294895264, Value=0
      PEGG3BA: Address=4294895284, Value=0
      PEGG3MK: Address=4294895280, Value=0
    PEGSP (VrfyCritReg16bitInitSignallist): Address=4294895116, Value=1, Mask=65535
    PSI50CHCTRL (VrfyCritReg32bitPerSignallist): Address=4292870144, Value=0, Mask=1
    PSI51CHCTRL (VrfyCritReg32bitPerSignallist): Address=4292874240, Value=0, Mask=1
    5 x VrfyCritReg8bitPerSignallist, all with Mask=255:
      RLN30LCUC: Address=4292837390, Value=0
      RLN31LCUC: Address=4292841486, Value=0
      SCI30SCR: Address=4292804616, Value=240
      SCI31SCR: Address=4292808712, Value=0
      SCI32SCR: Address=4292812808, Value=0
    SEGCONT (VrfyCritReg16bitInitSignallist): Address=4294896000, Value=880, Mask=65535
    6 x VrfyCritReg16bitPerSignallist, all with Value=0, Mask=65535:
      TAUD0TE: Address=4293001664
      TAUD0TOE: Address=4293001308
      TAUD1TE: Address=4293005760
      TAUD1TOE: Address=4293005404
      TAUD2TE: Address=4293009856
      TAUD2TOE: Address=4293009500
    3 x VrfyCritReg8bitPerSignallist, all with Value=0, Mask=1:
      TPBA0TE: Address=4293525800
      TPBA1TE: Address=4293529896
      TSG30STR0: Address=4293328912
    TSN0STAT (VrfyCritReg32bitPerSignallist): Address=4294082564, Value=0, Mask=65535
    WDTA0EVAC (VrfyCritReg8bitPerSignallist): Address=4292296708, Value=44, Mask=255
    WDTA0MD (VrfyCritReg8bitPerSignallist): Address=4292296716, Value=120, Mask=255
    fpcfg (VrfySysCritRegInitSignallist): RegisterID=10, SelectionID=0, Value=28, Mask=4294967295
    iccfg (VrfySysCritRegInitSignallist): RegisterID=26, SelectionID=4, Value=67652, Mask=4294967295
    icctrl (VrfySysCritRegPerSignallist): RegisterID=24, SelectionID=4, Value=196611, Mask=4294967295
    mpm (VrfySysCritRegInitSignallist): RegisterID=0, SelectionID=5, Value=3, Mask=4294967295
