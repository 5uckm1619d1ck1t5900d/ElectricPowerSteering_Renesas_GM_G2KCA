AUTOSAR XML (schema 4-0-3)
package /ActiveEcuC
  module config WdgM: implementation-config-variant=VARIANT-PRE-COMPILE, module-description=WdgM_Impl
    WdgMConfigSet: WdgMInitialMode=WdgMMode
      WdgMMode: WdgMExpiredSupervisionCycleTol=0, WdgMModeId=0, WdgMTicksPerSecond=250, WdgMSupervisionCycle=0.004, WdgMInitialTriggerModeId=0
        6 x WdgMAliveSupervision, all with WdgMMaxMargin=0, WdgMMinMargin=0:
          Alv_2ms_End: WdgMExpectedAliveIndications=2, WdgMSupervisionReferenceCycle=1, WdgMAliveSupervisionCheckpointRef=ChkPt_2ms_Appl6_End
          Alv_2ms_Strt: WdgMExpectedAliveIndications=2, WdgMSupervisionReferenceCycle=1, WdgMAliveSupervisionCheckpointRef=ChkPt_2ms_Appl10_Strt
          Alv_4ms_Strt: WdgMExpectedAliveIndications=1, WdgMSupervisionReferenceCycle=1, WdgMAliveSupervisionCheckpointRef=ChkPt_4ms_Appl10_Strt
          Alv_10ms_End: WdgMExpectedAliveIndications=2, WdgMSupervisionReferenceCycle=5, WdgMAliveSupervisionCheckpointRef=ChkPt_10msBsw_Appl10_End
          Alv_10ms_Strt: WdgMExpectedAliveIndications=2, WdgMSupervisionReferenceCycle=5, WdgMAliveSupervisionCheckpointRef=ChkPt_10ms_Appl10_Strt
          Alv_100ms_Strt: WdgMExpectedAliveIndications=1, WdgMSupervisionReferenceCycle=25, WdgMAliveSupervisionCheckpointRef=ChkPt_100ms_Appl10_Strt
        ExtTran_2ms (WdgMExternalLogicalSupervision): WdgMExternalCheckpointFinalRef=ChkPt_2ms_Appl6_Strt, WdgMExternalCheckpointInitialRef=ChkPt_2ms_Appl10_End
          ExtTran_2ms_1 (WdgMExternalTransition): WdgMExternalTransitionDestRef=ChkPt_2ms_Appl6_Strt, WdgMExternalTransitionSourceRef=ChkPt_2ms_Appl10_End
        ExtTran_10ms (WdgMExternalLogicalSupervision): WdgMExternalCheckpointFinalRef=ChkPt_10msBsw_Appl10_Strt, WdgMExternalCheckpointInitialRef=ChkPt_10ms_Appl10_Strt
          ExtTran_10ms_1 (WdgMExternalTransition): WdgMExternalTransitionDestRef=ChkPt_10ms_Appl6_Strt, WdgMExternalTransitionSourceRef=ChkPt_10ms_Appl10_End
          ExtTran_10ms_2 (WdgMExternalTransition): WdgMExternalTransitionDestRef=ChkPt_10msBsw_Appl10_Strt, WdgMExternalTransitionSourceRef=ChkPt_10ms_Appl6_End
        7 x WdgMLocalStatusParams, all with WdgMFailedAliveSupervisionRefCycleTol=0, WdgMSupervisedEntityInitialMode=WDGM_LOCAL_STATUS_OK, WdgMFailedProgramFlowRefCycleTol=0:
          Sts_2ms_Appl6: WdgMLocalStatusSupervisedEntityRef=SE_2ms_Appl6
          Sts_2ms_Appl10: WdgMLocalStatusSupervisedEntityRef=SE_2ms_Appl10
          Sts_4ms_Appl10: WdgMLocalStatusSupervisedEntityRef=SE_4ms_Appl10
          Sts_10ms_Appl6: WdgMLocalStatusSupervisedEntityRef=SE_10ms_Appl6
          Sts_10ms_Appl10: WdgMLocalStatusSupervisedEntityRef=SE_10ms_Appl10
          Sts_10msBsw_Appl10: WdgMLocalStatusSupervisedEntityRef=SE_10msBsw_Appl10
          Sts_100ms_Appl10: WdgMLocalStatusSupervisedEntityRef=SE_100ms_Appl10
        WdgMTrigger: WdgMTriggerConditionValue=6, WdgMWatchdogMode=WDGIF_SLOW_MODE, WdgMTriggerWindowStart=2, WdgMTriggerModeId=0, WdgMTriggerWatchdogRef=WdgMWatchdog
    WdgMGeneral:
      WdgMDefensiveBehavior = false
      WdgMUseRte = true
      WdgMDemSupervisionReport = false
      WdgMFirstCycleAliveCounterReset = true
      WdgMUseOsSuspendInterrupt = true
      WdgMTimebaseSource = WDGM_INTERNAL_SOFTWARE_TICK
      WdgMSecondResetPath = true
      WdgMTickOverrunCorrection = true
      WdgMEntityDeactivationEnabled = false
      WdgMStateChangeNotification = false
      WdgMDemStoppedSupervisionReport = false
      WdgMDevErrorDetect = true
      WdgMDemReport = false
      WdgMImmediateReset = true
      WdgMOffModeEnabled = false
      WdgMVersionInfoApi = false
      WdgMGlobalMemoryAppTaskRef = Appl10
      7 x WdgMSupervisedEntity, all with WdgMEnableEntityDeactivation=false, WdgMSupportedAutosarAPI=API_4_0:
        SE_2ms_Appl6: WdgMSupervisedEntityId=2, WdgMInternalCheckpointInitialRef=ChkPt_2ms_Appl6_Strt, WdgMAppTaskRef=Appl6, WdgMInternallCheckpointFinalRef=ChkPt_2ms_Appl6_End
          ChkPt_2ms_Appl6_End (WdgMCheckpoint): WdgMCheckpointId=1
          ChkPt_2ms_Appl6_Strt (WdgMCheckpoint): WdgMCheckpointId=0
          IntTran_2ms_Appl6 (WdgMInternalTransition): WdgMInternalTransitionDestRef=ChkPt_2ms_Appl6_End, WdgMInternalTransitionSourceRef=ChkPt_2ms_Appl6_Strt
        SE_2ms_Appl10: WdgMSupervisedEntityId=1, WdgMInternalCheckpointInitialRef=ChkPt_2ms_Appl10_Strt, WdgMAppTaskRef=Appl10, WdgMInternallCheckpointFinalRef=ChkPt_2ms_Appl10_End
          ChkPt_2ms_Appl10_End (WdgMCheckpoint): WdgMCheckpointId=1
          ChkPt_2ms_Appl10_Strt (WdgMCheckpoint): WdgMCheckpointId=0
          IntTran_2ms_Appl10 (WdgMInternalTransition): WdgMInternalTransitionDestRef=ChkPt_2ms_Appl10_End, WdgMInternalTransitionSourceRef=ChkPt_2ms_Appl10_Strt
        SE_4ms_Appl10: WdgMSupervisedEntityId=5, WdgMInternalCheckpointInitialRef=ChkPt_4ms_Appl10_Strt, WdgMAppTaskRef=Appl10, WdgMInternallCheckpointFinalRef=ChkPt_4ms_Appl10_End
          ChkPt_4ms_Appl10_Strt (WdgMCheckpoint): WdgMCheckpointId=0
          ChkPt_4ms_Appl10_End (WdgMCheckpoint): WdgMCheckpointId=1
          IntTran_4ms_Appl10 (WdgMInternalTransition): WdgMInternalTransitionDestRef=ChkPt_4ms_Appl10_End, WdgMInternalTransitionSourceRef=ChkPt_4ms_Appl10_Strt
        SE_10ms_Appl6: WdgMSupervisedEntityId=4, WdgMInternalCheckpointInitialRef=ChkPt_10ms_Appl6_Strt, WdgMAppTaskRef=Appl6, WdgMInternallCheckpointFinalRef=ChkPt_10ms_Appl6_End
          ChkPt_10ms_Appl6_Strt (WdgMCheckpoint): WdgMCheckpointId=0
          ChkPt_10ms_Appl6_End (WdgMCheckpoint): WdgMCheckpointId=1
          IntTran_10ms_Appl6 (WdgMInternalTransition): WdgMInternalTransitionDestRef=ChkPt_10ms_Appl6_End, WdgMInternalTransitionSourceRef=ChkPt_10ms_Appl6_Strt
        SE_10ms_Appl10: WdgMSupervisedEntityId=6, WdgMInternalCheckpointInitialRef=ChkPt_10ms_Appl10_Strt, WdgMAppTaskRef=Appl10, WdgMInternallCheckpointFinalRef=ChkPt_10ms_Appl10_End
          ChkPt_10ms_Appl10_End (WdgMCheckpoint): WdgMCheckpointId=1
          ChkPt_10ms_Appl10_Strt (WdgMCheckpoint): WdgMCheckpointId=0
          IntTran_10ms_Appl10 (WdgMInternalTransition): WdgMInternalTransitionDestRef=ChkPt_10ms_Appl10_End, WdgMInternalTransitionSourceRef=ChkPt_10ms_Appl10_Strt
        SE_10msBsw_Appl10: WdgMSupervisedEntityId=0, WdgMInternalCheckpointInitialRef=ChkPt_10msBsw_Appl10_Strt, WdgMAppTaskRef=Appl10, WdgMInternallCheckpointFinalRef=ChkPt_10msBsw_Appl10_End
          ChkPt_10msBsw_Appl10_Strt (WdgMCheckpoint): WdgMCheckpointId=0
          ChkPt_10msBsw_Appl10_End (WdgMCheckpoint): WdgMCheckpointId=1
          IntTran_10msBsw_Appl10 (WdgMInternalTransition): WdgMInternalTransitionDestRef=ChkPt_10msBsw_Appl10_End, WdgMInternalTransitionSourceRef=ChkPt_10msBsw_Appl10_Strt
        SE_100ms_Appl10: WdgMSupervisedEntityId=3, WdgMInternalCheckpointInitialRef=ChkPt_100ms_Appl10_Strt, WdgMAppTaskRef=Appl10, WdgMInternallCheckpointFinalRef=ChkPt_100ms_Appl10_End
          ChkPt_100ms_Appl10_End (WdgMCheckpoint): WdgMCheckpointId=1
          ChkPt_100ms_Appl10_Strt (WdgMCheckpoint): WdgMCheckpointId=0
          IntTran_100ms_Appl10 (WdgMInternalTransition): WdgMInternalTransitionDestRef=ChkPt_100ms_Appl10_End, WdgMInternalTransitionSourceRef=ChkPt_100ms_Appl10_Strt
      WdgMWatchdog: WdgMWatchdogName=, WdgMWatchdogDeviceRef=WdgIfDevice
