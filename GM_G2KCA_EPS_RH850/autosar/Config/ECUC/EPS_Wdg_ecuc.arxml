AUTOSAR XML (schema 4-0-3)
package /ActiveEcuC
  module config Wdg: implementation-config-variant=VARIANT-POST-BUILD-LOADABLE, module-description=Wdg_Impl
    WdgGeneral:
      WdgDevErrorDetect = true
      WdgDisableAllowed = false
      WdgIndex = 0
      WdgInitialTimeout = 10
      WdgMaxTimeout = 10
      WdgRunArea = ROM
      WdgTriggerLocation = NULL
      WdgVersionInfoApi = true
      WdgCriticalSectionProtection = true
      WdgVaryingActivationCodeMode = DISABLE
      WdgVersionCheckExternalModules = false
      WdgDeviceName = R7F701311
      WdgRegReadBackEnable = DISABLED
      WdgClockRef = McuWdtacounterClk
    WdgPublishedInformation: WdgTriggerMode=WDG_WINDOW
    WdgSettingsConfig: WdgDefaultMode=WDGIF_SLOW_MODE
      WdgSettingsFast: WdgClkSettingsFast=WDGCLK_DIVBY_2POWOF_15
      WdgSettingsOff
      WdgSettingsSlow: WdgClkSettingsSlow=WDGCLK_DIVBY_2POWOF_16
    WdgDemEventParameterRefs:
      WDG_E_TRIGGER_TIMEOUT = WDG_E_TRIGGER_TIMEOUT
      WDG_E_DISABLE_REJECTED = WDG_E_DISABLE_REJECTED
      WDG_E_MODE_FAILED = WDG_E_MODE_FAILED
      WDG_E_READBACK_FAILURE = WDG_E_READBACK_FAILURE
