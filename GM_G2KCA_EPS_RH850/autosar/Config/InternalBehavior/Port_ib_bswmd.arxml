AUTOSAR XML (schema 4-0-3)
package /Renesas/Port_ib_bswmd/BswModuleDescriptions
  bsw module description Port
    bsw internal behavior PortBehavior
      7 x exclusive area:
        SET_PIN_MODE_PROTECTION
        SET_PIN_DIR_PROTECTION
        SET_TO_DIO_ALT_PROTECTION
        INIT_CONFIG_PROTECTION
        REFRESH_PORT_INTERNAL_PROTECTION
        SET_PIN_DEFAULT_MODE_PROTECTION
        SET_PIN_DEFAULT_DIR_PROTECTION
