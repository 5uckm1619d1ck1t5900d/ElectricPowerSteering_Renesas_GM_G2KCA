AUTOSAR XML (schema 4-0-3)
package /Renesas/Spi_ib_bswmd/BswModuleDescriptions
  bsw module description Spi: provided-entrys=Spi_MainFunction_Handling
    bsw internal behavior SpiBehavior
      exclusive area SPI_RAM_DATA_PROTECTION
      exclusive area SPI_CHIP_SELECT_PROTECTION
      bsw schedulable entity Spi_MainFunction_Handling: implemented-entry=Spi_MainFunction_Handling
      bsw timing event Spi_MainFunction_HandlingTimingEvent0: starts-on-event=Spi_MainFunction_Handling, period=0.01
  bsw module entry Spi_MainFunction_Handling: call-type=SCHEDULED, execution-context=TASK
