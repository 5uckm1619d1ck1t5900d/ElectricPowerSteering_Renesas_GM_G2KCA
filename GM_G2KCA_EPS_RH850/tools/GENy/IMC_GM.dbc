VERSION ""

NS_ :

BS_:

BU_: EPS_B EPS_A

BO_ 33 SG16_Msg_EPS_B: 8 EPS_B
 SG_ SG16_Data_EPS_B : 7|64@0+ (1,0) [0|1.84467440737096E+019] ""  EPS_A

BO_ 32 SG16_Msg_EPS_A: 8 EPS_A
 SG_ SG16_Data_EPS_A : 7|64@0+ (1,0) [0|1.84467440737096E+019] ""  EPS_B

BO_ 31 SG15_Msg_EPS_B: 8 EPS_B
 SG_ SG15_Data_EPS_B : 7|64@0+ (1,0) [0|1.84467440737096E+019] ""  EPS_A

BO_ 30 SG15_Msg_EPS_A: 8 EPS_A
 SG_ SG15_Data_EPS_A : 7|64@0+ (1,0) [0|1.84467440737096E+019] ""  EPS_B

BO_ 29 SG14_Msg_EPS_B: 8 EPS_B
 SG_ SG14_Data_EPS_B : 7|64@0+ (1,0) [0|1.84467440737096E+019] ""  EPS_A

BO_ 28 SG14_Msg_EPS_A: 8 EPS_A
 SG_ SG14_Data_EPS_A : 7|64@0+ (1,0) [0|1.84467440737096E+019] ""  EPS_B

BO_ 27 SG13_Msg_EPS_B: 8 EPS_B
 SG_ SG13_Data_EPS_B : 7|64@0+ (1,0) [0|1.84467440737096E+019] ""  EPS_A

BO_ 26 SG13_Msg_EPS_A: 8 EPS_A
 SG_ SG13_Data_EPS_A : 7|64@0+ (1,0) [0|1.84467440737096E+019] ""  EPS_B

BO_ 25 SG12_Msg_EPS_B: 8 EPS_B
 SG_ SG12_Data_EPS_B : 7|64@0+ (1,0) [0|1.84467440737096E+019] ""  EPS_A

BO_ 24 SG12_Msg_EPS_A: 8 EPS_A
 SG_ SG12_Data_EPS_A : 7|64@0+ (1,0) [0|1.84467440737096E+019] ""  EPS_B

BO_ 23 SG11_Msg_EPS_B: 8 EPS_B
 SG_ SG11_Data_EPS_B : 7|64@0+ (1,0) [0|1.84467440737096E+019] ""  EPS_A

BO_ 22 SG11_Msg_EPS_A: 8 EPS_A
 SG_ SG11_Data_EPS_A : 7|64@0+ (1,0) [0|1.84467440737096E+019] ""  EPS_B

BO_ 21 SG10_Msg_EPS_B: 8 EPS_B
 SG_ SG10_Data_EPS_B : 7|64@0+ (1,0) [0|1.84467440737096E+019] ""  EPS_A

BO_ 20 SG10_Msg_EPS_A: 8 EPS_A
 SG_ SG10_Data_EPS_A : 7|64@0+ (1,0) [0|1.84467440737096E+019] ""  EPS_B

BO_ 19 SG9_Msg_EPS_B: 8 EPS_B
 SG_ SG9_Data_EPS_B : 7|64@0+ (1,0) [0|1.84467440737096E+019] ""  EPS_A

BO_ 18 SG9_Msg_EPS_A: 8 EPS_A
 SG_ SG9_Data_EPS_A : 7|64@0+ (1,0) [0|1.84467440737096E+019] ""  EPS_B

BO_ 17 SG8_Msg_EPS_B: 8 EPS_B
 SG_ SG8_Data_EPS_B : 7|64@0+ (1,0) [0|1.84467440737096E+019] ""  EPS_A

BO_ 16 SG8_Msg_EPS_A: 8 EPS_A
 SG_ SG8_Data_EPS_A : 7|64@0+ (1,0) [0|1.84467440737096E+019] ""  EPS_B

BO_ 15 SG7_Msg_EPS_B: 8 EPS_B
 SG_ SG7_Data_EPS_B : 7|64@0+ (1,0) [0|1.84467440737096E+019] ""  EPS_A

BO_ 14 SG7_Msg_EPS_A: 8 EPS_A
 SG_ SG7_Data_EPS_A : 7|64@0+ (1,0) [0|1.84467440737096E+019] ""  EPS_B

BO_ 13 SG6_Msg_EPS_B: 8 EPS_B
 SG_ SG6_Data_EPS_B : 7|64@0+ (1,0) [0|1.84467440737096E+019] ""  EPS_A

BO_ 12 SG6_Msg_EPS_A: 8 EPS_A
 SG_ SG6_Data_EPS_A : 7|64@0+ (1,0) [0|1.84467440737096E+019] ""  EPS_B

BO_ 11 SG5_Msg_EPS_B: 8 EPS_B
 SG_ SG5_Data_EPS_B : 7|64@0+ (1,0) [0|1.84467440737096E+019] ""  EPS_A

BO_ 10 SG5_Msg_EPS_A: 8 EPS_A
 SG_ SG5_Data_EPS_A : 7|64@0+ (1,0) [0|1.84467440737096E+019] ""  EPS_B

BO_ 9 SG4_Msg_EPS_B: 8 EPS_B
 SG_ SG4_Data_EPS_B : 7|64@0+ (1,0) [0|1.84467440737096E+019] ""  EPS_A

BO_ 8 SG4_Msg_EPS_A: 8 EPS_A
 SG_ SG4_Data_EPS_A : 7|64@0+ (1,0) [0|1.84467440737096E+019] ""  EPS_B

BO_ 7 SG3_Msg_EPS_B: 8 EPS_B
 SG_ SG3_Data_EPS_B : 7|64@0+ (1,0) [0|1.84467440737096E+019] ""  EPS_A

BO_ 6 SG3_Msg_EPS_A: 8 EPS_A
 SG_ SG3_Data_EPS_A : 7|64@0+ (1,0) [0|1.84467440737096E+019] ""  EPS_B

BO_ 5 SG2_Msg_EPS_B: 8 EPS_B
 SG_ SG2_Data_EPS_B : 7|64@0+ (1,0) [0|1.84467440737096E+019] ""  EPS_A

BO_ 4 SG2_Msg_EPS_A: 8 EPS_A
 SG_ SG2_Data_EPS_A : 7|64@0+ (1,0) [0|1.84467440737096E+019] ""  EPS_B

BO_ 3 SG1_Msg_EPS_B: 8 EPS_B
 SG_ SG1_Data_EPS_B : 7|64@0+ (1,0) [0|1.84467440737096E+019] ""  EPS_A

BO_ 2 SG1_Msg_EPS_A: 8 EPS_A
 SG_ SG1_Data_EPS_A : 7|64@0+ (1,0) [0|1.84467440737096E+019] ""  EPS_B

BO_ 1 SG0_Msg_EPS_B_ONLY_SCI: 8 EPS_B
 SG_ SG0_Data_EPS_B : 7|64@0+ (1,0) [0|1.84467440737096E+019] ""  EPS_A

BO_ 0 SG0_Msg_EPS_A_ONLY_SCI: 8 EPS_A
 SG_ SG0_Data_EPS_A : 7|64@0+ (1,0) [0|1.84467440737096E+019] ""  EPS_B

CM_ BO_ 1 "UNUSED";
CM_ BO_ 0 "UNUSED";
BA_DEF_  "DBName" STRING ;
BA_DEF_  "VersionDay" INT 1 31;
BA_DEF_  "VersionNumber" INT 0 10000;
BA_DEF_  "VersionMonth" INT 1 12;
BA_DEF_  "VersionYear" INT 2000 3000;
BA_DEF_ BO_  "GenMsgSendType" ENUM  "FixedPeriodic","Event","EnabledPeriodic","NotUsed","NotUsed","EventPeriodic","NotUsed","NotUsed","NoMsgSendType";
BA_DEF_ BO_  "GenMsgCycleTime" INT 0 1000000;
BA_DEF_  "BusType" STRING ;
BA_DEF_DEF_  "DBName" "";
BA_DEF_DEF_  "VersionDay" 7;
BA_DEF_DEF_  "VersionNumber" 1;
BA_DEF_DEF_  "VersionMonth" 6;
BA_DEF_DEF_  "VersionYear" 2016;
BA_DEF_DEF_  "GenMsgSendType" "FixedPeriodic";
BA_DEF_DEF_  "GenMsgCycleTime" 0;
BA_DEF_DEF_  "BusType" "CAN";
BA_ "DBName" "IMC";
BA_ "GenMsgCycleTime" BO_ 33 100;
BA_ "GenMsgCycleTime" BO_ 32 100;
BA_ "GenMsgCycleTime" BO_ 31 100;
BA_ "GenMsgCycleTime" BO_ 30 100;
BA_ "GenMsgCycleTime" BO_ 29 100;
BA_ "GenMsgCycleTime" BO_ 28 100;
BA_ "GenMsgCycleTime" BO_ 27 100;
BA_ "GenMsgCycleTime" BO_ 26 100;
BA_ "GenMsgCycleTime" BO_ 25 100;
BA_ "GenMsgCycleTime" BO_ 24 100;
BA_ "GenMsgCycleTime" BO_ 23 100;
BA_ "GenMsgCycleTime" BO_ 22 100;
BA_ "GenMsgCycleTime" BO_ 21 100;
BA_ "GenMsgCycleTime" BO_ 20 100;
BA_ "GenMsgCycleTime" BO_ 19 10;
BA_ "GenMsgCycleTime" BO_ 18 10;
BA_ "GenMsgCycleTime" BO_ 17 10;
BA_ "GenMsgCycleTime" BO_ 16 10;
BA_ "GenMsgCycleTime" BO_ 15 10;
BA_ "GenMsgCycleTime" BO_ 14 10;
BA_ "GenMsgCycleTime" BO_ 13 10;
BA_ "GenMsgCycleTime" BO_ 12 10;
BA_ "GenMsgCycleTime" BO_ 11 10;
BA_ "GenMsgCycleTime" BO_ 10 10;
BA_ "GenMsgCycleTime" BO_ 9 10;
BA_ "GenMsgCycleTime" BO_ 8 10;
BA_ "GenMsgCycleTime" BO_ 7 10;
BA_ "GenMsgCycleTime" BO_ 6 10;
BA_ "GenMsgCycleTime" BO_ 5 10;
BA_ "GenMsgCycleTime" BO_ 4 10;
BA_ "GenMsgCycleTime" BO_ 3 10;
BA_ "GenMsgCycleTime" BO_ 2 10;
BA_ "GenMsgCycleTime" BO_ 1 2;
BA_ "GenMsgCycleTime" BO_ 0 2;
