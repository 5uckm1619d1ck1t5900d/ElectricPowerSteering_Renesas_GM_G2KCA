AUTOSAR XML (schema 4-0-3)
# COPYRIGHT
# Copyright (c) 2008 by Vector Informatik GmbH. All rights reserved.
# This software is copyright protected and proprietary to Vector Informatik GmbH.
# Vector Informatik GmbH grants to you only those rights as set out in the license conditions.
package /MICROSAR
  module definition Crc [0..1]: category=VENDOR_SPECIFIC_MODULE_DEFINITION, refined-module-def=Crc, variants pre-compile  # Configuration of the CRC (Cyclic Redundancy Check) module.
    container CrcGeneral  # General configuration of the CRC
      enumeration Crc16Mode: set at pre-compile, default-value=CRC_16_RUNTIME  # 16bit-CRC Calculation Method | This switch selects one of the available CRC16 calculation methods.
        CRC_16_RUNTIME  # Runtime calculation results in smaller code size, but slower execution time.
        CRC_16_TABLE  # Table based calculation results in fast execution, but increases ROM size.
      enumeration Crc32Mode: set at pre-compile, default-value=CRC_32_RUNTIME  # 32bit-CRC Calculation Method | This switch selects one of the available CRC32 calculation methods.
        CRC_32_RUNTIME  # Runtime calculation results in smaller code size, but slower execution time.
        CRC_32_TABLE  # Table based calculation results in fast execution, but increases ROM size.
      enumeration Crc8H2FMode: set at pre-compile, default-value=CRC_8H2F_RUNTIME  # 8bit- H2F CRC Calculation Method | This switch selects one of the available CRC 8-bit calculation methods with 0x2F CRC polynomial.
        CRC_8H2F_RUNTIME  # Runtime calculation results in smaller code size, but slower execution time.
        CRC_8H2F_TABLE  # Table based calculation results in fast execution, but increases ROM size.
      enumeration Crc8Mode: set at pre-compile, default-value=CRC_8_RUNTIME  # 8bit-CRC Calculation Method: | This switch selects one of the available CRC 8-bit (SAE J1850) calculation methods.
        CRC_8_RUNTIME  # Runtime calculation results in smaller code size, but slower execution time.
        CRC_8_TABLE  # Table based calculation results in fast execution, but increases ROM size.
      boolean CrcVersionInfoApi: set at pre-compile, default-value=true  # API service Crc_GetVersionInfo | This parameter enables/disables the function Crc_GetVersionInfo() to get major, minor and patch version information.
      enumeration Crc32P4Mode: set at pre-compile, origin=Vector Informatik, default-value=CRC_32P4_RUNTIME  # 32bit-P4 CRC Calculation Method | Switch to select one of the available CRC 32-bit E2E Profile 4 calculation methods.
        CRC_32P4_RUNTIME  # Runtime calculation results in smaller code size, but slower execution time.
        CRC_32P4_TABLE  # Table based calculation results in fast execution, but increases ROM size.
    container CrcPublishedInformation  # This container holds default initial values for different CRC calculation methods.
      integer CrcInitialValue16: 0..65535, set at pre-compile, default-value=65535  # Init value for Crc16 | This is the initial value for the 16-bit CRC calculation.
      integer CrcInitialValue32: 0..4294967295, set at pre-compile, default-value=4294967295  # Init value for Crc32 | This is the initial value for the 32-bit CRC calculation.
      integer CrcInitialValue8: 0..255, set at pre-compile, default-value=255  # Init value for Crc8 | This is the initial value for the 8-bit (SAE J1850) CRC calculation.
      integer CrcInitialValue8H2F [0..1]: 0..255, set at pre-compile, default-value=255  # Init value for Crc8 H2F | Parameter not used
    container VectorCommonData
      string BswmdVersion: set at pre-compile, origin=Vector Informatik, default-value=5.03.00  # Version number of this Bswmd file
  bsw implementation Crc_Impl: programming-language=C, sw-version=5.02.00, used-code-generator=DaVinci Configurator, vendor-id=30, ar-release-version=4.00.03, preconfigured-configuration=Crc_Pre, recommended-configuration=Crc_Rec, vendor-specific-module-def=Crc
  module config Crc_Pre: definition=Crc
    CrcPublishedInformation: CrcInitialValue16=65535, CrcInitialValue32=4294967295, CrcInitialValue8=255, CrcInitialValue8H2F=255
  module config Crc_Rec: definition=Crc
