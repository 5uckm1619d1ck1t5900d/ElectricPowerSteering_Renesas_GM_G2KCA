AUTOSAR XML (schema 4-0-3)
# COPYRIGHT
# Copyright(c) 2014-2015 Renesas Electronics Corporation
package /Renesas/EcucDefs_Mcu
  ecuc definition collection RenesasParameterDefinition_Mcu: module=Mcu
  module definition Mcu: refined-module-def=Mcu, variants post-build  # Configuration of the MCU (Microcontroller Unit) module.
    container McuPublishedInformation  # Container holding all MCU specific published information parameters.
      container McuResetReasonConf [1..*]  # This container contains the configuration for the different type of reset reason that can be retrieved from Mcu_GetResetReason API.
        integer McuResetReason: 0..255, set at published-information, symbolic-name-value=true, default-value=0  # The parameter represents the different type of reset that a Micro supports. This parameter is referenced by the parameter EcuMResetReason in the ECU State manager module. This parameter is not used for implementation.
      container McuRstRsnConfPowOnClr  # This container contains the configuration for the different type of reset reason that can be retrieved from Mcu_GetResetReason API.
        integer McuResetReason: 0..0, set at published-information, origin=Renesas_v1.0.0, symbolic-name-value=true, default-value=0  # The parameter represents the different type of reset that a Micro supports. This parameter is referenced by the parameter EcuMResetReason in the ECU State manager module, POWER_ON_CLEAR_RST.
      container McuRstRsnConfPinRst  # This container contains the configuration for the different type of reset reason that can be retrieved from Mcu_GetResetReason API.
        integer McuResetReason: 1..1, set at published-information, origin=Renesas_v1.0.0, symbolic-name-value=true, default-value=1  # The parameter represents the different type of reset that a Micro supports. This parameter is referenced by the parameter EcuMResetReason in the ECU State manager module, MCU_PIN_RST.
      container McuRstRsnConfSwRst  # This container contains the configuration for the different type of reset reason that can be retrieved from Mcu_GetResetReason API.
        integer McuResetReason: 2..2, set at published-information, origin=Renesas_v1.0.0, symbolic-name-value=true, default-value=2  # The parameter represents the different type of reset that a Micro supports. This parameter is referenced by the parameter EcuMResetReason in the ECU State manager module, MCU_SW_RESET.
      container McuRstRsnConfWdta  # This container contains the configuration for the different type of reset reason that can be retrieved from Mcu_GetResetReason API.
        integer McuResetReason: 3..3, set at published-information, origin=Renesas_v1.0.0, symbolic-name-value=true, default-value=3  # The parameter represents the different type of reset that a Micro supports. This parameter is referenced by the parameter EcuMResetReason in the ECU State manager module, MCU_WDTA_RST.
      container McuRstRsnConfLockStepCompare  # This container contains the configuration for the different type of reset reason that can be retrieved from Mcu_GetResetReason API.
        integer McuResetReason: 4..4, set at published-information, origin=Renesas_v1.0.0, symbolic-name-value=true, default-value=4  # The parameter represents the different type of reset that a Micro supports. This parameter is referenced by the parameter EcuMResetReason in the ECU State manager module, MCU_LOCK_STEP_COMPARE_RST.
      container McuRstRsnConfClkMonUprLimErMosc  # This container contains the configuration for the different type of reset reason that can be retrieved from Mcu_GetResetReason API.
        integer McuResetReason: 5..5, set at published-information, origin=Renesas_v1.0.0, symbolic-name-value=true, default-value=5  # The parameter represents the different type of reset that a Micro supports. This parameter is referenced by the parameter EcuMResetReason in the ECU State manager module, MCU_CLK_MON_UPR_LIM_ER_MOSC_RST.
      container McuRstRsnConfClkMonLwrLimErMosc  # This container contains the configuration for the different type of reset reason that can be retrieved from Mcu_GetResetReason API.
        integer McuResetReason: 6..6, set at published-information, origin=Renesas_v1.0.0, symbolic-name-value=true, default-value=6  # The parameter represents the different type of reset that a Micro supports. This parameter is referenced by the parameter EcuMResetReason in the ECU State manager module, MCU_CLK_MON_LWR_LIM_ER_MOSC_RST.
      container McuRstRsnConfClkMonUprLimErWdt  # This container contains the configuration for the different type of reset reason that can be retrieved from Mcu_GetResetReason API.
        integer McuResetReason: 7..7, set at published-information, origin=Renesas_v1.0.0, symbolic-name-value=true, default-value=7  # The parameter represents the different type of reset that a Micro supports. This parameter is referenced by the parameter EcuMResetReason in the ECU State manager module, MCU_CLK_MON_UPR_LIM_ER_WDT_RST.
      container McuRstRsnConfClkMonLwrLimErWdt  # This container contains the configuration for the different type of reset reason that can be retrieved from Mcu_GetResetReason API.
        integer McuResetReason: 8..8, set at published-information, origin=Renesas_v1.0.0, symbolic-name-value=true, default-value=8  # The parameter represents the different type of reset that a Micro supports. This parameter is referenced by the parameter EcuMResetReason in the ECU State manager module, MCU_CLK_MON_LWR_LIM_ER_WDT_RST.
      container McuRstRsnConfClkMonUprLimErPclk  # This container contains the configuration for the different type of reset reason that can be retrieved from Mcu_GetResetReason API.
        integer McuResetReason: 9..9, set at published-information, origin=Renesas_v1.0.0, symbolic-name-value=true, default-value=9  # The parameter represents the different type of reset that a Micro supports. This parameter is referenced by the parameter EcuMResetReason in the ECU State manager module, MCU_CLK_MON_UPR_LIM_ER_PCLK_RST.
      container McuRstRsnConfClkMonLwrLimErPclk  # This container contains the configuration for the different type of reset reason that can be retrieved from Mcu_GetResetReason API.
        integer McuResetReason: 10..10, set at published-information, origin=Renesas_v1.0.0, symbolic-name-value=true, default-value=10  # The parameter represents the different type of reset that a Micro supports. This parameter is referenced by the parameter EcuMResetReason in the ECU State manager module, MCU_CLK_MON_LWR_LIM_ER_PCLK_RST.
      container McuRstRsnConfClkMonUprLimErPe1  # This container contains the configuration for the different type of reset reason that can be retrieved from Mcu_GetResetReason API.
        integer McuResetReason: 11..11, set at published-information, origin=Renesas_v1.0.0, symbolic-name-value=true, default-value=11  # The parameter represents the different type of reset that a Micro supports. This parameter is referenced by the parameter EcuMResetReason in the ECU State manager module, MCU_CLK_MON_UPR_LIM_ER_PE1_RST.
      container McuRstRsnConfClkMonLwrLimErPe1  # This container contains the configuration for the different type of reset reason that can be retrieved from Mcu_GetResetReason API.
        integer McuResetReason: 12..12, set at published-information, origin=Renesas_v1.0.0, symbolic-name-value=true, default-value=12  # The parameter represents the different type of reset that a Micro supports. This parameter is referenced by the parameter EcuMResetReason in the ECU State manager module, MCU_CLK_MON_LWR_LIM_ER_PE1_RST.
      container McuRstRsnConfLRamEcc2AddPrty  # This container contains the configuration for the different type of reset reason that can be retrieved from Mcu_GetResetReason API.
        integer McuResetReason: 13..13, set at published-information, origin=Renesas_v1.0.0, symbolic-name-value=true, default-value=13  # The parameter represents the different type of reset that a Micro supports. This parameter is referenced by the parameter EcuMResetReason in the ECU State manager module, MCU_LRAM_ECC2_ADDPTY_RST.
      container McuRstRsnConfInstCacheRamEcc2  # This container contains the configuration for the different type of reset reason that can be retrieved from Mcu_GetResetReason API.
        integer McuResetReason: 14..14, set at published-information, origin=Renesas_v1.0.0, symbolic-name-value=true, default-value=14  # The parameter represents the different type of reset that a Micro supports. This parameter is referenced by the parameter EcuMResetReason in the ECU State manager module, MCU_INST_CACHE_RAM_ECC2_RST.
      container McuRstRsnConfCodeFlsEcc2AddPrty  # This container contains the configuration for the different type of reset reason that can be retrieved from Mcu_GetResetReason API.
        integer McuResetReason: 15..15, set at published-information, origin=Renesas_v1.0.0, symbolic-name-value=true, default-value=15  # The parameter represents the different type of reset that a Micro supports. This parameter is referenced by the parameter EcuMResetReason in the ECU State manager module, MCU_CODE_FLS_ECC2_ADDPTY_RST.
      container McuRstRsnConfDataFlsEcc2  # This container contains the configuration for the different type of reset reason that can be retrieved from Mcu_GetResetReason API.
        integer McuResetReason: 16..16, set at published-information, origin=Renesas_v1.0.0, symbolic-name-value=true, default-value=16  # The parameter represents the different type of reset that a Micro supports. This parameter is referenced by the parameter EcuMResetReason in the ECU State manager module, MCU_DATA_FLS_ECC2_RST.
      container McuRstRsnConfDtsRamEcc2  # This container contains the configuration for the different type of reset reason that can be retrieved from Mcu_GetResetReason API.
        integer McuResetReason: 17..17, set at published-information, origin=Renesas_v1.0.0, symbolic-name-value=true, default-value=17  # The parameter represents the different type of reset that a Micro supports. This parameter is referenced by the parameter EcuMResetReason in the ECU State manager module, MCU_DTS_RAM_ECC2_RST.
      container McuRstRsnConfCsihRamEcc2  # This container contains the configuration for the different type of reset reason that can be retrieved from Mcu_GetResetReason API.
        integer McuResetReason: 18..18, set at published-information, origin=Renesas_v1.0.0, symbolic-name-value=true, default-value=18  # The parameter represents the different type of reset that a Micro supports. This parameter is referenced by the parameter EcuMResetReason in the ECU State manager module, MCU_CSIH_RAM_ECC2_RST.
      container McuRstRsnConfCanRamEcc2  # This container contains the configuration for the different type of reset reason that can be retrieved from Mcu_GetResetReason API.
        integer McuResetReason: 19..19, set at published-information, origin=Renesas_v1.0.0, symbolic-name-value=true, default-value=19  # The parameter represents the different type of reset that a Micro supports. This parameter is referenced by the parameter EcuMResetReason in the ECU State manager module, MCU_CAN_RAM_ECC2_RST.
      container McuRstRsnConfFrRamEcc2  # This container contains the configuration for the different type of reset reason that can be retrieved from Mcu_GetResetReason API.
        integer McuResetReason: 20..20, set at published-information, origin=Renesas_v1.0.0, symbolic-name-value=true, default-value=20  # The parameter represents the different type of reset that a Micro supports. This parameter is referenced by the parameter EcuMResetReason in the ECU State manager module, MCU_FR_RAM_ECC2_RST.
      container McuRstRsnConfFlsProgMode  # This container contains the configuration for the different type of reset reason that can be retrieved from Mcu_GetResetReason API.
        integer McuResetReason: 21..21, set at published-information, origin=Renesas_v1.0.0, symbolic-name-value=true, default-value=21  # The parameter represents the different type of reset that a Micro supports. This parameter is referenced by the parameter EcuMResetReason in the ECU State manager module, MCU_FLS_PROG_MODE_RST.
      container McuRstRsnConfTestMode  # This container contains the configuration for the different type of reset reason that can be retrieved from Mcu_GetResetReason API.
        integer McuResetReason: 22..22, set at published-information, origin=Renesas_v1.0.0, symbolic-name-value=true, default-value=22  # The parameter represents the different type of reset that a Micro supports. This parameter is referenced by the parameter EcuMResetReason in the ECU State manager module, MCU_TEST_MODE_RST.
      container McuRstRsnConfSingChipModInact  # This container contains the configuration for the different type of reset reason that can be retrieved from Mcu_GetResetReason API.
        integer McuResetReason: 23..23, set at published-information, origin=Renesas_v1.0.0, symbolic-name-value=true, default-value=23  # The parameter represents the different type of reset that a Micro supports. This parameter is referenced by the parameter EcuMResetReason in the ECU State manager module, MCU_SING_CHIP_MOD_INACT_RST.
      container McuRstRsnConfPeGuard  # This container contains the configuration for the different type of reset reason that can be retrieved from Mcu_GetResetReason API.
        integer McuResetReason: 24..24, set at published-information, origin=Renesas_v1.0.0, symbolic-name-value=true, default-value=24  # The parameter represents the different type of reset that a Micro supports. This parameter is referenced by the parameter EcuMResetReason in the ECU State manager module, MCU_PEGUARD_RST.
      container McuRstRsnConfPBusGuard  # This container contains the configuration for the different type of reset reason that can be retrieved from Mcu_GetResetReason API.
        integer McuResetReason: 25..25, set at published-information, origin=Renesas_v1.0.0, symbolic-name-value=true, default-value=25  # The parameter represents the different type of reset that a Micro supports. This parameter is referenced by the parameter EcuMResetReason in the ECU State manager module, MCU_PBUS_GUARD_RST.
      container McuRstRsnConfSarAdcPrty  # This container contains the configuration for the different type of reset reason that can be retrieved from Mcu_GetResetReason API.
        integer McuResetReason: 26..26, set at published-information, origin=Renesas_v1.0.0, symbolic-name-value=true, default-value=26  # The parameter represents the different type of reset that a Micro supports. This parameter is referenced by the parameter EcuMResetReason in the ECU State manager module, MCU_SAR_ADC_PRTY_ERR_RST.
      container McuRstRsnConfBusDataPrty  # This container contains the configuration for the different type of reset reason that can be retrieved from Mcu_GetResetReason API.
        integer McuResetReason: 27..27, set at published-information, origin=Renesas_v1.0.0, symbolic-name-value=true, default-value=27  # The parameter represents the different type of reset that a Micro supports. This parameter is referenced by the parameter EcuMResetReason in the ECU State manager module, MCU_BUS_DATA_PRTY_RST.
      container McuRstRsnConfEcmCompare  # This container contains the configuration for the different type of reset reason that can be retrieved from Mcu_GetResetReason API.
        integer McuResetReason: 28..28, set at published-information, origin=Renesas_v1.0.0, symbolic-name-value=true, default-value=28  # The parameter represents the different type of reset that a Micro supports. This parameter is referenced by the parameter EcuMResetReason in the ECU State manager module, MCU_ECM_COMPARE_RST.
      container McuRstRsnConfLvi  # This container contains the configuration for the different type of reset reason that can be retrieved from Mcu_GetResetReason API.
        integer McuResetReason: 29..29, set at published-information, origin=Renesas_v1.0.0, symbolic-name-value=true, default-value=29  # The parameter represents the different type of reset that a Micro supports. This parameter is referenced by the parameter EcuMResetReason in the ECU State manager module, MCU_LVI_RST.
      container McuRstRsnConfTempSensor  # This container contains the configuration for the different type of reset reason that can be retrieved from Mcu_GetResetReason API.
        integer McuResetReason: 30..30, set at published-information, origin=Renesas_v1.0.0, symbolic-name-value=true, default-value=30  # The parameter represents the different type of reset that a Micro supports. This parameter is referenced by the parameter EcuMResetReason in the ECU State manager module, MCU_TEMP_SENSOR_RST.
      container McuRstRsnConfDmaTrans  # This container contains the configuration for the different type of reset reason that can be retrieved from Mcu_GetResetReason API.
        integer McuResetReason: 31..31, set at published-information, origin=Renesas_v1.0.0, symbolic-name-value=true, default-value=31  # The parameter represents the different type of reset that a Micro supports. This parameter is referenced by the parameter EcuMResetReason in the ECU State manager module, MCU_DMA_TRANS_RST.
      container McuRstRsnConfDmaViol  # This container contains the configuration for the different type of reset reason that can be retrieved from Mcu_GetResetReason API.
        integer McuResetReason: 32..32, set at published-information, origin=Renesas_v1.0.0, symbolic-name-value=true, default-value=32  # The parameter represents the different type of reset that a Micro supports. This parameter is referenced by the parameter EcuMResetReason in the ECU State manager module, MCU_DMA_VIOL_RST.
      container McuRstRsnConfLRamEcc1  # This container contains the configuration for the different type of reset reason that can be retrieved from Mcu_GetResetReason API.
        integer McuResetReason: 33..33, set at published-information, origin=Renesas_v1.0.0, symbolic-name-value=true, default-value=33  # The parameter represents the different type of reset that a Micro supports. This parameter is referenced by the parameter EcuMResetReason in the ECU State manager module, MCU_LRAM_ECC1_RST.
      container McuRstRsnConfCodeFlsEcc1  # This container contains the configuration for the different type of reset reason that can be retrieved from Mcu_GetResetReason API.
        integer McuResetReason: 34..34, set at published-information, origin=Renesas_v1.0.0, symbolic-name-value=true, default-value=34  # The parameter represents the different type of reset that a Micro supports. This parameter is referenced by the parameter EcuMResetReason in the ECU State manager module, MCU_CODE_FLS_ECC1_RST.
      container McuRstRsnConfDataFlsEcc1  # This container contains the configuration for the different type of reset reason that can be retrieved from Mcu_GetResetReason API.
        integer McuResetReason: 35..35, set at published-information, origin=Renesas_v1.0.0, symbolic-name-value=true, default-value=35  # The parameter represents the different type of reset that a Micro supports. This parameter is referenced by the parameter EcuMResetReason in the ECU State manager module, MCU_DATA_FLS_ECC1_RST.
      container McuRstRsnConfDtsRamEcc1  # This container contains the configuration for the different type of reset reason that can be retrieved from Mcu_GetResetReason API.
        integer McuResetReason: 36..36, set at published-information, origin=Renesas_v1.0.0, symbolic-name-value=true, default-value=36  # The parameter represents the different type of reset that a Micro supports. This parameter is referenced by the parameter EcuMResetReason in the ECU State manager module, MCU_DTS_RAM_ECC1_RST.
      container McuRstRsnConfPeriRamEcc1  # This container contains the configuration for the different type of reset reason that can be retrieved from Mcu_GetResetReason API.
        integer McuResetReason: 37..37, set at published-information, origin=Renesas_v1.0.0, symbolic-name-value=true, default-value=37  # The parameter represents the different type of reset that a Micro supports. This parameter is referenced by the parameter EcuMResetReason in the ECU State manager module, MCU_PERI_RAM_ECC1_RST.
      container McuRstRsnConfBistCodeEcc1  # This container contains the configuration for the different type of reset reason that can be retrieved from Mcu_GetResetReason API.
        integer McuResetReason: 38..38, set at published-information, origin=Renesas_v1.0.0, symbolic-name-value=true, default-value=38  # The parameter represents the different type of reset that a Micro supports. This parameter is referenced by the parameter EcuMResetReason in the ECU State manager module, MCU_BIST_CODE_ECC1_RST.
      container McuRstRsnConfBistCodeEcc2  # This container contains the configuration for the different type of reset reason that can be retrieved from Mcu_GetResetReason API.
        integer McuResetReason: 39..39, set at published-information, origin=Renesas_v1.0.0, symbolic-name-value=true, default-value=39  # The parameter represents the different type of reset that a Micro supports. This parameter is referenced by the parameter EcuMResetReason in the ECU State manager module, MCU_BIST_CODE_ECC2_RST.
      container McuRstRsnConfFaci  # This container contains the configuration for the different type of reset reason that can be retrieved from Mcu_GetResetReason API.
        integer McuResetReason: 40..40, set at published-information, origin=Renesas_v1.0.0, symbolic-name-value=true, default-value=40  # The parameter represents the different type of reset that a Micro supports. This parameter is referenced by the parameter EcuMResetReason in the ECU State manager module, MCU_FACI_RST.
      container McuRstRsnConfEcmDelayOverFlow  # This container contains the configuration for the different type of reset reason that can be retrieved from Mcu_GetResetReason API.
        integer McuResetReason: 41..41, set at published-information, origin=Renesas_v1.0.0, symbolic-name-value=true, default-value=41  # The parameter represents the different type of reset that a Micro supports. This parameter is referenced by the parameter EcuMResetReason in the ECU State manager module, MCU_ECM_DELY_OVRFLW_RST.
      container McuRstRsnConfCvmRst  # This container contains the configuration for the different type of reset reason that can be retrieved from Mcu_GetResetReason API.
        integer McuResetReason: 42..42, set at published-information, origin=Renesas_v1.0.0, symbolic-name-value=true, default-value=42  # The parameter represents the different type of reset that a Micro supports. This parameter is referenced by the parameter EcuMResetReason in the ECU State manager module, MCU_CVM_RST.
      container McuRstRsnConfRstUndefined  # This container contains the configuration for the different type of reset reason that can be retrieved from Mcu_GetResetReason API.
        integer McuResetReason: 43..43, set at published-information, origin=Renesas_v1.0.0, symbolic-name-value=true, default-value=43  # The parameter represents the different type of reset that a Micro supports. This parameter is referenced by the parameter EcuMResetReason in the ECU State manager module, MCU_RESET_UNDEFINED.
      container McuRstRsnConfRstUnknown  # This container contains the configuration for the different type of reset reason that can be retrieved from Mcu_GetResetReason API.
        integer McuResetReason: 44..44, set at published-information, origin=Renesas_v1.0.0, symbolic-name-value=true, default-value=44  # The parameter represents the different type of reset that a Micro supports. This parameter is referenced by the parameter EcuMResetReason in the ECU State manager module, MCU_RESET_UNKNOWN.
    container McuGeneralConfiguration  # This container contains the configuration (parameters) of the MCU driver.
      boolean McuVersionCheckExternalModules: set at pre-compile, origin=Renesas_v1.0.0, default-value=true  # Enable / disable AUTOSAR Version check for inter-module dependencies. | true: AUTOSAR Version check for inter-module dependencies is enabled. false: AUTOSAR Version check for inter-module dependencies is disabled.
      boolean McuDevErrorDetect: set at pre-compile, default-value=false  # Pre-processor switch for enabling the development error detection and reporting. | true: Enables development error detection and reporting. false: Disables development error detection and reporting.
      boolean McuGetRamStateApi: set at pre-compile, default-value=false  # Pre-processor switch to enable/disable the API Mcu_GetRamState. | (e.g. If the H/W does not support the functionality, this parameter can be used to disable the API). true: API Mcu_GetRamState is enabled. false: API Mcu_GetRamState is disabled.
      boolean McuInitClock: set at pre-compile, default-value=true  # If this parameter is set to FALSE, the clock initialization has to be disabled from the MCU driver. This concept applies when there are some write once clock registers and a bootloader is present. If this parameter is set to TRUE, the MCU driver is responsible for the clock initialization. | true: The MCU driver is responsible for the clock initialization. false: The clock initialization is disabled from the MCU driver.
      boolean McuNoPll: set at pre-compile, default-value=true  # This parameter shall be set true, if the H/W does not have a PLL or the PLL circuitry is enabled after the power on without S/W intervention. In this case MCU_DistributePllClock has to be disabled and MCU_GetPllStatus has to return MCU_PLL_STATUS_UNDEFINED. Otherwise this parameter has to be set False. | true: The H/W does not have a PLL or the PLL circuitry is enabled after the power on without S/W intervention. false: The H/W have a PLL or the PLL circuitry is disabled after the power on without S/W intervention.
      boolean McuPerformResetApi: set at pre-compile, default-value=false  # Pre-processor switch to enable or disable the use of the function Mcu_PerformReset(). | true: Enables the use of the function Mcu_PerformReset(). false: Disables the use of the function Mcu_PerformReset().
      boolean McuVersionInfoApi: set at pre-compile, default-value=false  # Pre-processor switch to enable or disable the API to read out the modules version information. | true: Enables the API to read out the modules version information. false: Disables the API to read out the modules version information.
      boolean McuCriticalSectionProtection: set at pre-compile, origin=Renesas_v1.0.0, default-value=true  # This parameter specifies if the MCU driver CPU load can be reduced by disabling the enter/exit critical section functionality by adding a precompiled configuration parameter to the MCU driver configuration. | true: Enables the critical section functionality for the restricted area. false: Disables the critical section functionality for the restricted area.
      boolean McuSwResetCallApi: set at pre-compile, origin=Renesas_v1.0.0, default-value=false  # This parameter shall decide if MCU_RESET_CALLOUT API will be used for to reset software. | true: MCU_RESET_CALLOUT API will be used for reset software. false: MCU_RESET_CALLOUT API will not be used for reset software.
      integer McuEcmDelayTimerOverflowValue: 0..65535, set at pre-compile, origin=Renesas_v1.0.0, default-value=65535  # This parameter specifies to configure the overflow value for the ECM delay timer. This value will be compared with ECM delay timer register. The ECM delay timer uses high speed peripheral clock signal for counting.
      enumeration McuEcmErrorOutputMode: {NON_DYNAMIC_MODE, DYNAMIC_MODE}, set at pre-compile, origin=Renesas_v1.0.0, default-value=NON_DYNAMIC_MODE  # This parameter used to configure the error output either in Dynamic or Non-Dynamic mode. | NON_DYNAMIC_MODE: error output in Non-Dynamic mode. DYNAMIC_MODE: error output in Dynamic mode.
      boolean McuEcmErrorOutTimer: set at pre-compile, origin=Renesas_v1.0.0, default-value=false  # This parameter used to selects the timer output in Dynamic mode. | true: Timer output selection to OSTM1. false: Timer output selection to Channel 15 in TAUD1.
      boolean McuRamSectorSetting: set at pre-compile, origin=Renesas_v1.0.0, default-value=false  # This parameter enable or disable Mcu_InitRamSection API. | true: enables Mcu_InitRamSection API. false: disables Mcu_InitRamSection API.
      enumeration McuDeviceName: {R7F701310, R7F701311, R7F701312, R7F701313, R7F701314, R7F701315, R7F701318, R7F701319, R7F701320, R7F701321, R7F701322, R7F701323}, set at pre-compile, origin=Renesas_v1.0.0, default-value=R7F701312  # This parameter contains the supported device name to identify the device specific C header file through Translation XML File. | R7F701310, R7F701311, R7F701312, R7F701313, R7F701314, R7F701315, R7F701318, R7F701319, R7F701320, R7F701321, R7F701322 and R7F701323: This value should be child tag of TRANSLATION-FILE-PATH and DEVICE-FILE-PATH tag in Translation XML File.
      boolean McuClm0Operation: set at post-build, origin=Renesas_v1.0.0, default-value=false  # This parameter enables or disables operation of clock monitor function for CLMA0. | true: Enables operation of clock monitor function for CLMA0. false: Disables operation of clock monitor function for CLMA0.
      integer McuClm0MonitoringClockAccuracy: 0..20, set at pre-compile, origin=Renesas_v1.0.0, default-value=9  # This parameter specifies the monitoring clock accuracy of CLMA0 in percentage.
      integer McuClm0SamplingClockAccuracy: 0..20, set at pre-compile, origin=Renesas_v1.0.0, default-value=9  # This parameter specifies the sampling clock accuracy of CLMA0 in percentage.
      boolean McuClm1Operation: set at post-build, origin=Renesas_v1.0.0, default-value=false  # This parameter enables or disables operation of clock monitor function for CLMA1. | true: Enables operation of clock monitor function for CLMA1. false: Disables operation of clock monitor function for CLMA1.
      integer McuClm1MonitoringClockAccuracy: 0..20, set at pre-compile, origin=Renesas_v1.0.0, default-value=9  # This parameter specifies the monitoring clock accuracy of CLMA1 in percentage.
      integer McuClm1SamplingClockAccuracy: 0..20, set at pre-compile, origin=Renesas_v1.0.0, default-value=9  # This parameter specifies the sampling clock accuracy of CLMA1 in percentage.
      boolean McuClm2Operation: set at post-build, origin=Renesas_v1.0.0, default-value=false  # This parameter enables or disables operation of clock monitor function for CLMA2. | true: Enables operation of clock monitor function for CLMA2. false: Disables operation of clock monitor function for CLMA2.
      integer McuClm2MonitoringClockAccuracy: 0..20, set at pre-compile, origin=Renesas_v1.0.0, default-value=14  # This parameter specifies the monitoring clock accuracy of CLMA2 in percentage.
      integer McuClm2SamplingClockAccuracy: 0..20, set at pre-compile, origin=Renesas_v1.0.0, default-value=14  # This parameter specifies the sampling clock accuracy of CLMA2 in percentage.
      boolean McuClm3Operation: set at post-build, origin=Renesas_v1.0.0, default-value=false  # This parameter enables or disables operation of clock monitor function for CLMA3. | true: Enables operation of clock monitor function for CLMA3. false: Disables operation of clock monitor function for CLMA3.
      integer McuClm3MonitoringClockAccuracy: 0..20, set at pre-compile, origin=Renesas_v1.0.0, default-value=14  # This parameter specifies the monitoring clock accuracy of CLMA3 in percentage.
      integer McuClm3SamplingClockAccuracy: 0..20, set at pre-compile, origin=Renesas_v1.0.0, default-value=14  # This parameter specifies the sampling clock accuracy of CLMA3 in percentage.
      boolean McuCvmSelfDiagnosticTest: set at pre-compile, origin=Renesas_v1.0.0, default-value=false  # This parameter enables or disables operation of self diagnostic test supported for CVM. This test shall be performed during initialization phase in the module specific initialization function. If self diagnostic test fails then DEM error will be reported. | true: Enables operation of self diagnostic test supported for CVM. false: Disables operation of self diagnostic test supported for CVM.
      boolean McuClma0SelfDiagnosticTest: set at pre-compile, origin=Renesas_v1.0.0, default-value=false  # This parameter enables or disables operation of self diagnostic test supported for CLMA0. CLMA0 Self-diagnostic tests shall be performed during initialization phase in the module specific initialization function. If self diagnostic test fails then DEM error will be reported. | true: Enables operation of self diagnostic test supported for CLMA0. false: Disables operation of self diagnostic test supported for CLMA0.
      boolean McuClma1SelfDiagnosticTest: set at pre-compile, origin=Renesas_v1.0.0, default-value=false  # This parameter enables or disables operation of self diagnostic test supported for CLMA1. CLMA1 Self-diagnostic tests shall be performed during initialization phase in the module specific initialization function. If self diagnostic test fails then DEM error will be reported. | true: Enables operation of self diagnostic test supported for CLMA1. false: Disables operation of self diagnostic test supported for CLMA1.
      boolean McuClma2SelfDiagnosticTest: set at pre-compile, origin=Renesas_v1.0.0, default-value=false  # This parameter enables or disables operation of self diagnostic test supported for CLMA2. CLMA2 Self-diagnostic tests shall be performed during initialization phase in the module specific initialization function. If self diagnostic test fails then DEM error will be reported. | true: Enables operation of self diagnostic test supported for CLMA2. false: Disables operation of self diagnostic test supported for CLMA2.
      boolean McuClma3SelfDiagnosticTest: set at pre-compile, origin=Renesas_v1.0.0, default-value=false  # This parameter enables or disables operation of self diagnostic test supported for CLMA3. CLMA3 Self-diagnostic tests shall be performed during initialization phase in the module specific initialization function. If self diagnostic test fails then DEM error will be reported. | true: Enables operation of self diagnostic test supported for CLMA3. false: Disables operation of self diagnostic test supported for CLMA3.
      boolean McuEcmSelfDiagnosticTest: set at pre-compile, origin=Renesas_v1.0.0, default-value=false  # This parameter enables or disables operation of self diagnostic test supported for ECM(Error Control Module) in order to test the ERROROUTZ signal. ECM Self-diagnostic tests shall be performed during initialization phase in the module specific initialization function. | true: Enables operation of self diagnostic test supported for ECM. false: Disables operation of self diagnostic test supported for ECM.
      boolean McuReadBackConfiguration: set at pre-compile, origin=Renesas_v1.0.0, default-value=false  # This parameter enables or disables operation of read back the configuration/control register values after writing into them. It is applicable to all API's which writes data to configuration and control registers. If Read back test fails then DEM error will be reported. | true: Enables operation of read back the configuration/control register values. false: Disables operation of read back the configuration/control register values.
      integer McuLoopCount: 1..255, set at pre-compile, origin=Renesas_v1.0.0, default-value=5  # The count value for the feed back loop in Mcu module. The loop can be minimum 1 to maximum 255
      boolean McuLockStepSelfDiagnosticTest: set at pre-compile, origin=Renesas_v1.1.1, default-value=false  # This parameter is used to monitor the functionalities of the lockstep mode. | true: Enables the Compare Unit Self-diagnostic test during initialisation phase. false: Disables the Compare Unit Self-diagnostic test during initialisation phase.
    container McuModuleConfiguration: multiple-configuration-container=true  # This container contains the configuration (parameters) of the MCU driver.
      enumeration McuClockSrcFailureNotification: {DISABLED, ENABLED}, set at post-build, default-value=DISABLED  # This parameter enables or disables clock failure notification. In case this feature is not supported by HW the setting should be disabled. This parameter is not used for implementation. | ENABLED: enables clock failure notification. DISABLED: disables clock failure notification.
      enumeration McuLviDetectionLevel: {DETECTION_LEVEL_0, DETECTION_LEVEL_1, DETECTION_LEVEL_3}, set at post-build, origin=Renesas_v1.0.0, default-value=DETECTION_LEVEL_0  # This parameter contains the Low Voltage Indicator (LVI) detection level. | DETECTION_LEVEL_0: LVI is not active. DETECTION_LEVEL_1: LVI level 1 (4.5 V). DETECTION_LEVEL_3: LVI level 3 (3.1 V).
      boolean McuLviResetMask: set at post-build, origin=Renesas_v1.0.0, default-value=false  # This parameter contains the LVI error mask or un-mask setting. | true: LVI error is masked. false: LVI error is not masked.
      integer McuNumberOfMcuModes: 1..255, set at pre-compile, default-value=1  # This parameter shall represent the number of Modes available for the MCU. Controller is not supporting low power modes hence this parameter is not used for implementation. | calculation Formula = Number of configured McuModeSettingConf
      integer McuRamSectors: 1..4294967295, set at post-build, default-value=1  # This parameter shall represent the number of RAM sectors available for the MCU. Parameter "McuRamSectorSetting" in "McuGeneralConfiguration" container is used instead of this parameter. Hence this parameter is not used for implementation. | calculation Formula = Number of configured McuRamSectorSettingConf
      integer McuResetSetting [0..1]: 1..255, set at pre-compile, default-value=1  # This parameter relates to the MCU specific reset configuration. This applies to the function Mcu_PerformReset, which performs a microcontroller reset using the hardware feature of the microcontroller. Since there is no configuration of reset feature required for performing reset of this microcontroller using Mcu_PerformReset api, hence this parameter is not used for implementation.
      boolean McuCvmOutMaskFbist: set at post-build, origin=Renesas_v1.0.0, default-value=false  # This parameter enables or disables the CVMOUT Output Mask for FBIST Operation. | true: disables the CVMOUT Output Mask for FBIST Operation. false: enables the CVMOUT Output Mask for FBIST Operation.
      boolean McuCvmOutMaskDiag: set at post-build, origin=Renesas_v1.0.0, default-value=false  # This parameter enables or disables the CVMOUT Output Mask for DIAG Operation. | true: disables the CVMOUT Output Mask for DIAG Operation. false: enables the CVMOUT Output Mask for DIAG Operation.
      boolean McuCvmOutputFilter: set at post-build, origin=Renesas_v1.0.0, default-value=false  # This parameter enables or disables the CVMOUT Output Filter Control. | true: disables the 1 micro output filter of CVMOUT. false: enables the 1 micro output filter of CVMOUT.
      boolean McuCvmResetEnable: set at post-build, origin=Renesas_v1.0.0, default-value=false  # This parameter enables or disables a reset of core voltage operation area upon detection of abnormal in core power supply. The register CVMREN can be set only once after a power-on reset is cancelled. So, it should be taken care while configuring this parameter for multiple configurations. | true: enables a reset of core voltage operation. false: disables a reset of core voltage operation.
      container McuClockSettingConfig [1..2]  # This container contains the configuration (parameters) for the Clock settings of the MCU. Please see MCU031 for more information on the MCU clock settings.
        integer McuClockSettingId: 0..255, set at pre-compile, symbolic-name-value=true, default-value=0  # The Id of this McuClockSettingConfig to be used as argument for the API call "Mcu_InitClock".
        integer McuMainOsciFrequency: 16000000..16000000, set at pre-compile, origin=Renesas_v1.0.0, default-value=16000000  # This parameter holds the main oscillator frequency in Hz.
        integer McuCpuMainSysClk: 160000000..160000000, set at post-build, origin=Renesas_v1.0.0, default-value=160000000  # This parameter contains the CPU main system clock frequency. This parameter does not affect the behavior of the MCU driver. It is a frequency that will be available to other modules for reference. It either needs to be calculated manually or by the configuration editor.
        enumeration McuUnitName: {CLK_CPU}, set at post-build, origin=Renesas_v1.0.0, default-value=CLK_CPU  # This parameter contains the functional unit name for the CPU. | CLK_CPU: CLK_CPU is unit name.
        container McuHighspeedPeriClk [0..1]  # This container contains the parameters related to High Speed Peripheral clock.
          enumeration McuUnitName: {CLK_HSB}, set at post-build, origin=Renesas_v1.0.0, default-value=CLK_HSB  # This parameter contains the functional unit name for the High Speed Peripheral clock. | CLK_HSB: CLK_HSB is unit name.
          integer McuPeripheralClock: 80000000..80000000, set at post-build, origin=Renesas_v1.0.0, default-value=80000000  # This parameter contains the High Speed Peripheral clock value. Unit is in Hertz.
        container McuLowspeedPeriClk [0..1]  # This container contains the parameters related to Low Speed Peripheral clock.
          enumeration McuUnitName: {CLK_LSB}, set at post-build, origin=Renesas_v1.0.0, default-value=CLK_LSB  # This parameter contains the functional unit name for the Low Speed Peripheral clock. | CLK_LSB: CLK_LSB is unit name.
          integer McuPeripheralClock: 40000000..40000000, set at post-build, origin=Renesas_v1.0.0, default-value=40000000  # This parameter contains the Low Speed Peripheral clock value. Unit is in Hertz.
        container McuWdtacounterClk [0..1]  # This container contains the parameters related to Wdta counter Clock.
          enumeration McuWdtCounterDivider: {DIVBY_1_ID_1, DIVBY_32_ID_1}, set at post-build, origin=Renesas_v1.0.0, default-value=DIVBY_1_ID_1  # This parameter contains the divider for the WDTA counter clock. | DIVBY_1_ID_1: WdtacounterClk/1 is selected as clock divider. DIVBY_32_ID_1: WdtacounterClk/32 is selected as clock divider.
          enumeration McuUnitName: {WDTCLKI}, set at post-build, origin=Renesas_v1.0.0, default-value=WDTCLKI  # This parameter contains the functional unit name for the Wdta counter Clock. | WDTCLKI: WDTCLKI is unit name.
          integer McuPeripheralClock: 250000..8000000, set at post-build, origin=Renesas_v1.0.0, default-value=8000000  # This parameter contains the Wdta counter Clock. Unit is in Hertz.
        container McuExternalClkOutSetting  # This container contains the parameters related to External clock output Setting.
          enumeration McuExternalClk0SourceSel: {MCU_NO_OUTPUT, MCU_MAIN_OSCILLATOR, MCU_INTERNAL_OSCILLATION_CLOCK, MCU_HIGH_SPEED_PERI_CLOCK}, set at post-build, origin=Renesas_v1.0.0, default-value=MCU_NO_OUTPUT  # This parameter is to select the external clock 0 source. | MCU_NO_OUTPUT: No clock. MCU_MAIN_OSCILLATOR: 16MHz MainOSC. MCU_INTERNAL_OSCILLATION_CLOCK: 8MHz HS IntOSC. MCU_HIGH_SPEED_PERI_CLOCK: 80MHz High-speed peripheral clock.
          integer McuExternalClk0DividerSel: 1..511, set at post-build, origin=Renesas_v1.0.0, default-value=1  # This parameter is to select the divider for external clock 0 source. The value configured for this parameter will be ignored if parameter 'McuExternalClk0SourceSel' is configured as 'MCU_NO_OUTPUT'.
          integer McuExternalClock0: 0..80000000, set at post-build, origin=Renesas_v1.0.0, default-value=0  # This parameter contains the output of External Clock 0 value.
          enumeration McuExternalClk1SourceSel: {MCU_NO_OUTPUT, MCU_MAIN_OSCILLATOR, MCU_INTERNAL_OSCILLATION_CLOCK, MCU_HIGH_SPEED_PERI_CLOCK}, set at post-build, origin=Renesas_v1.0.0, default-value=MCU_NO_OUTPUT  # This parameter is to select the external clock 1 source. | MCU_NO_OUTPUT: No clock. MCU_MAIN_OSCILLATOR: 16MHz MainOSC. MCU_INTERNAL_OSCILLATION_CLOCK: 8MHz HS IntOSC. MCU_HIGH_SPEED_PERI_CLOCK: 80MHz High-speed peripheral clock.
          integer McuExternalClk1DividerSel: 1..511, set at post-build, origin=Renesas_v1.0.0, default-value=1  # This parameter is to select the divider for external clock 1 source. The value configured for this parameter will be ignored if parameter 'McuExternalClk1SourceSel' is configured as 'MCU_NO_OUTPUT'.
          integer McuExternalClock1: 0..80000000, set at post-build, origin=Renesas_v1.0.0, default-value=0  # This parameter contains the output of External Clock 1 value.
        container McuClockReferencePoint [1..*]  # This container defines a reference point in the Mcu Clock tree. It defines the frequency which can be used by other modules as an input value. Lower multiplicity is 1, as even in the simplest case (only one frequency is used), there is one frequency to be defined. This container is not used for implementation.
          float McuClockReferencePointFrequency: 0..160000000, set at post-build, default-value=0  # This is the frequency for the specific instance of the McuClockReferencePoint container. It shall be given in Hz. This parameter is not used for implementation. So if its used for reference frequency then user has to take care for configuration of valid clock domain associated with it.
      container McuEcmErrorSourcesCfg  # This container contains the configuration related to all the error sources which are input to ECM.
        container McuEcmErrorSource0  # This container contains all the supported configuration parameters of the related error source from WDTA module.
          boolean McuEcmErrorMaskableInterrupt: set at post-build, origin=Renesas_v1.0.0, default-value=false  # This parameter enables or disables generation of a maskable interrupt when the error occurs from WDTA module. | true: enables generation of a maskable interrupt when the error occurs from WDTA module. false: disables generation of a maskable interrupt when the error occurs from WDTA module.
          boolean McuEcmErrorNonMaskableInterrupt: set at post-build, origin=Renesas_v1.0.0, default-value=false  # This parameter enables or disables generation of a non-maskable interrupt when the error occurs from WDTA module. | true: enables generation of a non-maskable interrupt when the error occurs from WDTA module. false: disables generation of a non-maskable interrupt when the error occurs from WDTA module.
          boolean McuEcmErrorInternalReset: set at post-build, origin=Renesas_v1.0.0, default-value=false  # This parameter enables or disables generation of an internal reset when the error occurs from WDTA module. | true: enables generation of an internal reset when the error occurs from WDTA module. false: disables generation of an internal reset when the error occurs from WDTA module.
          boolean McuEcmErrorNMIDelayTimer: set at post-build, origin=Renesas_v1.0.0, default-value=false  # This parameter enables or disables delay timer start caused by non-maskable interrupts in response to errors from WDTA module. | true: enables delay timer start caused by non-maskable interrupts in response to errors from WDTA module. false: disables delay timer start caused by non-maskable interrupts in response to errors from WDTA module.
          boolean McuEcmErrorMIDelayTimer: set at post-build, origin=Renesas_v1.0.0, default-value=false  # This parameter enables or disables delay timer start caused by maskable interrupts in response to errors from WDTA module. | true: enables delay timer start caused by maskable interrupts in response to errors from WDTA module. false: disables delay timer start caused by maskable interrupts in response to errors from WDTA module.
          boolean McuEcmErrorOutputMask: set at post-build, origin=Renesas_v1.0.0, default-value=true  # This parameter mask or unmask the individual error sources of the error pin output from WDTA module. | true: mask the individual error sources of the error pin output from WDTA module. false: unmask the individual error sources of the error pin output from WDTA module.
          function name McuMiNotification [0..1]: set at post-build, origin=Renesas_v1.0.0, default-value=NULL_PTR, regular-expression=[a-zA-Z][a-zA-Z0-9_]*  # This parameter contains notification function for MI notification. | The syntax for McuMiNotification should be provided as Mcu_EcmMINotification.
          function name McuNmiNotification [0..1]: set at post-build, origin=Renesas_v1.0.0, default-value=NULL_PTR, regular-expression=[a-zA-Z][a-zA-Z0-9_]*  # This parameter contains notification function for NMI notification. | The syntax for McuNmiNotification should be provided as Mcu_EcmNMINotification.
        container McuEcmErrorSource1  # This container contains all the supported configuration parameters of the related error source from Lock step compare module.
          boolean McuEcmErrorMaskableInterrupt: set at post-build, origin=Renesas_v1.0.0, default-value=false  # This parameter enables or disables generation of a maskable interrupt when the error occurs from Lock step compare module. | true: enables generation of a maskable interrupt when the error occurs from Lock step compare module. false: disables generation of a maskable interrupt when the error occurs from Lock step compare module.
          boolean McuEcmErrorNonMaskableInterrupt: set at post-build, origin=Renesas_v1.0.0, default-value=false  # This parameter enables or disables generation of a non-maskable interrupt when the error occurs from Lock step compare module. | true: enables generation of a non-maskable interrupt when the error occurs from Lock step compare module. false: disables generation of a non-maskable interrupt when the error occurs from Lock step compare module.
          boolean McuEcmErrorInternalReset: set at post-build, origin=Renesas_v1.0.0, default-value=false  # This parameter enables or disables generation of an internal reset when the error occurs from Lock step compare module. | true: enables generation of an internal reset when the error occurs from Lock step compare module. false: disables generation of an internal reset when the error occurs from Lock step compare module.
          boolean McuEcmErrorNMIDelayTimer: set at post-build, origin=Renesas_v1.0.0, default-value=false  # This parameter enables or disables delay timer start caused by non-maskable interrupts in response to errors from Lock step compare module. | true: enables delay timer start caused by non-maskable interrupts in response to errors from Lock step compare module. false: disables delay timer start caused by non-maskable interrupts in response to errors from Lock step compare module.
          boolean McuEcmErrorMIDelayTimer: set at post-build, origin=Renesas_v1.0.0, default-value=false  # This parameter enables or disables delay timer start caused by maskable interrupts in response to errors from Lock step compare module. | true: enables delay timer start caused by maskable interrupts in response to errors from Lock step compare module. false: disables delay timer start caused by maskable interrupts in response to errors from Lock step compare module.
          boolean McuEcmErrorOutputMask: set at post-build, origin=Renesas_v1.0.0, default-value=true  # This parameter mask or unmask the individual error sources of the error pin output from Lock step compare module. | true: mask the individual error sources of the error pin output from Lock step compare module. false: unmask the individual error sources of the error pin output from Lock step compare module.
          function name McuMiNotification [0..1]: set at post-build, origin=Renesas_v1.0.0, default-value=NULL_PTR, regular-expression=[a-zA-Z][a-zA-Z0-9_]*  # This parameter contains notification function for MI notification. | The syntax for McuMiNotification should be provided as Mcu_EcmMINotification.
          function name McuNmiNotification [0..1]: set at post-build, origin=Renesas_v1.0.0, default-value=NULL_PTR, regular-expression=[a-zA-Z][a-zA-Z0-9_]*  # This parameter contains notification function for NMI notification. | The syntax for McuNmiNotification should be provided as Mcu_EcmNMINotification.
        container McuEcmErrorSource4  # This container contains all the supported configuration parameters of the related error source from Clock monitor upper-limit error (MOSC).
          boolean McuEcmErrorMaskableInterrupt: set at post-build, origin=Renesas_v1.0.0, default-value=false  # This parameter enables or disables generation of a maskable interrupt when the error occurs from Clock monitor upper-limit error (MOSC). | true: enables generation of a maskable interrupt when the error occurs from Clock monitor upper-limit error (MOSC). false: disables generation of a maskable interrupt when the error occurs from Clock monitor upper-limit error (MOSC).
          boolean McuEcmErrorNonMaskableInterrupt: set at post-build, origin=Renesas_v1.0.0, default-value=false  # This parameter enables or disables generation of a non-maskable interrupt when the error occurs from Clock monitor upper-limit error (MOSC). | true: enables generation of a non-maskable interrupt when the error occurs from Clock monitor upper-limit error (MOSC). false: disables generation of a non-maskable interrupt when the error occurs from Clock monitor upper-limit error (MOSC).
          boolean McuEcmErrorInternalReset: set at post-build, origin=Renesas_v1.0.0, default-value=false  # This parameter enables or disables generation of an internal reset when the error occurs from Clock monitor upper-limit error (MOSC). | true: enables generation of an internal reset when the error occurs from Clock monitor upper-limit error (MOSC). false: disables generation of an internal reset when the error occurs from Clock monitor upper-limit error (MOSC).
          boolean McuEcmErrorNMIDelayTimer: set at post-build, origin=Renesas_v1.0.0, default-value=false  # This parameter enables or disables delay timer start caused by non-maskable interrupts in response to errors from Clock monitor upper-limit error (MOSC). | true: enables delay timer start caused by non-maskable interrupts in response to errors from Clock monitor upper-limit error (MOSC). false: disables delay timer start caused by non-maskable interrupts in response to errors from Clock monitor upper-limit error (MOSC).
          boolean McuEcmErrorMIDelayTimer: set at post-build, origin=Renesas_v1.0.0, default-value=false  # This parameter enables or disables delay timer start caused by maskable interrupts in response to errors from Clock monitor upper-limit error (MOSC). | true: enables delay timer start caused by maskable interrupts in response to errors from Clock monitor upper-limit error (MOSC). false: disables delay timer start caused by maskable interrupts in response to errors from Clock monitor upper-limit error (MOSC).
          boolean McuEcmErrorOutputMask: set at post-build, origin=Renesas_v1.0.0, default-value=true  # This parameter mask or unmask the individual error sources of the error pin output from Clock monitor upper-limit error (MOSC). | true: mask the individual error sources of the error pin output from Clock monitor upper-limit error (MOSC). false: unmask the individual error sources of the error pin output from Clock monitor upper-limit error (MOSC).
          function name McuMiNotification [0..1]: set at post-build, origin=Renesas_v1.0.0, default-value=NULL_PTR, regular-expression=[a-zA-Z][a-zA-Z0-9_]*  # This parameter contains notification function for MI notification. | The syntax for McuMiNotification should be provided as Mcu_EcmMINotification.
          function name McuNmiNotification [0..1]: set at post-build, origin=Renesas_v1.0.0, default-value=NULL_PTR, regular-expression=[a-zA-Z][a-zA-Z0-9_]*  # This parameter contains notification function for NMI notification. | The syntax for McuNmiNotification should be provided as Mcu_EcmNMINotification.
        container McuEcmErrorSource5  # This container contains all the supported configuration parameters of the related error source from Clock monitor lower-limit error (MOSC).
          boolean McuEcmErrorMaskableInterrupt: set at post-build, origin=Renesas_v1.0.0, default-value=false  # This parameter enables or disables generation of a maskable interrupt when the error occurs from Clock monitor lower-limit error (MOSC). | true: enables generation of a maskable interrupt when the error occurs from Clock monitor lower-limit error (MOSC). false: disables generation of a maskable interrupt when the error occurs from Clock monitor lower-limit error (MOSC).
          boolean McuEcmErrorNonMaskableInterrupt: set at post-build, origin=Renesas_v1.0.0, default-value=false  # This parameter enables or disables generation of a non-maskable interrupt when the error occurs from Clock monitor lower-limit error (MOSC). | true: enables generation of a non-maskable interrupt when the error occurs from Clock monitor lower-limit error (MOSC). false: disables generation of a non-maskable interrupt when the error occurs from Clock monitor lower-limit error (MOSC).
          boolean McuEcmErrorInternalReset: set at post-build, origin=Renesas_v1.0.0, default-value=false  # This parameter enables or disables generation of an internal reset when the error occurs from Clock monitor lower-limit error (MOSC). | true: enables generation of an internal reset when the error occurs from Clock monitor lower-limit error (MOSC). false: disables generation of an internal reset when the error occurs from Clock monitor lower-limit error (MOSC).
          boolean McuEcmErrorNMIDelayTimer: set at post-build, origin=Renesas_v1.0.0, default-value=false  # This parameter enables or disables delay timer start caused by non-maskable interrupts in response to errors from Clock monitor lower-limit error (MOSC). | true: enables delay timer start caused by non-maskable interrupts in response to errors from Clock monitor lower-limit error (MOSC). false: disables delay timer start caused by non-maskable interrupts in response to errors from Clock monitor lower-limit error (MOSC).
          boolean McuEcmErrorMIDelayTimer: set at post-build, origin=Renesas_v1.0.0, default-value=false  # This parameter enables or disables delay timer start caused by maskable interrupts in response to errors from Clock monitor lower-limit error (MOSC). | true: enables delay timer start caused by maskable interrupts in response to errors from Clock monitor lower-limit error (MOSC). false: disables delay timer start caused by maskable interrupts in response to errors from Clock monitor lower-limit error (MOSC).
          boolean McuEcmErrorOutputMask: set at post-build, origin=Renesas_v1.0.0, default-value=true  # This parameter mask or unmask the individual error sources of the error pin output from Clock monitor lower-limit error (MOSC). | true: mask the individual error sources of the error pin output from Clock monitor lower-limit error (MOSC). false: unmask the individual error sources of the error pin output from Clock monitor lower-limit error (MOSC).
          function name McuMiNotification [0..1]: set at post-build, origin=Renesas_v1.0.0, default-value=NULL_PTR, regular-expression=[a-zA-Z][a-zA-Z0-9_]*  # This parameter contains notification function for MI notification. | The syntax for McuMiNotification should be provided as Mcu_EcmMINotification.
          function name McuNmiNotification [0..1]: set at post-build, origin=Renesas_v1.0.0, default-value=NULL_PTR, regular-expression=[a-zA-Z][a-zA-Z0-9_]*  # This parameter contains notification function for NMI notification. | The syntax for McuNmiNotification should be provided as Mcu_EcmNMINotification.
        container McuEcmErrorSource6  # This container contains all the supported configuration parameters of the related error source from Clock monitor upper-limit error (WDT count clock).
          boolean McuEcmErrorMaskableInterrupt: set at post-build, origin=Renesas_v1.0.0, default-value=false  # This parameter enables or disables generation of a maskable interrupt when the error occurs from Clock monitor upper-limit error (WDT count clock). | true: enables generation of a maskable interrupt when the error occurs from Clock monitor upper-limit error (WDT count clock). false: disables generation of a maskable interrupt when the error occurs from Clock monitor upper-limit error (WDT count clock).
          boolean McuEcmErrorNonMaskableInterrupt: set at post-build, origin=Renesas_v1.0.0, default-value=false  # This parameter enables or disables generation of a non-maskable interrupt when the error occurs from Clock monitor upper-limit error (WDT count clock). | true: enables generation of a non-maskable interrupt when the error occurs from Clock monitor upper-limit error (WDT count clock). false: disables generation of a non-maskable interrupt when the error occurs from Clock monitor upper-limit error (WDT count clock).
          boolean McuEcmErrorInternalReset: set at post-build, origin=Renesas_v1.0.0, default-value=false  # This parameter enables or disables generation of an internal reset when the error occurs from Clock monitor upper-limit error (WDT count clock). | true: enables generation of an internal reset when the error occurs from Clock monitor upper-limit error (WDT count clock). false: disables generation of an internal reset when the error occurs from Clock monitor upper-limit error (WDT count clock).
          boolean McuEcmErrorNMIDelayTimer: set at post-build, origin=Renesas_v1.0.0, default-value=false  # This parameter enables or disables delay timer start caused by non-maskable interrupts in response to errors from Clock monitor upper-limit error (WDT count clock). | true: enables delay timer start caused by non-maskable interrupts in response to errors from Clock monitor upper-limit error (WDT count clock). false: disables delay timer start caused by non-maskable interrupts in response to errors from Clock monitor upper-limit error (WDT count clock).
          boolean McuEcmErrorMIDelayTimer: set at post-build, origin=Renesas_v1.0.0, default-value=false  # This parameter enables or disables delay timer start caused by maskable interrupts in response to errors from Clock monitor upper-limit error (WDT count clock). | true: enables delay timer start caused by maskable interrupts in response to errors from Clock monitor upper-limit error (WDT count clock). false: disables delay timer start caused by maskable interrupts in response to errors from Clock monitor upper-limit error (WDT count clock).
          boolean McuEcmErrorOutputMask: set at post-build, origin=Renesas_v1.0.0, default-value=true  # This parameter mask or unmask the individual error sources of the error pin output from Clock monitor upper-limit error (WDT count clock). | true: mask the individual error sources of the error pin output from Clock monitor upper-limit error (WDT count clock). false: unmask the individual error sources of the error pin output from Clock monitor upper-limit error (WDT count clock).
          function name McuMiNotification [0..1]: set at post-build, origin=Renesas_v1.0.0, default-value=NULL_PTR, regular-expression=[a-zA-Z][a-zA-Z0-9_]*  # This parameter contains notification function for MI notification. | The syntax for McuMiNotification should be provided as Mcu_EcmMINotification.
          function name McuNmiNotification [0..1]: set at post-build, origin=Renesas_v1.0.0, default-value=NULL_PTR, regular-expression=[a-zA-Z][a-zA-Z0-9_]*  # This parameter contains notification function for NMI notification. | The syntax for McuNmiNotification should be provided as Mcu_EcmNMINotification.
        container McuEcmErrorSource7  # This container contains all the supported configuration parameters of the related error source from Clock monitor lower-limit error (WDT count clock).
          boolean McuEcmErrorMaskableInterrupt: set at post-build, origin=Renesas_v1.0.0, default-value=false  # This parameter enables or disables generation of a maskable interrupt when the error occurs from Clock monitor lower-limit error (WDT count clock). | true: enables generation of a maskable interrupt when the error occurs from Clock monitor lower-limit error (WDT count clock). false: disables generation of a maskable interrupt when the error occurs from Clock monitor lower-limit error (WDT count clock).
          boolean McuEcmErrorNonMaskableInterrupt: set at post-build, origin=Renesas_v1.0.0, default-value=false  # This parameter enables or disables generation of a non-maskable interrupt when the error occurs from Clock monitor lower-limit error (WDT count clock). | true: enables generation of a non-maskable interrupt when the error occurs from Clock monitor lower-limit error (WDT count clock). false: disables generation of a non-maskable interrupt when the error occurs from Clock monitor lower-limit error (WDT count clock).
          boolean McuEcmErrorInternalReset: set at post-build, origin=Renesas_v1.0.0, default-value=false  # This parameter enables or disables generation of an internal reset when the error occurs from Clock monitor lower-limit error (WDT count clock). | true: enables generation of an internal reset when the error occurs from Clock monitor lower-limit error (WDT count clock). false: disables generation of an internal reset when the error occurs from Clock monitor lower-limit error (WDT count clock).
          boolean McuEcmErrorNMIDelayTimer: set at post-build, origin=Renesas_v1.0.0, default-value=false  # This parameter enables or disables delay timer start caused by non-maskable interrupts in response to errors from Clock monitor lower-limit error (WDT count clock). | true: enables delay timer start caused by non-maskable interrupts in response to errors from Clock monitor lower-limit error (WDT count clock). false: disables delay timer start caused by non-maskable interrupts in response to errors from Clock monitor lower-limit error (WDT count clock).
          boolean McuEcmErrorMIDelayTimer: set at post-build, origin=Renesas_v1.0.0, default-value=false  # This parameter enables or disables delay timer start caused by maskable interrupts in response to errors from Clock monitor lower-limit error (WDT count clock). | true: enables delay timer start caused by maskable interrupts in response to errors from Clock monitor lower-limit error (WDT count clock). false: disables delay timer start caused by maskable interrupts in response to errors from Clock monitor lower-limit error (WDT count clock).
          boolean McuEcmErrorOutputMask: set at post-build, origin=Renesas_v1.0.0, default-value=true  # This parameter mask or unmask the individual error sources of the error pin output from Clock monitor lower-limit error (WDT count clock). | true: mask the individual error sources of the error pin output from Clock monitor lower-limit error (WDT count clock). false: unmask the individual error sources of the error pin output from Clock monitor lower-limit error (WDT count clock).
          function name McuMiNotification [0..1]: set at post-build, origin=Renesas_v1.0.0, default-value=NULL_PTR, regular-expression=[a-zA-Z][a-zA-Z0-9_]*  # This parameter contains notification function for MI notification. | The syntax for McuMiNotification should be provided as Mcu_EcmMINotification.
          function name McuNmiNotification [0..1]: set at post-build, origin=Renesas_v1.0.0, default-value=NULL_PTR, regular-expression=[a-zA-Z][a-zA-Z0-9_]*  # This parameter contains notification function for NMI notification. | The syntax for McuNmiNotification should be provided as Mcu_EcmNMINotification.
        container McuEcmErrorSource8  # This container contains all the supported configuration parameters of the related error source from Clock monitor upper-limit error (peripheral clock).
          boolean McuEcmErrorMaskableInterrupt: set at post-build, origin=Renesas_v1.0.0, default-value=false  # This parameter enables or disables generation of a maskable interrupt when the error occurs from Clock monitor upper-limit error (peripheral clock). | true: enables generation of a maskable interrupt when the error occurs from Clock monitor upper-limit error (peripheral clock). false: disables generation of a maskable interrupt when the error occurs from Clock monitor upper-limit error (peripheral clock).
          boolean McuEcmErrorNonMaskableInterrupt: set at post-build, origin=Renesas_v1.0.0, default-value=false  # This parameter enables or disables generation of a non-maskable interrupt when the error occurs from Clock monitor upper-limit error (peripheral clock). | true: enables generation of a non-maskable interrupt when the error occurs from Clock monitor upper-limit error (peripheral clock). false: disables generation of a non-maskable interrupt when the error occurs from Clock monitor upper-limit error (peripheral clock).
          boolean McuEcmErrorInternalReset: set at post-build, origin=Renesas_v1.0.0, default-value=false  # This parameter enables or disables generation of an internal reset when the error occurs from Clock monitor upper-limit error (peripheral clock). | true: enables generation of an internal reset when the error occurs from Clock monitor upper-limit error (peripheral clock). false: disables generation of an internal reset when the error occurs from Clock monitor upper-limit error (peripheral clock).
          boolean McuEcmErrorNMIDelayTimer: set at post-build, origin=Renesas_v1.0.0, default-value=false  # This parameter enables or disables delay timer start caused by non-maskable interrupts in response to errors from Clock monitor upper-limit error (peripheral clock). | true: enables delay timer start caused by non-maskable interrupts in response to errors from Clock monitor upper-limit error (peripheral clock). false: disables delay timer start caused by non-maskable interrupts in response to errors from Clock monitor upper-limit error (peripheral clock).
          boolean McuEcmErrorMIDelayTimer: set at post-build, origin=Renesas_v1.0.0, default-value=false  # This parameter enables or disables delay timer start caused by maskable interrupts in response to errors from Clock monitor upper-limit error (peripheral clock). | true: enables delay timer start caused by maskable interrupts in response to errors from Clock monitor upper-limit error (peripheral clock). false: disables delay timer start caused by maskable interrupts in response to errors from Clock monitor upper-limit error (peripheral clock).
          boolean McuEcmErrorOutputMask: set at post-build, origin=Renesas_v1.0.0, default-value=true  # This parameter mask or unmask the individual error sources of the error pin output from Clock monitor upper-limit error (peripheral clock). | true: mask the individual error sources of the error pin output from Clock monitor upper-limit error (peripheral clock). false: unmask the individual error sources of the error pin output from Clock monitor upper-limit error (peripheral clock).
          function name McuMiNotification [0..1]: set at post-build, origin=Renesas_v1.0.0, default-value=NULL_PTR, regular-expression=[a-zA-Z][a-zA-Z0-9_]*  # This parameter contains notification function for MI notification. | The syntax for McuMiNotification should be provided as Mcu_EcmMINotification.
          function name McuNmiNotification [0..1]: set at post-build, origin=Renesas_v1.0.0, default-value=NULL_PTR, regular-expression=[a-zA-Z][a-zA-Z0-9_]*  # This parameter contains notification function for NMI notification. | The syntax for McuNmiNotification should be provided as Mcu_EcmNMINotification.
        container McuEcmErrorSource9  # This container contains all the supported configuration parameters of the related error source from Clock monitor lower-limit error (peripheral clock).
          boolean McuEcmErrorMaskableInterrupt: set at post-build, origin=Renesas_v1.0.0, default-value=false  # This parameter enables or disables generation of a maskable interrupt when the error occurs from Clock monitor lower-limit error (peripheral clock). | true: enables generation of a maskable interrupt when the error occurs from Clock monitor lower-limit error (peripheral clock). false: disables generation of a maskable interrupt when the error occurs from Clock monitor lower-limit error (peripheral clock).
          boolean McuEcmErrorNonMaskableInterrupt: set at post-build, origin=Renesas_v1.0.0, default-value=false  # This parameter enables or disables generation of a non-maskable interrupt when the error occurs from Clock monitor lower-limit error (peripheral clock). | true: enables generation of a non-maskable interrupt when the error occurs from Clock monitor lower-limit error (peripheral clock). false: disables generation of a non-maskable interrupt when the error occurs from Clock monitor lower-limit error (peripheral clock).
          boolean McuEcmErrorInternalReset: set at post-build, origin=Renesas_v1.0.0, default-value=false  # This parameter enables or disables generation of an internal reset when the error occurs from Clock monitor lower-limit error (peripheral clock). | true: enables generation of an internal reset when the error occurs from Clock monitor lower-limit error (peripheral clock). false: disables generation of an internal reset when the error occurs from Clock monitor lower-limit error (peripheral clock).
          boolean McuEcmErrorNMIDelayTimer: set at post-build, origin=Renesas_v1.0.0, default-value=false  # This parameter enables or disables delay timer start caused by non-maskable interrupts in response to errors from Clock monitor lower-limit error (peripheral clock). | true: enables delay timer start caused by non-maskable interrupts in response to errors from Clock monitor lower-limit error (peripheral clock). false: disables delay timer start caused by non-maskable interrupts in response to errors from Clock monitor lower-limit error (peripheral clock).
          boolean McuEcmErrorMIDelayTimer: set at post-build, origin=Renesas_v1.0.0, default-value=false  # This parameter enables or disables delay timer start caused by maskable interrupts in response to errors from Clock monitor lower-limit error (peripheral clock). | true: enables delay timer start caused by maskable interrupts in response to errors from Clock monitor lower-limit error (peripheral clock). false: disables delay timer start caused by maskable interrupts in response to errors from Clock monitor lower-limit error (peripheral clock).
          boolean McuEcmErrorOutputMask: set at post-build, origin=Renesas_v1.0.0, default-value=true  # This parameter mask or unmask the individual error sources of the error pin output from Clock monitor lower-limit error (peripheral clock). | true: mask the individual error sources of the error pin output from Clock monitor lower-limit error (peripheral clock). false: unmask the individual error sources of the error pin output from Clock monitor lower-limit error (peripheral clock).
          function name McuMiNotification [0..1]: set at post-build, origin=Renesas_v1.0.0, default-value=NULL_PTR, regular-expression=[a-zA-Z][a-zA-Z0-9_]*  # This parameter contains notification function for MI notification. | The syntax for McuMiNotification should be provided as Mcu_EcmMINotification.
          function name McuNmiNotification [0..1]: set at post-build, origin=Renesas_v1.0.0, default-value=NULL_PTR, regular-expression=[a-zA-Z][a-zA-Z0-9_]*  # This parameter contains notification function for NMI notification. | The syntax for McuNmiNotification should be provided as Mcu_EcmNMINotification.
        container McuEcmErrorSource10  # This container contains all the supported configuration parameters of the related error source from Clock monitor upper-limit error (PE1 checker core clock).
          boolean McuEcmErrorMaskableInterrupt: set at post-build, origin=Renesas_v1.0.0, default-value=false  # This parameter enables or disables generation of a maskable interrupt when the error occurs from Clock monitor upper-limit error (PE1 checker core clock). | true: enables generation of a maskable interrupt when the error occurs from Clock monitor upper-limit error (PE1 checker core clock). false: disables generation of a maskable interrupt when the error occurs from Clock monitor upper-limit error (PE1 checker core clock).
          boolean McuEcmErrorNonMaskableInterrupt: set at post-build, origin=Renesas_v1.0.0, default-value=false  # This parameter enables or disables generation of a non-maskable interrupt when the error occurs from Clock monitor upper-limit error (PE1 checker core clock). | true: enables generation of a non-maskable interrupt when the error occurs from Clock monitor upper-limit error (PE1 checker core clock). false: disables generation of a non-maskable interrupt when the error occurs from Clock monitor upper-limit error (PE1 checker core clock).
          boolean McuEcmErrorInternalReset: set at post-build, origin=Renesas_v1.0.0, default-value=false  # This parameter enables or disables generation of an internal reset when the error occurs from Clock monitor upper-limit error (PE1 checker core clock). | true: enables generation of an internal reset when the error occurs from Clock monitor upper-limit error (PE1 checker core clock). false: disables generation of an internal reset when the error occurs from Clock monitor upper-limit error (PE1 checker core clock).
          boolean McuEcmErrorNMIDelayTimer: set at post-build, origin=Renesas_v1.0.0, default-value=false  # This parameter enables or disables delay timer start caused by non-maskable interrupts in response to errors from Clock monitor upper-limit error (PE1 checker core clock). | true: enables delay timer start caused by non-maskable interrupts in response to errors from Clock monitor upper-limit error (PE1 checker core clock). false: disables delay timer start caused by non-maskable interrupts in response to errors from Clock monitor upper-limit error (PE1 checker core clock).
          boolean McuEcmErrorMIDelayTimer: set at post-build, origin=Renesas_v1.0.0, default-value=false  # This parameter enables or disables delay timer start caused by maskable interrupts in response to errors from Clock monitor upper-limit error (PE1 checker core clock). | true: enables delay timer start caused by maskable interrupts in response to errors from Clock monitor upper-limit error (PE1 checker core clock). false: disables delay timer start caused by maskable interrupts in response to errors from Clock monitor upper-limit error (PE1 checker core clock).
          boolean McuEcmErrorOutputMask: set at post-build, origin=Renesas_v1.0.0, default-value=true  # This parameter mask or unmask the individual error sources of the error pin output from Clock monitor upper-limit error (PE1 checker core clock). | true: mask the individual error sources of the error pin output from Clock monitor upper-limit error (PE1 checker core clock). false: unmask the individual error sources of the error pin output from Clock monitor upper-limit error (PE1 checker core clock).
          function name McuMiNotification [0..1]: set at post-build, origin=Renesas_v1.0.0, default-value=NULL_PTR, regular-expression=[a-zA-Z][a-zA-Z0-9_]*  # This parameter contains notification function for MI notification. | The syntax for McuMiNotification should be provided as Mcu_EcmMINotification.
          function name McuNmiNotification [0..1]: set at post-build, origin=Renesas_v1.0.0, default-value=NULL_PTR, regular-expression=[a-zA-Z][a-zA-Z0-9_]*  # This parameter contains notification function for NMI notification. | The syntax for McuNmiNotification should be provided as Mcu_EcmNMINotification.
        container McuEcmErrorSource11  # This container contains all the supported configuration parameters of the related error source from Clock monitor lower-limit error (PE1 checker core clock).
          boolean McuEcmErrorMaskableInterrupt: set at post-build, origin=Renesas_v1.0.0, default-value=false  # This parameter enables or disables generation of a maskable interrupt when the error occurs from Clock monitor lower-limit error (PE1 checker core clock). | true: enables generation of a maskable interrupt when the error occurs from Clock monitor lower-limit error (PE1 checker core clock). false: disables generation of a maskable interrupt when the error occurs from Clock monitor lower-limit error (PE1 checker core clock).
          boolean McuEcmErrorNonMaskableInterrupt: set at post-build, origin=Renesas_v1.0.0, default-value=false  # This parameter enables or disables generation of a non-maskable interrupt when the error occurs from Clock monitor lower-limit error (PE1 checker core clock). | true: enables generation of a non-maskable interrupt when the error occurs from Clock monitor lower-limit error (PE1 checker core clock). false: disables generation of a non-maskable interrupt when the error occurs from Clock monitor lower-limit error (PE1 checker core clock).
          boolean McuEcmErrorInternalReset: set at post-build, origin=Renesas_v1.0.0, default-value=false  # This parameter enables or disables generation of an internal reset when the error occurs from Clock monitor lower-limit error (PE1 checker core clock). | true: enables generation of an internal reset when the error occurs from Clock monitor lower-limit error (PE1 checker core clock). false: disables generation of an internal reset when the error occurs from Clock monitor lower-limit error (PE1 checker core clock).
          boolean McuEcmErrorNMIDelayTimer: set at post-build, origin=Renesas_v1.0.0, default-value=false  # This parameter enables or disables delay timer start caused by non-maskable interrupts in response to errors from Clock monitor lower-limit error (PE1 checker core clock). | true: enables delay timer start caused by non-maskable interrupts in response to errors from Clock monitor lower-limit error (PE1 checker core clock). false: disables delay timer start caused by non-maskable interrupts in response to errors from Clock monitor lower-limit error (PE1 checker core clock).
          boolean McuEcmErrorMIDelayTimer: set at post-build, origin=Renesas_v1.0.0, default-value=false  # This parameter enables or disables delay timer start caused by maskable interrupts in response to errors from Clock monitor lower-limit error (PE1 checker core clock). | true: enables delay timer start caused by maskable interrupts in response to errors from Clock monitor lower-limit error (PE1 checker core clock). false: disables delay timer start caused by maskable interrupts in response to errors from Clock monitor lower-limit error (PE1 checker core clock).
          boolean McuEcmErrorOutputMask: set at post-build, origin=Renesas_v1.0.0, default-value=true  # This parameter mask or unmask the individual error sources of the error pin output from Clock monitor lower-limit error (PE1 checker core clock). | true: mask the individual error sources of the error pin output from Clock monitor lower-limit error (PE1 checker core clock). false: unmask the individual error sources of the error pin output from Clock monitor lower-limit error (PE1 checker core clock).
          function name McuMiNotification [0..1]: set at post-build, origin=Renesas_v1.0.0, default-value=NULL_PTR, regular-expression=[a-zA-Z][a-zA-Z0-9_]*  # This parameter contains notification function for MI notification. | The syntax for McuMiNotification should be provided as Mcu_EcmMINotification.
          function name McuNmiNotification [0..1]: set at post-build, origin=Renesas_v1.0.0, default-value=NULL_PTR, regular-expression=[a-zA-Z][a-zA-Z0-9_]*  # This parameter contains notification function for NMI notification. | The syntax for McuNmiNotification should be provided as Mcu_EcmNMINotification.
        container McuEcmErrorSource12  # This container contains all the supported configuration parameters of the related error source from Local RAM ECC 2-bit error and address parity error.
          boolean McuEcmErrorMaskableInterrupt: set at post-build, origin=Renesas_v1.0.0, default-value=false  # This parameter enables or disables generation of a maskable interrupt when the error occurs from Local RAM ECC 2-bit error and address parity error. | true: enables generation of a maskable interrupt when the error occurs from Local RAM ECC 2-bit error and address parity error. false: disables generation of a maskable interrupt when the error occurs from Local RAM ECC 2-bit error and address parity error.
          boolean McuEcmErrorNonMaskableInterrupt: set at post-build, origin=Renesas_v1.0.0, default-value=false  # This parameter enables or disables generation of a non-maskable interrupt when the error occurs from Local RAM ECC 2-bit error and address parity error. | true: enables generation of a non-maskable interrupt when the error occurs from Local RAM ECC 2-bit error and address parity error. false: disables generation of a non-maskable interrupt when the error occurs from Local RAM ECC 2-bit error and address parity error.
          boolean McuEcmErrorInternalReset: set at post-build, origin=Renesas_v1.0.0, default-value=false  # This parameter enables or disables generation of an internal reset when the error occurs from Local RAM ECC 2-bit error and address parity error. | true: enables generation of an internal reset when the error occurs from Local RAM ECC 2-bit error and address parity error. false: disables generation of an internal reset when the error occurs from Local RAM ECC 2-bit error and address parity error.
          boolean McuEcmErrorNMIDelayTimer: set at post-build, origin=Renesas_v1.0.0, default-value=false  # This parameter enables or disables delay timer start caused by non-maskable interrupts in response to errors from Local RAM ECC 2-bit error and address parity error. | true: enables delay timer start caused by non-maskable interrupts in response to errors from Local RAM ECC 2-bit error and address parity error. false: disables delay timer start caused by non-maskable interrupts in response to errors from Local RAM ECC 2-bit error and address parity error.
          boolean McuEcmErrorMIDelayTimer: set at post-build, origin=Renesas_v1.0.0, default-value=false  # This parameter enables or disables delay timer start caused by maskable interrupts in response to errors from Local RAM ECC 2-bit error and address parity error. | true: enables delay timer start caused by maskable interrupts in response to errors from Local RAM ECC 2-bit error and address parity error. false: disables delay timer start caused by maskable interrupts in response to errors from Local RAM ECC 2-bit error and address parity error.
          boolean McuEcmErrorOutputMask: set at post-build, origin=Renesas_v1.0.0, default-value=true  # This parameter mask or unmask the individual error sources of the error pin output from Local RAM ECC 2-bit error and address parity error. | true: mask the individual error sources of the error pin output from Local RAM ECC 2-bit error and address parity error. false: unmask the individual error sources of the error pin output from Local RAM ECC 2-bit error and address parity error.
          function name McuMiNotification [0..1]: set at post-build, origin=Renesas_v1.0.0, default-value=NULL_PTR, regular-expression=[a-zA-Z][a-zA-Z0-9_]*  # This parameter contains notification function for MI notification. | The syntax for McuMiNotification should be provided as Mcu_EcmMINotification.
          function name McuNmiNotification [0..1]: set at post-build, origin=Renesas_v1.0.0, default-value=NULL_PTR, regular-expression=[a-zA-Z][a-zA-Z0-9_]*  # This parameter contains notification function for NMI notification. | The syntax for McuNmiNotification should be provided as Mcu_EcmNMINotification.
        container McuEcmErrorSource14  # This container contains all the supported configuration parameters of the related error source from Instruction cache RAM ECC 2-bit error and SED error.
          boolean McuEcmErrorMaskableInterrupt: set at post-build, origin=Renesas_v1.0.0, default-value=false  # This parameter enables or disables generation of a maskable interrupt when the error occurs from Cache module. | true: enables generation of a maskable interrupt when the error occurs from Instruction cache RAM ECC 2-bit error and SED error. false: disables generation of a maskable interrupt when the error occurs from Instruction cache RAM ECC 2-bit error and SED error.
          boolean McuEcmErrorNonMaskableInterrupt: set at post-build, origin=Renesas_v1.0.0, default-value=false  # This parameter enables or disables generation of a non-maskable interrupt when the error occurs from Instruction cache RAM ECC 2-bit error and SED error. | true: enables generation of a non-maskable interrupt when the error occurs from Instruction cache RAM ECC 2-bit error and SED error. false: disables generation of a non-maskable interrupt when the error occurs from Instruction cache RAM ECC 2-bit error and SED error.
          boolean McuEcmErrorInternalReset: set at post-build, origin=Renesas_v1.0.0, default-value=false  # This parameter enables or disables generation of an internal reset when the error occurs from Instruction cache RAM ECC 2-bit error and SED error. | true: enables generation of an internal reset when the error occurs from Instruction cache RAM ECC 2-bit error and SED error. false: disables generation of an internal reset when the error occurs from Instruction cache RAM ECC 2-bit error and SED error.
          boolean McuEcmErrorNMIDelayTimer: set at post-build, origin=Renesas_v1.0.0, default-value=false  # This parameter enables or disables delay timer start caused by non-maskable interrupts in response to errors from Instruction cache RAM ECC 2-bit error and SED error. | true: enables delay timer start caused by non-maskable interrupts in response to errors from Instruction cache RAM ECC 2-bit error and SED error. false: disables delay timer start caused by non-maskable interrupts in response to errors from Instruction cache RAM ECC 2-bit error and SED error.
          boolean McuEcmErrorMIDelayTimer: set at post-build, origin=Renesas_v1.0.0, default-value=false  # This parameter enables or disables delay timer start caused by maskable interrupts in response to errors from Instruction cache RAM ECC 2-bit error and SED error. | true: enables delay timer start caused by maskable interrupts in response to errors from Instruction cache RAM ECC 2-bit error and SED error. false: disables delay timer start caused by maskable interrupts in response to errors from Instruction cache RAM ECC 2-bit error and SED error.
          boolean McuEcmErrorOutputMask: set at post-build, origin=Renesas_v1.0.0, default-value=true  # This parameter mask or unmask the individual error sources of the error pin output from Instruction cache RAM ECC 2-bit error and SED error. | true: mask the individual error sources of the error pin output from Instruction cache RAM ECC 2-bit error and SED error. false: unmask the individual error sources of the error pin output from Instruction cache RAM ECC 2-bit error and SED error.
          function name McuMiNotification [0..1]: set at post-build, origin=Renesas_v1.0.0, default-value=NULL_PTR, regular-expression=[a-zA-Z][a-zA-Z0-9_]*  # This parameter contains notification function for MI notification. | The syntax for McuMiNotification should be provided as Mcu_EcmMINotification.
          function name McuNmiNotification [0..1]: set at post-build, origin=Renesas_v1.0.0, default-value=NULL_PTR, regular-expression=[a-zA-Z][a-zA-Z0-9_]*  # This parameter contains notification function for NMI notification. | The syntax for McuNmiNotification should be provided as Mcu_EcmNMINotification.
        container McuEcmErrorSource15  # This container contains all the supported configuration parameters of the related error source from Code flash ECC 2-bit error and address parity error.
          boolean McuEcmErrorMaskableInterrupt: set at post-build, origin=Renesas_v1.0.0, default-value=false  # This parameter enables or disables generation of a maskable interrupt when the error occurs from Code flash ECC 2-bit error and address parity error. | true: enables generation of a maskable interrupt when the error occurs from Code flash ECC 2-bit error and address parity error. false: disables generation of a maskable interrupt when the error occurs from Code flash ECC 2-bit error and address parity error.
          boolean McuEcmErrorNonMaskableInterrupt: set at post-build, origin=Renesas_v1.0.0, default-value=false  # This parameter enables or disables generation of a non-maskable interrupt when the error occurs from Code flash ECC 2-bit error and address parity error. | true: enables generation of a non-maskable interrupt when the error occurs from Code flash ECC 2-bit error and address parity error. false: disables generation of a non-maskable interrupt when the error occurs from Code flash ECC 2-bit error and address parity error.
          boolean McuEcmErrorInternalReset: set at post-build, origin=Renesas_v1.0.0, default-value=false  # This parameter enables or disables generation of an internal reset when the error occurs from Code flash ECC 2-bit error and address parity error. | true: enables generation of an internal reset when the error occurs from Code flash ECC 2-bit error and address parity error. false: disables generation of an internal reset when the error occurs from Code flash ECC 2-bit error and address parity error.
          boolean McuEcmErrorNMIDelayTimer: set at post-build, origin=Renesas_v1.0.0, default-value=false  # This parameter enables or disables delay timer start caused by non-maskable interrupts in response to errors from Code flash ECC 2-bit error and address parity error. | true: enables delay timer start caused by non-maskable interrupts in response to errors from Code flash ECC 2-bit error and address parity error. false: disables delay timer start caused by non-maskable interrupts in response to errors from Code flash ECC 2-bit error and address parity error.
          boolean McuEcmErrorMIDelayTimer: set at post-build, origin=Renesas_v1.0.0, default-value=false  # This parameter enables or disables delay timer start caused by maskable interrupts in response to errors from Code flash ECC 2-bit error and address parity error. | true: enables delay timer start caused by maskable interrupts in response to errors from Code flash ECC 2-bit error and address parity error. false: disables delay timer start caused by maskable interrupts in response to errors from Code flash ECC 2-bit error and address parity error.
          boolean McuEcmErrorOutputMask: set at post-build, origin=Renesas_v1.0.0, default-value=true  # This parameter mask or unmask the individual error sources of the error pin output from Code flash ECC 2-bit error and address parity error. | true: mask the individual error sources of the error pin output from Code flash ECC 2-bit error and address parity error. false: unmask the individual error sources of the error pin output from Code flash ECC 2-bit error and address parity error.
          function name McuMiNotification [0..1]: set at post-build, origin=Renesas_v1.0.0, default-value=NULL_PTR, regular-expression=[a-zA-Z][a-zA-Z0-9_]*  # This parameter contains notification function for MI notification. | The syntax for McuMiNotification should be provided as Mcu_EcmMINotification.
          function name McuNmiNotification [0..1]: set at post-build, origin=Renesas_v1.0.0, default-value=NULL_PTR, regular-expression=[a-zA-Z][a-zA-Z0-9_]*  # This parameter contains notification function for NMI notification. | The syntax for McuNmiNotification should be provided as Mcu_EcmNMINotification.
        container McuEcmErrorSource16  # This container contains all the supported configuration parameters of the related error source from Data flash ECC 2-bit error.
          boolean McuEcmErrorMaskableInterrupt: set at post-build, origin=Renesas_v1.0.0, default-value=false  # This parameter enables or disables generation of a maskable interrupt when the error occurs from Data flash ECC 2-bit error. | true: enables generation of a maskable interrupt when the error occurs from Data flash ECC 2-bit error. false: disables generation of a maskable interrupt when the error occurs from Data flash ECC 2-bit error.
          boolean McuEcmErrorNonMaskableInterrupt: set at post-build, origin=Renesas_v1.0.0, default-value=false  # This parameter enables or disables generation of a non-maskable interrupt when the error occurs from Data flash ECC 2-bit error. | true: enables generation of a non-maskable interrupt when the error occurs from Data flash ECC 2-bit error. false: disables generation of a non-maskable interrupt when the error occurs from Data flash ECC 2-bit error.
          boolean McuEcmErrorInternalReset: set at post-build, origin=Renesas_v1.0.0, default-value=false  # This parameter enables or disables generation of an internal reset when the error occurs from Data flash ECC 2-bit error. | true: enables generation of an internal reset when the error occurs from Data flash ECC 2-bit error. false: disables generation of an internal reset when the error occurs from Data flash ECC 2-bit error.
          boolean McuEcmErrorNMIDelayTimer: set at post-build, origin=Renesas_v1.0.0, default-value=false  # This parameter enables or disables delay timer start caused by non-maskable interrupts in response to errors from Data flash ECC 2-bit error. | true: enables delay timer start caused by non-maskable interrupts in response to errors from Data flash ECC 2-bit error. false: disables delay timer start caused by non-maskable interrupts in response to errors from Data flash ECC 2-bit error.
          boolean McuEcmErrorMIDelayTimer: set at post-build, origin=Renesas_v1.0.0, default-value=false  # This parameter enables or disables delay timer start caused by maskable interrupts in response to errors from Data flash ECC 2-bit error. | true: enables delay timer start caused by maskable interrupts in response to errors from Data flash ECC 2-bit error. false: disables delay timer start caused by maskable interrupts in response to errors from Data flash ECC 2-bit error.
          boolean McuEcmErrorOutputMask: set at post-build, origin=Renesas_v1.0.0, default-value=true  # This parameter mask or unmask the individual error sources of the error pin output from Data flash ECC 2-bit error. | true: mask the individual error sources of the error pin output from Data flash ECC 2-bit error. false: unmask the individual error sources of the error pin output from Data flash ECC 2-bit error.
          function name McuMiNotification [0..1]: set at post-build, origin=Renesas_v1.0.0, default-value=NULL_PTR, regular-expression=[a-zA-Z][a-zA-Z0-9_]*  # This parameter contains notification function for MI notification. | The syntax for McuMiNotification should be provided as Mcu_EcmMINotification.
          function name McuNmiNotification [0..1]: set at post-build, origin=Renesas_v1.0.0, default-value=NULL_PTR, regular-expression=[a-zA-Z][a-zA-Z0-9_]*  # This parameter contains notification function for NMI notification. | The syntax for McuNmiNotification should be provided as Mcu_EcmNMINotification.
        container McuEcmErrorSource17  # This container contains all the supported configuration parameters of the related error source from DTS RAM ECC 2-bit error.
          boolean McuEcmErrorMaskableInterrupt: set at post-build, origin=Renesas_v1.0.0, default-value=false  # This parameter enables or disables generation of a maskable interrupt when the error occurs from DTS RAM ECC 2-bit error. | true: enables generation of a maskable interrupt when the error occurs from DTS RAM ECC 2-bit error. false: disables generation of a maskable interrupt when the error occurs from DTS RAM ECC 2-bit error.
          boolean McuEcmErrorNonMaskableInterrupt: set at post-build, origin=Renesas_v1.0.0, default-value=false  # This parameter enables or disables generation of a non-maskable interrupt when the error occurs from DTS RAM ECC 2-bit error. | true: enables generation of a non-maskable interrupt when the error occurs from DTS RAM ECC 2-bit error. false: disables generation of a non-maskable interrupt when the error occurs from DTS RAM ECC 2-bit error.
          boolean McuEcmErrorInternalReset: set at post-build, origin=Renesas_v1.0.0, default-value=false  # This parameter enables or disables generation of an internal reset when the error occurs from DTS RAM ECC 2-bit error. | true: enables generation of an internal reset when the error occurs from DTS RAM ECC 2-bit error. false: disables generation of an internal reset when the error occurs from DTS RAM ECC 2-bit error.
          boolean McuEcmErrorNMIDelayTimer: set at post-build, origin=Renesas_v1.0.0, default-value=false  # This parameter enables or disables delay timer start caused by non-maskable interrupts in response to errors from DTS RAM ECC 2-bit error. | true: enables delay timer start caused by non-maskable interrupts in response to errors from DTS RAM ECC 2-bit error. false: disables delay timer start caused by non-maskable interrupts in response to errors from DTS RAM ECC 2-bit error.
          boolean McuEcmErrorMIDelayTimer: set at post-build, origin=Renesas_v1.0.0, default-value=false  # This parameter enables or disables delay timer start caused by maskable interrupts in response to errors from DTS RAM ECC 2-bit error. | true: enables delay timer start caused by maskable interrupts in response to errors from DTS RAM ECC 2-bit error. false: disables delay timer start caused by maskable interrupts in response to errors from DTS RAM ECC 2-bit error.
          boolean McuEcmErrorOutputMask: set at post-build, origin=Renesas_v1.0.0, default-value=true  # This parameter mask or unmask the individual error sources of the error pin output from DTS RAM ECC 2-bit error. | true: mask the individual error sources of the error pin output from DTS RAM ECC 2-bit error. false: unmask the individual error sources of the error pin output from DTS RAM ECC 2-bit error.
          function name McuMiNotification [0..1]: set at post-build, origin=Renesas_v1.0.0, default-value=NULL_PTR, regular-expression=[a-zA-Z][a-zA-Z0-9_]*  # This parameter contains notification function for MI notification. | The syntax for McuMiNotification should be provided as Mcu_EcmMINotification.
          function name McuNmiNotification [0..1]: set at post-build, origin=Renesas_v1.0.0, default-value=NULL_PTR, regular-expression=[a-zA-Z][a-zA-Z0-9_]*  # This parameter contains notification function for NMI notification. | The syntax for McuNmiNotification should be provided as Mcu_EcmNMINotification.
        container McuEcmErrorSource18  # This container contains all the supported configuration parameters of the related error source from CSIH RAM ECC 2-bit error.
          boolean McuEcmErrorMaskableInterrupt: set at post-build, origin=Renesas_v1.0.0, default-value=false  # This parameter enables or disables generation of a maskable interrupt when the error occurs from CSIH RAM ECC 2-bit error. | true: enables generation of a maskable interrupt when the error occurs from CSIH RAM ECC 2-bit error. false: disables generation of a maskable interrupt when the error occurs from CSIH RAM ECC 2-bit error.
          boolean McuEcmErrorNonMaskableInterrupt: set at post-build, origin=Renesas_v1.0.0, default-value=false  # This parameter enables or disables generation of a non-maskable interrupt when the error occurs from CSIH RAM ECC 2-bit error. | true: enables generation of a non-maskable interrupt when the error occurs from CSIH RAM ECC 2-bit error. false: disables generation of a non-maskable interrupt when the error occurs from CSIH RAM ECC 2-bit error.
          boolean McuEcmErrorInternalReset: set at post-build, origin=Renesas_v1.0.0, default-value=false  # This parameter enables or disables generation of an internal reset when the error occurs from CSIH RAM ECC 2-bit error. | true: enables generation of an internal reset when the error occurs from CSIH RAM ECC 2-bit error. false: disables generation of an internal reset when the error occurs from CSIH RAM ECC 2-bit error.
          boolean McuEcmErrorNMIDelayTimer: set at post-build, origin=Renesas_v1.0.0, default-value=false  # This parameter enables or disables delay timer start caused by non-maskable interrupts in response to errors from CSIH RAM ECC 2-bit error. | true: enables delay timer start caused by non-maskable interrupts in response to errors from CSIH RAM ECC 2-bit error. false: disables delay timer start caused by non-maskable interrupts in response to errors from CSIH RAM ECC 2-bit error.
          boolean McuEcmErrorMIDelayTimer: set at post-build, origin=Renesas_v1.0.0, default-value=false  # This parameter enables or disables delay timer start caused by maskable interrupts in response to errors from CSIH RAM ECC 2-bit error. | true: enables delay timer start caused by maskable interrupts in response to errors from CSIH RAM ECC 2-bit error. false: disables delay timer start caused by maskable interrupts in response to errors from CSIH RAM ECC 2-bit error.
          boolean McuEcmErrorOutputMask: set at post-build, origin=Renesas_v1.0.0, default-value=true  # This parameter mask or unmask the individual error sources of the error pin output from CSIH RAM ECC 2-bit error. | true: mask the individual error sources of the error pin output from CSIH RAM ECC 2-bit error. false: unmask the individual error sources of the error pin output from CSIH RAM ECC 2-bit error.
          function name McuMiNotification [0..1]: set at post-build, origin=Renesas_v1.0.0, default-value=NULL_PTR, regular-expression=[a-zA-Z][a-zA-Z0-9_]*  # This parameter contains notification function for MI notification. | The syntax for McuMiNotification should be provided as Mcu_EcmMINotification.
          function name McuNmiNotification [0..1]: set at post-build, origin=Renesas_v1.0.0, default-value=NULL_PTR, regular-expression=[a-zA-Z][a-zA-Z0-9_]*  # This parameter contains notification function for NMI notification. | The syntax for McuNmiNotification should be provided as Mcu_EcmNMINotification.
        container McuEcmErrorSource19  # This container contains all the supported configuration parameters of the related error source from CAN RAM ECC 2-bit error.
          boolean McuEcmErrorMaskableInterrupt: set at post-build, origin=Renesas_v1.0.0, default-value=false  # This parameter enables or disables generation of a maskable interrupt when the error occurs from CAN RAM ECC 2-bit error. | true: enables generation of a maskable interrupt when the error occurs from CAN RAM ECC 2-bit error. false: disables generation of a maskable interrupt when the error occurs from CAN RAM ECC 2-bit error.
          boolean McuEcmErrorNonMaskableInterrupt: set at post-build, origin=Renesas_v1.0.0, default-value=false  # This parameter enables or disables generation of a non-maskable interrupt when the error occurs from CAN RAM ECC 2-bit error. | true: enables generation of a non-maskable interrupt when the error occurs from CAN RAM ECC 2-bit error. false: disables generation of a non-maskable interrupt when the error occurs from CAN RAM ECC 2-bit error.
          boolean McuEcmErrorInternalReset: set at post-build, origin=Renesas_v1.0.0, default-value=false  # This parameter enables or disables generation of an internal reset when the error occurs from CAN RAM ECC 2-bit error. | true: enables generation of an internal reset when the error occurs from CAN RAM ECC 2-bit error. false: disables generation of an internal reset when the error occurs from CAN RAM ECC 2-bit error.
          boolean McuEcmErrorNMIDelayTimer: set at post-build, origin=Renesas_v1.0.0, default-value=false  # This parameter enables or disables delay timer start caused by non-maskable interrupts in response to errors from CAN RAM ECC 2-bit error. | true: enables delay timer start caused by non-maskable interrupts in response to errors from CAN RAM ECC 2-bit error. false: disables delay timer start caused by non-maskable interrupts in response to errors from CAN RAM ECC 2-bit error.
          boolean McuEcmErrorMIDelayTimer: set at post-build, origin=Renesas_v1.0.0, default-value=false  # This parameter enables or disables delay timer start caused by maskable interrupts in response to errors from CAN RAM ECC 2-bit error. | true: enables delay timer start caused by maskable interrupts in response to errors from CAN RAM ECC 2-bit error. false: disables delay timer start caused by maskable interrupts in response to errors from CAN RAM ECC 2-bit error.
          boolean McuEcmErrorOutputMask: set at post-build, origin=Renesas_v1.0.0, default-value=true  # This parameter mask or unmask the individual error sources of the error pin output from CAN RAM ECC 2-bit error. | true: mask the individual error sources of the error pin output from CAN RAM ECC 2-bit error. false: unmask the individual error sources of the error pin output from CAN RAM ECC 2-bit error.
          function name McuMiNotification [0..1]: set at post-build, origin=Renesas_v1.0.0, default-value=NULL_PTR, regular-expression=[a-zA-Z][a-zA-Z0-9_]*  # This parameter contains notification function for MI notification. | The syntax for McuMiNotification should be provided as Mcu_EcmMINotification.
          function name McuNmiNotification [0..1]: set at post-build, origin=Renesas_v1.0.0, default-value=NULL_PTR, regular-expression=[a-zA-Z][a-zA-Z0-9_]*  # This parameter contains notification function for NMI notification. | The syntax for McuNmiNotification should be provided as Mcu_EcmNMINotification.
        container McuEcmErrorSource20  # This container contains all the supported configuration parameters of the related error source from FlexRay RAM ECC 2-bit error.
          boolean McuEcmErrorMaskableInterrupt: set at post-build, origin=Renesas_v1.0.0, default-value=false  # This parameter enables or disables generation of a maskable interrupt when the error occurs from FlexRay RAM ECC 2-bit error. | true: enables generation of a maskable interrupt when the error occurs from FlexRay RAM ECC 2-bit error. false: disables generation of a maskable interrupt when the error occurs from FlexRay RAM ECC 2-bit error.
          boolean McuEcmErrorNonMaskableInterrupt: set at post-build, origin=Renesas_v1.0.0, default-value=false  # This parameter enables or disables generation of a non-maskable interrupt when the error occurs from FlexRay RAM ECC 2-bit error. | true: enables generation of a non-maskable interrupt when the error occurs from FlexRay RAM ECC 2-bit error. false: disables generation of a non-maskable interrupt when the error occurs from FlexRay RAM ECC 2-bit error.
          boolean McuEcmErrorInternalReset: set at post-build, origin=Renesas_v1.0.0, default-value=false  # This parameter enables or disables generation of an internal reset when the error occurs from FlexRay RAM ECC 2-bit error. | true: enables generation of an internal reset when the error occurs from FlexRay RAM ECC 2-bit error. false: disables generation of an internal reset when the error occurs from FlexRay RAM ECC 2-bit error.
          boolean McuEcmErrorNMIDelayTimer: set at post-build, origin=Renesas_v1.0.0, default-value=false  # This parameter enables or disables delay timer start caused by non-maskable interrupts in response to errors from FlexRay RAM ECC 2-bit error. | true: enables delay timer start caused by non-maskable interrupts in response to errors from FlexRay RAM ECC 2-bit error. false: disables delay timer start caused by non-maskable interrupts in response to errors from FlexRay RAM ECC 2-bit error.
          boolean McuEcmErrorMIDelayTimer: set at post-build, origin=Renesas_v1.0.0, default-value=false  # This parameter enables or disables delay timer start caused by maskable interrupts in response to errors from FlexRay RAM ECC 2-bit error. | true: enables delay timer start caused by maskable interrupts in response to errors from FlexRay RAM ECC 2-bit error. false: disables delay timer start caused by maskable interrupts in response to errors from FlexRay RAM ECC 2-bit error.
          boolean McuEcmErrorOutputMask: set at post-build, origin=Renesas_v1.0.0, default-value=true  # This parameter mask or unmask the individual error sources of the error pin output from FlexRay RAM ECC 2-bit error. | true: mask the individual error sources of the error pin output from FlexRay RAM ECC 2-bit error. false: unmask the individual error sources of the error pin output from FlexRay RAM ECC 2-bit error.
          function name McuMiNotification [0..1]: set at post-build, origin=Renesas_v1.0.0, default-value=NULL_PTR, regular-expression=[a-zA-Z][a-zA-Z0-9_]*  # This parameter contains notification function for MI notification. | The syntax for McuMiNotification should be provided as Mcu_EcmMINotification.
          function name McuNmiNotification [0..1]: set at post-build, origin=Renesas_v1.0.0, default-value=NULL_PTR, regular-expression=[a-zA-Z][a-zA-Z0-9_]*  # This parameter contains notification function for NMI notification. | The syntax for McuNmiNotification should be provided as Mcu_EcmNMINotification.
        container McuEcmErrorSource21  # This container contains all the supported configuration parameters of the related error source from Mode error (flash programming mode is started in single-chip mode).
          boolean McuEcmErrorMaskableInterrupt: set at post-build, origin=Renesas_v1.0.0, default-value=false  # This parameter enables or disables generation of a maskable interrupt when the error occurs from Mode error (flash programming mode is started in single-chip mode). | true: enables generation of a maskable interrupt when the error occurs from Mode error (flash programming mode is started in single-chip mode). false: disables generation of a maskable interrupt when the error occurs from Mode error (flash programming mode is started in single-chip mode).
          boolean McuEcmErrorNonMaskableInterrupt: set at post-build, origin=Renesas_v1.0.0, default-value=false  # This parameter enables or disables generation of a non-maskable interrupt when the error occurs from Mode error (flash programming mode is started in single-chip mode). | true: enables generation of a non-maskable interrupt when the error occurs from Mode error (flash programming mode is started in single-chip mode). false: disables generation of a non-maskable interrupt when the error occurs from Mode error (flash programming mode is started in single-chip mode).
          boolean McuEcmErrorInternalReset: set at post-build, origin=Renesas_v1.0.0, default-value=false  # This parameter enables or disables generation of an internal reset when the error occurs from Mode error (flash programming mode is started in single-chip mode). | true: enables generation of an internal reset when the error occurs from Mode error (flash programming mode is started in single-chip mode). false: disables generation of an internal reset when the error occurs from Mode error (flash programming mode is started in single-chip mode).
          boolean McuEcmErrorNMIDelayTimer: set at post-build, origin=Renesas_v1.0.0, default-value=false  # This parameter enables or disables delay timer start caused by non-maskable interrupts in response to errors from Mode error (flash programming mode is started in single-chip mode). | true: enables delay timer start caused by non-maskable interrupts in response to errors from Mode error (flash programming mode is started in single-chip mode). false: disables delay timer start caused by non-maskable interrupts in response to errors from Mode error (flash programming mode is started in single-chip mode).
          boolean McuEcmErrorMIDelayTimer: set at post-build, origin=Renesas_v1.0.0, default-value=false  # This parameter enables or disables delay timer start caused by maskable interrupts in response to errors from Mode error (flash programming mode is started in single-chip mode). | true: enables delay timer start caused by maskable interrupts in response to errors from Mode error (flash programming mode is started in single-chip mode). false: disables delay timer start caused by maskable interrupts in response to errors from Mode error (flash programming mode is started in single-chip mode).
          boolean McuEcmErrorOutputMask: set at post-build, origin=Renesas_v1.0.0, default-value=true  # This parameter mask or unmask the individual error sources of the error pin output from Mode error (flash programming mode is started in single-chip mode). | true: mask the individual error sources of the error pin output from Mode error (flash programming mode is started in single-chip mode). false: unmask the individual error sources of the error pin output from Mode error (flash programming mode is started in single-chip mode).
          function name McuMiNotification [0..1]: set at post-build, origin=Renesas_v1.0.0, default-value=NULL_PTR, regular-expression=[a-zA-Z][a-zA-Z0-9_]*  # This parameter contains notification function for MI notification. | The syntax for McuMiNotification should be provided as Mcu_EcmMINotification.
          function name McuNmiNotification [0..1]: set at post-build, origin=Renesas_v1.0.0, default-value=NULL_PTR, regular-expression=[a-zA-Z][a-zA-Z0-9_]*  # This parameter contains notification function for NMI notification. | The syntax for McuNmiNotification should be provided as Mcu_EcmNMINotification.
        container McuEcmErrorSource22  # This container contains all the supported configuration parameters of the related error source from Mode error (test mode is started in single-chip mode).
          boolean McuEcmErrorMaskableInterrupt: set at post-build, origin=Renesas_v1.0.0, default-value=false  # This parameter enables or disables generation of a maskable interrupt when the error occurs from Mode error (test mode is started in single-chip mode). | true: enables generation of a maskable interrupt when the error occurs from Mode error (test mode is started in single-chip mode). false: disables generation of a maskable interrupt when the error occurs from Mode error (test mode is started in single-chip mode).
          boolean McuEcmErrorNonMaskableInterrupt: set at post-build, origin=Renesas_v1.0.0, default-value=false  # This parameter enables or disables generation of a non-maskable interrupt when the error occurs from Mode error (test mode is started in single-chip mode). | true: enables generation of a non-maskable interrupt when the error occurs from Mode error (test mode is started in single-chip mode). false: disables generation of a non-maskable interrupt when the error occurs from Mode error (test mode is started in single-chip mode).
          boolean McuEcmErrorInternalReset: set at post-build, origin=Renesas_v1.0.0, default-value=false  # This parameter enables or disables generation of an internal reset when the error occurs from Mode error (test mode is started in single-chip mode). | true: enables generation of an internal reset when the error occurs from Mode error (test mode is started in single-chip mode). false: disables generation of an internal reset when the error occurs from Mode error (test mode is started in single-chip mode).
          boolean McuEcmErrorNMIDelayTimer: set at post-build, origin=Renesas_v1.0.0, default-value=false  # This parameter enables or disables delay timer start caused by non-maskable interrupts in response to errors from Mode error (test mode is started in single-chip mode). | true: enables delay timer start caused by non-maskable interrupts in response to errors from Mode error (test mode is started in single-chip mode). false: disables delay timer start caused by non-maskable interrupts in response to errors from Mode error (test mode is started in single-chip mode).
          boolean McuEcmErrorMIDelayTimer: set at post-build, origin=Renesas_v1.0.0, default-value=false  # This parameter enables or disables delay timer start caused by maskable interrupts in response to errors from Mode error (test mode is started in single-chip mode). | true: enables delay timer start caused by maskable interrupts in response to errors from Mode error (test mode is started in single-chip mode). false: disables delay timer start caused by maskable interrupts in response to errors from Mode error (test mode is started in single-chip mode).
          boolean McuEcmErrorOutputMask: set at post-build, origin=Renesas_v1.0.0, default-value=true  # This parameter mask or unmask the individual error sources of the error pin output from Mode error (test mode is started in single-chip mode). | true: mask the individual error sources of the error pin output from Mode error (test mode is started in single-chip mode). false: unmask the individual error sources of the error pin output from Mode error (test mode is started in single-chip mode).
          function name McuMiNotification [0..1]: set at post-build, origin=Renesas_v1.0.0, default-value=NULL_PTR, regular-expression=[a-zA-Z][a-zA-Z0-9_]*  # This parameter contains notification function for MI notification. | The syntax for McuMiNotification should be provided as Mcu_EcmMINotification.
          function name McuNmiNotification [0..1]: set at post-build, origin=Renesas_v1.0.0, default-value=NULL_PTR, regular-expression=[a-zA-Z][a-zA-Z0-9_]*  # This parameter contains notification function for NMI notification. | The syntax for McuNmiNotification should be provided as Mcu_EcmNMINotification.
        container McuEcmErrorSource23  # This container contains all the supported configuration parameters of the related error source from Mode error (single-chip mode is inactive in single-chip mode).
          boolean McuEcmErrorMaskableInterrupt: set at post-build, origin=Renesas_v1.0.0, default-value=false  # This parameter enables or disables generation of a maskable interrupt when the error occurs from Mode error (single-chip mode is inactive in single-chip mode). | true: enables generation of a maskable interrupt when the error occurs from Mode error (single-chip mode is inactive in single-chip mode). false: disables generation of a maskable interrupt when the error occurs from Mode error (single-chip mode is inactive in single-chip mode).
          boolean McuEcmErrorNonMaskableInterrupt: set at post-build, origin=Renesas_v1.0.0, default-value=false  # This parameter enables or disables generation of a non-maskable interrupt when the error occurs from Mode error (single-chip mode is inactive in single-chip mode). | true: enables generation of a non-maskable interrupt when the error occurs from Mode error (single-chip mode is inactive in single-chip mode). false: disables generation of a non-maskable interrupt when the error occurs from Mode error (single-chip mode is inactive in single-chip mode).
          boolean McuEcmErrorInternalReset: set at post-build, origin=Renesas_v1.0.0, default-value=false  # This parameter enables or disables generation of an internal reset when the error occurs from Mode error (single-chip mode is inactive in single-chip mode). | true: enables generation of an internal reset when the error occurs from Mode error (single-chip mode is inactive in single-chip mode). false: disables generation of an internal reset when the error occurs from Mode error (single-chip mode is inactive in single-chip mode).
          boolean McuEcmErrorNMIDelayTimer: set at post-build, origin=Renesas_v1.0.0, default-value=false  # This parameter enables or disables delay timer start caused by non-maskable interrupts in response to errors from Mode error (single-chip mode is inactive in single-chip mode). | true: enables delay timer start caused by non-maskable interrupts in response to errors from Mode error (single-chip mode is inactive in single-chip mode). false: disables delay timer start caused by non-maskable interrupts in response to errors from Mode error (single-chip mode is inactive in single-chip mode).
          boolean McuEcmErrorMIDelayTimer: set at post-build, origin=Renesas_v1.0.0, default-value=false  # This parameter enables or disables delay timer start caused by maskable interrupts in response to errors from Mode error (single-chip mode is inactive in single-chip mode). | true: enables delay timer start caused by maskable interrupts in response to errors from Mode error (single-chip mode is inactive in single-chip mode). false: disables delay timer start caused by maskable interrupts in response to errors from Mode error (single-chip mode is inactive in single-chip mode).
          boolean McuEcmErrorOutputMask: set at post-build, origin=Renesas_v1.0.0, default-value=true  # This parameter mask or unmask the individual error sources of the error pin output from Mode error (single-chip mode is inactive in single-chip mode). | true: mask the individual error sources of the error pin output from Mode error (single-chip mode is inactive in single-chip mode). false: unmask the individual error sources of the error pin output from Mode error (single-chip mode is inactive in single-chip mode).
          function name McuMiNotification [0..1]: set at post-build, origin=Renesas_v1.0.0, default-value=NULL_PTR, regular-expression=[a-zA-Z][a-zA-Z0-9_]*  # This parameter contains notification function for MI notification. | The syntax for McuMiNotification should be provided as Mcu_EcmMINotification.
          function name McuNmiNotification [0..1]: set at post-build, origin=Renesas_v1.0.0, default-value=NULL_PTR, regular-expression=[a-zA-Z][a-zA-Z0-9_]*  # This parameter contains notification function for NMI notification. | The syntax for McuNmiNotification should be provided as Mcu_EcmNMINotification.
        container McuEcmErrorSource24  # This container contains all the supported configuration parameters of the related error source from PE guard error.
          boolean McuEcmErrorMaskableInterrupt: set at post-build, origin=Renesas_v1.0.0, default-value=false  # This parameter enables or disables generation of a maskable interrupt when the error occurs from PE guard error. | true: enables generation of a maskable interrupt when the error occurs from PE guard error. false: disables generation of a maskable interrupt when the error occurs from PE guard error.
          boolean McuEcmErrorNonMaskableInterrupt: set at post-build, origin=Renesas_v1.0.0, default-value=false  # This parameter enables or disables generation of a non-maskable interrupt when the error occurs from PE guard error. | true: enables generation of a non-maskable interrupt when the error occurs from PE guard error. false: disables generation of a non-maskable interrupt when the error occurs from PE guard error.
          boolean McuEcmErrorInternalReset: set at post-build, origin=Renesas_v1.0.0, default-value=false  # This parameter enables or disables generation of an internal reset when the error occurs from PE guard error. | true: enables generation of an internal reset when the error occurs from PE guard error. false: disables generation of an internal reset when the error occurs from PE guard error.
          boolean McuEcmErrorNMIDelayTimer: set at post-build, origin=Renesas_v1.0.0, default-value=false  # This parameter enables or disables delay timer start caused by non-maskable interrupts in response to errors from PE guard error. | true: enables delay timer start caused by non-maskable interrupts in response to errors from PE guard error. false: disables delay timer start caused by non-maskable interrupts in response to errors from PE guard error.
          boolean McuEcmErrorMIDelayTimer: set at post-build, origin=Renesas_v1.0.0, default-value=false  # This parameter enables or disables delay timer start caused by maskable interrupts in response to errors from PE guard error. | true: enables delay timer start caused by maskable interrupts in response to errors from PE guard error. false: disables delay timer start caused by maskable interrupts in response to errors from PE guard error.
          boolean McuEcmErrorOutputMask: set at post-build, origin=Renesas_v1.0.0, default-value=true  # This parameter mask or unmask the individual error sources of the error pin output from PE guard error. | true: mask the individual error sources of the error pin output from PE guard error. false: unmask the individual error sources of the error pin output from PE guard error.
          function name McuMiNotification [0..1]: set at post-build, origin=Renesas_v1.0.0, default-value=NULL_PTR, regular-expression=[a-zA-Z][a-zA-Z0-9_]*  # This parameter contains notification function for MI notification. | The syntax for McuMiNotification should be provided as Mcu_EcmMINotification.
          function name McuNmiNotification [0..1]: set at post-build, origin=Renesas_v1.0.0, default-value=NULL_PTR, regular-expression=[a-zA-Z][a-zA-Z0-9_]*  # This parameter contains notification function for NMI notification. | The syntax for McuNmiNotification should be provided as Mcu_EcmNMINotification.
        container McuEcmErrorSource26  # This container contains all the supported configuration parameters of the related error source from P-Bus guard error.
          boolean McuEcmErrorMaskableInterrupt: set at post-build, origin=Renesas_v1.0.0, default-value=false  # This parameter enables or disables generation of a maskable interrupt when the error occurs from P-Bus guard error. | true: enables generation of a maskable interrupt when the error occurs from P-Bus guard error. false: disables generation of a maskable interrupt when the error occurs from P-Bus guard error.
          boolean McuEcmErrorNonMaskableInterrupt: set at post-build, origin=Renesas_v1.0.0, default-value=false  # This parameter enables or disables generation of a non-maskable interrupt when the error occurs from P-Bus guard error. | true: enables generation of a non-maskable interrupt when the error occurs from P-Bus guard error. false: disables generation of a non-maskable interrupt when the error occurs from P-Bus guard error.
          boolean McuEcmErrorInternalReset: set at post-build, origin=Renesas_v1.0.0, default-value=false  # This parameter enables or disables generation of an internal reset when the error occurs from P-Bus guard error. | true: enables generation of an internal reset when the error occurs from P-Bus guard error. false: disables generation of an internal reset when the error occurs from P-Bus guard error.
          boolean McuEcmErrorNMIDelayTimer: set at post-build, origin=Renesas_v1.0.0, default-value=false  # This parameter enables or disables delay timer start caused by non-maskable interrupts in response to errors from P-Bus guard error. | true: enables delay timer start caused by non-maskable interrupts in response to errors from P-Bus guard error. false: disables delay timer start caused by non-maskable interrupts in response to errors from P-Bus guard error.
          boolean McuEcmErrorMIDelayTimer: set at post-build, origin=Renesas_v1.0.0, default-value=false  # This parameter enables or disables delay timer start caused by maskable interrupts in response to errors from P-Bus guard error. | true: enables delay timer start caused by maskable interrupts in response to errors from P-Bus guard error. false: disables delay timer start caused by maskable interrupts in response to errors from P-Bus guard error.
          boolean McuEcmErrorOutputMask: set at post-build, origin=Renesas_v1.0.0, default-value=true  # This parameter mask or unmask the individual error sources of the error pin output from P-Bus guard error. | true: mask the individual error sources of the error pin output from P-Bus guard error. false: unmask the individual error sources of the error pin output from P-Bus guard error.
          function name McuMiNotification [0..1]: set at post-build, origin=Renesas_v1.0.0, default-value=NULL_PTR, regular-expression=[a-zA-Z][a-zA-Z0-9_]*  # This parameter contains notification function for MI notification. | The syntax for McuMiNotification should be provided as Mcu_EcmMINotification.
          function name McuNmiNotification [0..1]: set at post-build, origin=Renesas_v1.0.0, default-value=NULL_PTR, regular-expression=[a-zA-Z][a-zA-Z0-9_]*  # This parameter contains notification function for NMI notification. | The syntax for McuNmiNotification should be provided as Mcu_EcmNMINotification.
        container McuEcmErrorSource27  # This container contains all the supported configuration parameters of the related error source from SAR-ADC parity error.
          boolean McuEcmErrorMaskableInterrupt: set at post-build, origin=Renesas_v1.0.0, default-value=false  # This parameter enables or disables generation of a maskable interrupt when the error occurs from SAR-ADC parity error. | true: enables generation of a maskable interrupt when the error occurs from SAR-ADC parity error. false: disables generation of a maskable interrupt when the error occurs from SAR-ADC parity error.
          boolean McuEcmErrorNonMaskableInterrupt: set at post-build, origin=Renesas_v1.0.0, default-value=false  # This parameter enables or disables generation of a non-maskable interrupt when the error occurs from SAR-ADC parity error. | true: enables generation of a non-maskable interrupt when the error occurs from SAR-ADC parity error. false: disables generation of a non-maskable interrupt when the error occurs from SAR-ADC parity error.
          boolean McuEcmErrorInternalReset: set at post-build, origin=Renesas_v1.0.0, default-value=false  # This parameter enables or disables generation of an internal reset when the error occurs from SAR-ADC parity error. | true: enables generation of an internal reset when the error occurs from SAR-ADC parity error. false: disables generation of an internal reset when the error occurs from SAR-ADC parity error.
          boolean McuEcmErrorNMIDelayTimer: set at post-build, origin=Renesas_v1.0.0, default-value=false  # This parameter enables or disables delay timer start caused by non-maskable interrupts in response to errors from SAR-ADC parity error. | true: enables delay timer start caused by non-maskable interrupts in response to errors from SAR-ADC parity error. false: disables delay timer start caused by non-maskable interrupts in response to errors from SAR-ADC parity error.
          boolean McuEcmErrorMIDelayTimer: set at post-build, origin=Renesas_v1.0.0, default-value=false  # This parameter enables or disables delay timer start caused by maskable interrupts in response to errors from SAR-ADC parity error. | true: enables delay timer start caused by maskable interrupts in response to errors from SAR-ADC parity error. false: disables delay timer start caused by maskable interrupts in response to errors from SAR-ADC parity error.
          boolean McuEcmErrorOutputMask: set at post-build, origin=Renesas_v1.0.0, default-value=true  # This parameter mask or unmask the individual error sources of the error pin output from SAR-ADC parity error. | true: mask the individual error sources of the error pin output from SAR-ADC parity error. false: unmask the individual error sources of the error pin output from SAR-ADC parity error.
          function name McuMiNotification [0..1]: set at post-build, origin=Renesas_v1.0.0, default-value=NULL_PTR, regular-expression=[a-zA-Z][a-zA-Z0-9_]*  # This parameter contains notification function for MI notification. | The syntax for McuMiNotification should be provided as Mcu_EcmMINotification.
          function name McuNmiNotification [0..1]: set at post-build, origin=Renesas_v1.0.0, default-value=NULL_PTR, regular-expression=[a-zA-Z][a-zA-Z0-9_]*  # This parameter contains notification function for NMI notification. | The syntax for McuNmiNotification should be provided as Mcu_EcmNMINotification.
        container McuEcmErrorSource28  # This container contains all the supported configuration parameters of the related error source from Bus data parity error.
          boolean McuEcmErrorMaskableInterrupt: set at post-build, origin=Renesas_v1.0.0, default-value=false  # This parameter enables or disables generation of a maskable interrupt when the error occurs from Bus data parity error. | true: enables generation of a maskable interrupt when the error occurs from Bus data parity error. false: disables generation of a maskable interrupt when the error occurs from Bus data parity error.
          boolean McuEcmErrorNonMaskableInterrupt: set at post-build, origin=Renesas_v1.0.0, default-value=false  # This parameter enables or disables generation of a non-maskable interrupt when the error occurs from Bus data parity error. | true: enables generation of a non-maskable interrupt when the error occurs from Bus data parity error. false: disables generation of a non-maskable interrupt when the error occurs from Bus data parity error.
          boolean McuEcmErrorInternalReset: set at post-build, origin=Renesas_v1.0.0, default-value=false  # This parameter enables or disables generation of an internal reset when the error occurs from Bus data parity error. | true: enables generation of an internal reset when the error occurs from Bus data parity error. false: disables generation of an internal reset when the error occurs from Bus data parity error.
          boolean McuEcmErrorNMIDelayTimer: set at post-build, origin=Renesas_v1.0.0, default-value=false  # This parameter enables or disables delay timer start caused by non-maskable interrupts in response to errors from Bus data parity error. | true: enables delay timer start caused by non-maskable interrupts in response to errors from Bus data parity error. false: disables delay timer start caused by non-maskable interrupts in response to errors from Bus data parity error.
          boolean McuEcmErrorMIDelayTimer: set at post-build, origin=Renesas_v1.0.0, default-value=false  # This parameter enables or disables delay timer start caused by maskable interrupts in response to errors from Bus data parity error. | true: enables delay timer start caused by maskable interrupts in response to errors from Bus data parity error. false: disables delay timer start caused by maskable interrupts in response to errors from Bus data parity error.
          boolean McuEcmErrorOutputMask: set at post-build, origin=Renesas_v1.0.0, default-value=true  # This parameter mask or unmask the individual error sources of the error pin output from Bus data parity error. | true: mask the individual error sources of the error pin output from Bus data parity error. false: unmask the individual error sources of the error pin output from Bus data parity error.
          function name McuMiNotification [0..1]: set at post-build, origin=Renesas_v1.0.0, default-value=NULL_PTR, regular-expression=[a-zA-Z][a-zA-Z0-9_]*  # This parameter contains notification function for MI notification. | The syntax for McuMiNotification should be provided as Mcu_EcmMINotification.
          function name McuNmiNotification [0..1]: set at post-build, origin=Renesas_v1.0.0, default-value=NULL_PTR, regular-expression=[a-zA-Z][a-zA-Z0-9_]*  # This parameter contains notification function for NMI notification. | The syntax for McuNmiNotification should be provided as Mcu_EcmNMINotification.
        container McuEcmErrorSource29  # This container contains all the supported configuration parameters of the related error source from ECM compare error.
          boolean McuEcmErrorMaskableInterrupt: set at post-build, origin=Renesas_v1.0.0, default-value=false  # This parameter enables or disables generation of a maskable interrupt when the error occurs from ECM compare error. | true: enables generation of a maskable interrupt when the error occurs from ECM compare error. false: disables generation of a maskable interrupt when the error occurs from ECM compare error.
          boolean McuEcmErrorNonMaskableInterrupt: set at post-build, origin=Renesas_v1.0.0, default-value=false  # This parameter enables or disables generation of a non-maskable interrupt when the error occurs from ECM compare error. | true: enables generation of a non-maskable interrupt when the error occurs from ECM compare error. false: disables generation of a non-maskable interrupt when the error occurs from ECM compare error.
          boolean McuEcmErrorInternalReset: set at post-build, origin=Renesas_v1.0.0, default-value=false  # This parameter enables or disables generation of an internal reset when the error occurs from ECM compare error. | true: enables generation of an internal reset when the error occurs from ECM compare error. false: disables generation of an internal reset when the error occurs from ECM compare error.
          boolean McuEcmErrorNMIDelayTimer: set at post-build, origin=Renesas_v1.0.0, default-value=false  # This parameter enables or disables delay timer start caused by non-maskable interrupts in response to errors from ECM compare error. | true: enables delay timer start caused by non-maskable interrupts in response to errors from ECM compare error. false: disables delay timer start caused by non-maskable interrupts in response to errors from ECM compare error.
          boolean McuEcmErrorMIDelayTimer: set at post-build, origin=Renesas_v1.0.0, default-value=false  # This parameter enables or disables delay timer start caused by maskable interrupts in response to errors from ECM compare error. | true: enables delay timer start caused by maskable interrupts in response to errors from ECM compare error. false: disables delay timer start caused by maskable interrupts in response to errors from ECM compare error.
          boolean McuEcmErrorOutputMask: set at post-build, origin=Renesas_v1.0.0, default-value=true  # This parameter mask or unmask the individual error sources of the error pin output from ECM compare error. | true: mask the individual error sources of the error pin output from ECM compare error. false: unmask the individual error sources of the error pin output from ECM compare error.
          function name McuMiNotification [0..1]: set at post-build, origin=Renesas_v1.0.0, default-value=NULL_PTR, regular-expression=[a-zA-Z][a-zA-Z0-9_]*  # This parameter contains notification function for MI notification. | The syntax for McuMiNotification should be provided as Mcu_EcmMINotification.
          function name McuNmiNotification [0..1]: set at post-build, origin=Renesas_v1.0.0, default-value=NULL_PTR, regular-expression=[a-zA-Z][a-zA-Z0-9_]*  # This parameter contains notification function for NMI notification. | The syntax for McuNmiNotification should be provided as Mcu_EcmNMINotification.
        container McuEcmErrorSource30  # This container contains all the supported configuration parameters of the related error source from LVI error.
          boolean McuEcmErrorMaskableInterrupt: set at post-build, origin=Renesas_v1.0.0, default-value=false  # This parameter enables or disables generation of a maskable interrupt when the error occurs from LVI error. | true: enables generation of a maskable interrupt when the error occurs from LVI error. false: disables generation of a maskable interrupt when the error occurs from LVI error.
          boolean McuEcmErrorNonMaskableInterrupt: set at post-build, origin=Renesas_v1.0.0, default-value=false  # This parameter enables or disables generation of a non-maskable interrupt when the error occurs from LVI error. | true: enables generation of a non-maskable interrupt when the error occurs from LVI error. false: disables generation of a non-maskable interrupt when the error occurs from LVI error.
          boolean McuEcmErrorInternalReset: set at post-build, origin=Renesas_v1.0.0, default-value=false  # This parameter enables or disables generation of an internal reset when the error occurs from LVI error. | true: enables generation of an internal reset when the error occurs from LVI error. false: disables generation of an internal reset when the error occurs from LVI error.
          boolean McuEcmErrorNMIDelayTimer: set at post-build, origin=Renesas_v1.0.0, default-value=false  # This parameter enables or disables delay timer start caused by non-maskable interrupts in response to errors from LVI error. | true: enables delay timer start caused by non-maskable interrupts in response to errors from LVI error. false: disables delay timer start caused by non-maskable interrupts in response to errors from LVI error.
          boolean McuEcmErrorMIDelayTimer: set at post-build, origin=Renesas_v1.0.0, default-value=false  # This parameter enables or disables delay timer start caused by maskable interrupts in response to errors from LVI error. | true: enables delay timer start caused by maskable interrupts in response to errors from LVI error. false: disables delay timer start caused by maskable interrupts in response to errors from LVI error.
          boolean McuEcmErrorOutputMask: set at post-build, origin=Renesas_v1.0.0, default-value=true  # This parameter mask or unmask the individual error sources of the error pin output from LVI error. | true: mask the individual error sources of the error pin output from LVI error. false: unmask the individual error sources of the error pin output from LVI error.
          function name McuMiNotification [0..1]: set at post-build, origin=Renesas_v1.0.0, default-value=NULL_PTR, regular-expression=[a-zA-Z][a-zA-Z0-9_]*  # This parameter contains notification function for MI notification. | The syntax for McuMiNotification should be provided as Mcu_EcmMINotification.
          function name McuNmiNotification [0..1]: set at post-build, origin=Renesas_v1.0.0, default-value=NULL_PTR, regular-expression=[a-zA-Z][a-zA-Z0-9_]*  # This parameter contains notification function for NMI notification. | The syntax for McuNmiNotification should be provided as Mcu_EcmNMINotification.
        container McuEcmErrorSource31  # This container contains all the supported configuration parameters of the related error source from Temperature sensor error.
          boolean McuEcmErrorMaskableInterrupt: set at post-build, origin=Renesas_v1.0.0, default-value=false  # This parameter enables or disables generation of a maskable interrupt when the error occurs from Temperature sensor error. | true: enables generation of a maskable interrupt when the error occurs from Temperature sensor error. false: disables generation of a maskable interrupt when the error occurs from Temperature sensor error.
          boolean McuEcmErrorNonMaskableInterrupt: set at post-build, origin=Renesas_v1.0.0, default-value=false  # This parameter enables or disables generation of a non-maskable interrupt when the error occurs from Temperature sensor error. | true: enables generation of a non-maskable interrupt when the error occurs from Temperature sensor error. false: disables generation of a non-maskable interrupt when the error occurs from Temperature sensor error.
          boolean McuEcmErrorInternalReset: set at post-build, origin=Renesas_v1.0.0, default-value=false  # This parameter enables or disables generation of an internal reset when the error occurs from Temperature sensor error. | true: enables generation of an internal reset when the error occurs from Temperature sensor error. false: disables generation of an internal reset when the error occurs from Temperature sensor error.
          boolean McuEcmErrorNMIDelayTimer: set at post-build, origin=Renesas_v1.0.0, default-value=false  # This parameter enables or disables delay timer start caused by non-maskable interrupts in response to errors from Temperature sensor error. | true: enables delay timer start caused by non-maskable interrupts in response to errors from Temperature sensor error. false: disables delay timer start caused by non-maskable interrupts in response to errors from Temperature sensor error.
          boolean McuEcmErrorMIDelayTimer: set at post-build, origin=Renesas_v1.0.0, default-value=false  # This parameter enables or disables delay timer start caused by maskable interrupts in response to errors from Temperature sensor error. | true: enables delay timer start caused by maskable interrupts in response to errors from Temperature sensor error. false: disables delay timer start caused by maskable interrupts in response to errors from Temperature sensor error.
          boolean McuEcmErrorOutputMask: set at post-build, origin=Renesas_v1.0.0, default-value=true  # This parameter mask or unmask the individual error sources of the error pin output from Temperature sensor error. | true: mask the individual error sources of the error pin output from Temperature sensor error. false: unmask the individual error sources of the error pin output from Temperature sensor error.
          function name McuMiNotification [0..1]: set at post-build, origin=Renesas_v1.0.0, default-value=NULL_PTR, regular-expression=[a-zA-Z][a-zA-Z0-9_]*  # This parameter contains notification function for MI notification. | The syntax for McuMiNotification should be provided as Mcu_EcmMINotification.
          function name McuNmiNotification [0..1]: set at post-build, origin=Renesas_v1.0.0, default-value=NULL_PTR, regular-expression=[a-zA-Z][a-zA-Z0-9_]*  # This parameter contains notification function for NMI notification. | The syntax for McuNmiNotification should be provided as Mcu_EcmNMINotification.
        container McuEcmErrorSource32  # This container contains all the supported configuration parameters of the related error source from DMA transfer error.
          boolean McuEcmErrorMaskableInterrupt: set at post-build, origin=Renesas_v1.0.0, default-value=false  # This parameter enables or disables generation of a maskable interrupt when the error occurs from DMA transfer error. | true: enables generation of a maskable interrupt when the error occurs from DMA transfer error. false: disables generation of a maskable interrupt when the error occurs from DMA transfer error.
          boolean McuEcmErrorNonMaskableInterrupt: set at post-build, origin=Renesas_v1.0.0, default-value=false  # This parameter enables or disables generation of a non-maskable interrupt when the error occurs from DMA transfer error. | true: enables generation of a non-maskable interrupt when the error occurs from DMA transfer error. false: disables generation of a non-maskable interrupt when the error occurs from DMA transfer error.
          boolean McuEcmErrorInternalReset: set at post-build, origin=Renesas_v1.0.0, default-value=false  # This parameter enables or disables generation of an internal reset when the error occurs from DMA transfer error. | true: enables generation of an internal reset when the error occurs from DMA transfer error. false: disables generation of an internal reset when the error occurs from DMA transfer error.
          boolean McuEcmErrorNMIDelayTimer: set at post-build, origin=Renesas_v1.0.0, default-value=false  # This parameter enables or disables delay timer start caused by non-maskable interrupts in response to errors from DMA transfer error. | true: enables delay timer start caused by non-maskable interrupts in response to errors from DMA transfer error. false: disables delay timer start caused by non-maskable interrupts in response to errors from DMA transfer error.
          boolean McuEcmErrorMIDelayTimer: set at post-build, origin=Renesas_v1.0.0, default-value=false  # This parameter enables or disables delay timer start caused by maskable interrupts in response to errors from DMA transfer error. | true: enables delay timer start caused by maskable interrupts in response to errors from DMA transfer error. false: disables delay timer start caused by maskable interrupts in response to errors from DMA transfer error.
          boolean McuEcmErrorOutputMask: set at post-build, origin=Renesas_v1.0.0, default-value=true  # This parameter mask or unmask the individual error sources of the error pin output from DMA transfer error. | true: mask the individual error sources of the error pin output from DMA transfer error. false: unmask the individual error sources of the error pin output from DMA transfer error.
          function name McuMiNotification [0..1]: set at post-build, origin=Renesas_v1.0.0, default-value=NULL_PTR, regular-expression=[a-zA-Z][a-zA-Z0-9_]*  # This parameter contains notification function for MI notification. | The syntax for McuMiNotification should be provided as Mcu_EcmMINotification.
          function name McuNmiNotification [0..1]: set at post-build, origin=Renesas_v1.0.0, default-value=NULL_PTR, regular-expression=[a-zA-Z][a-zA-Z0-9_]*  # This parameter contains notification function for NMI notification. | The syntax for McuNmiNotification should be provided as Mcu_EcmNMINotification.
        container McuEcmErrorSource33  # This container contains all the supported configuration parameters of the related error source from DMA register access protection violation error.
          boolean McuEcmErrorMaskableInterrupt: set at post-build, origin=Renesas_v1.0.0, default-value=false  # This parameter enables or disables generation of a maskable interrupt when the error occurs from DMA register access protection violation error. | true: enables generation of a maskable interrupt when the error occurs from DMA register access protection violation error. false: disables generation of a maskable interrupt when the error occurs from DMA register access protection violation error.
          boolean McuEcmErrorNonMaskableInterrupt: set at post-build, origin=Renesas_v1.0.0, default-value=false  # This parameter enables or disables generation of a non-maskable interrupt when the error occurs from DMA register access protection violation error. | true: enables generation of a non-maskable interrupt when the error occurs from DMA register access protection violation error. false: disables generation of a non-maskable interrupt when the error occurs from DMA register access protection violation error.
          boolean McuEcmErrorInternalReset: set at post-build, origin=Renesas_v1.0.0, default-value=false  # This parameter enables or disables generation of an internal reset when the error occurs from DMA register access protection violation error. | true: enables generation of an internal reset when the error occurs from DMA register access protection violation error. false: disables generation of an internal reset when the error occurs from DMA register access protection violation error.
          boolean McuEcmErrorNMIDelayTimer: set at post-build, origin=Renesas_v1.0.0, default-value=false  # This parameter enables or disables delay timer start caused by non-maskable interrupts in response to errors from DMA register access protection violation error. | true: enables delay timer start caused by non-maskable interrupts in response to errors from DMA register access protection violation error. false: disables delay timer start caused by non-maskable interrupts in response to errors from DMA register access protection violation error.
          boolean McuEcmErrorMIDelayTimer: set at post-build, origin=Renesas_v1.0.0, default-value=false  # This parameter enables or disables delay timer start caused by maskable interrupts in response to errors from DMA register access protection violation error. | true: enables delay timer start caused by maskable interrupts in response to errors from DMA register access protection violation error. false: disables delay timer start caused by maskable interrupts in response to errors from DMA register access protection violation error.
          boolean McuEcmErrorOutputMask: set at post-build, origin=Renesas_v1.0.0, default-value=true  # This parameter mask or unmask the individual error sources of the error pin output from DMA register access protection violation error. | true: mask the individual error sources of the error pin output from DMA register access protection violation error. false: unmask the individual error sources of the error pin output from DMA register access protection violation error.
          function name McuMiNotification [0..1]: set at post-build, origin=Renesas_v1.0.0, default-value=NULL_PTR, regular-expression=[a-zA-Z][a-zA-Z0-9_]*  # This parameter contains notification function for MI notification. | The syntax for McuMiNotification should be provided as Mcu_EcmMINotification.
          function name McuNmiNotification [0..1]: set at post-build, origin=Renesas_v1.0.0, default-value=NULL_PTR, regular-expression=[a-zA-Z][a-zA-Z0-9_]*  # This parameter contains notification function for NMI notification. | The syntax for McuNmiNotification should be provided as Mcu_EcmNMINotification.
        container McuEcmErrorSource34  # This container contains all the supported configuration parameters of the related error source from Local RAM ECC 1-bit error and parity error.
          boolean McuEcmErrorMaskableInterrupt: set at post-build, origin=Renesas_v1.0.0, default-value=false  # This parameter enables or disables generation of a maskable interrupt when the error occurs from Local RAM ECC 1-bit error and parity error. | true: enables generation of a maskable interrupt when the error occurs from Local RAM ECC 1-bit error and parity error. false: disables generation of a maskable interrupt when the error occurs from Local RAM ECC 1-bit error and parity error.
          boolean McuEcmErrorNonMaskableInterrupt: set at post-build, origin=Renesas_v1.0.0, default-value=false  # This parameter enables or disables generation of a non-maskable interrupt when the error occurs from Local RAM ECC 1-bit error and parity error. | true: enables generation of a non-maskable interrupt when the error occurs from Local RAM ECC 1-bit error and parity error. false: disables generation of a non-maskable interrupt when the error occurs from Local RAM ECC 1-bit error and parity error.
          boolean McuEcmErrorInternalReset: set at post-build, origin=Renesas_v1.0.0, default-value=false  # This parameter enables or disables generation of an internal reset when the error occurs from Local RAM ECC 1-bit error and parity error. | true: enables generation of an internal reset when the error occurs from Local RAM ECC 1-bit error and parity error. false: disables generation of an internal reset when the error occurs from Local RAM ECC 1-bit error and parity error.
          boolean McuEcmErrorNMIDelayTimer: set at post-build, origin=Renesas_v1.0.0, default-value=false  # This parameter enables or disables delay timer start caused by non-maskable interrupts in response to errors from Local RAM ECC 1-bit error and parity error. | true: enables delay timer start caused by non-maskable interrupts in response to errors from Local RAM ECC 1-bit error and parity error. false: disables delay timer start caused by non-maskable interrupts in response to errors from Local RAM ECC 1-bit error and parity error.
          boolean McuEcmErrorMIDelayTimer: set at post-build, origin=Renesas_v1.0.0, default-value=false  # This parameter enables or disables delay timer start caused by maskable interrupts in response to errors from Local RAM ECC 1-bit error and parity error. | true: enables delay timer start caused by maskable interrupts in response to errors from Local RAM ECC 1-bit error and parity error. false: disables delay timer start caused by maskable interrupts in response to errors from Local RAM ECC 1-bit error and parity error.
          boolean McuEcmErrorOutputMask: set at post-build, origin=Renesas_v1.0.0, default-value=true  # This parameter mask or unmask the individual error sources of the error pin output from Local RAM ECC 1-bit error and parity error. | true: mask the individual error sources of the error pin output from Local RAM ECC 1-bit error and parity error. false: unmask the individual error sources of the error pin output from Local RAM ECC 1-bit error and parity error.
          function name McuMiNotification [0..1]: set at post-build, origin=Renesas_v1.0.0, default-value=NULL_PTR, regular-expression=[a-zA-Z][a-zA-Z0-9_]*  # This parameter contains notification function for MI notification. | The syntax for McuMiNotification should be provided as Mcu_EcmMINotification.
          function name McuNmiNotification [0..1]: set at post-build, origin=Renesas_v1.0.0, default-value=NULL_PTR, regular-expression=[a-zA-Z][a-zA-Z0-9_]*  # This parameter contains notification function for NMI notification. | The syntax for McuNmiNotification should be provided as Mcu_EcmNMINotification.
        container McuEcmErrorSource36  # This container contains all the supported configuration parameters of the related error source from Code flash ECC 1-bit error.
          boolean McuEcmErrorMaskableInterrupt: set at post-build, origin=Renesas_v1.0.0, default-value=false  # This parameter enables or disables generation of a maskable interrupt when the error occurs from Code flash ECC 1-bit error. | true: enables generation of a maskable interrupt when the error occurs from Code flash ECC 1-bit error. false: disables generation of a maskable interrupt when the error occurs from Code flash ECC 1-bit error.
          boolean McuEcmErrorNonMaskableInterrupt: set at post-build, origin=Renesas_v1.0.0, default-value=false  # This parameter enables or disables generation of a non-maskable interrupt when the error occurs from Code flash ECC 1-bit error. | true: enables generation of a non-maskable interrupt when the error occurs from Code flash ECC 1-bit error. false: disables generation of a non-maskable interrupt when the error occurs from Code flash ECC 1-bit error.
          boolean McuEcmErrorInternalReset: set at post-build, origin=Renesas_v1.0.0, default-value=false  # This parameter enables or disables generation of an internal reset when the error occurs from Code flash ECC 1-bit error. | true: enables generation of an internal reset when the error occurs from Code flash ECC 1-bit error. false: disables generation of an internal reset when the error occurs from Code flash ECC 1-bit error.
          boolean McuEcmErrorNMIDelayTimer: set at post-build, origin=Renesas_v1.0.0, default-value=false  # This parameter enables or disables delay timer start caused by non-maskable interrupts in response to errors from Code flash ECC 1-bit error. | true: enables delay timer start caused by non-maskable interrupts in response to errors from Code flash ECC 1-bit error. false: disables delay timer start caused by non-maskable interrupts in response to errors from Code flash ECC 1-bit error.
          boolean McuEcmErrorMIDelayTimer: set at post-build, origin=Renesas_v1.0.0, default-value=false  # This parameter enables or disables delay timer start caused by maskable interrupts in response to errors from Code flash ECC 1-bit error. | true: enables delay timer start caused by maskable interrupts in response to errors from Code flash ECC 1-bit error. false: disables delay timer start caused by maskable interrupts in response to errors from Code flash ECC 1-bit error.
          boolean McuEcmErrorOutputMask: set at post-build, origin=Renesas_v1.0.0, default-value=true  # This parameter mask or unmask the individual error sources of the error pin output from Code flash ECC 1-bit error. | true: mask the individual error sources of the error pin output from Code flash ECC 1-bit error. false: unmask the individual error sources of the error pin output from Code flash ECC 1-bit error.
          function name McuMiNotification [0..1]: set at post-build, origin=Renesas_v1.0.0, default-value=NULL_PTR, regular-expression=[a-zA-Z][a-zA-Z0-9_]*  # This parameter contains notification function for MI notification. | The syntax for McuMiNotification should be provided as Mcu_EcmMINotification.
          function name McuNmiNotification [0..1]: set at post-build, origin=Renesas_v1.0.0, default-value=NULL_PTR, regular-expression=[a-zA-Z][a-zA-Z0-9_]*  # This parameter contains notification function for NMI notification. | The syntax for McuNmiNotification should be provided as Mcu_EcmNMINotification.
        container McuEcmErrorSource37  # This container contains all the supported configuration parameters of the related error source from Data flash ECC 1-bit error.
          boolean McuEcmErrorMaskableInterrupt: set at post-build, origin=Renesas_v1.0.0, default-value=false  # This parameter enables or disables generation of a maskable interrupt when the error occurs from Data flash ECC 1-bit error. | true: enables generation of a maskable interrupt when the error occurs from Data flash ECC 1-bit error. false: disables generation of a maskable interrupt when the error occurs from Data flash ECC 1-bit error.
          boolean McuEcmErrorNonMaskableInterrupt: set at post-build, origin=Renesas_v1.0.0, default-value=false  # This parameter enables or disables generation of a non-maskable interrupt when the error occurs from Data flash ECC 1-bit error. | true: enables generation of a non-maskable interrupt when the error occurs from Data flash ECC 1-bit error. false: disables generation of a non-maskable interrupt when the error occurs from Data flash ECC 1-bit error.
          boolean McuEcmErrorInternalReset: set at post-build, origin=Renesas_v1.0.0, default-value=false  # This parameter enables or disables generation of an internal reset when the error occurs from Data flash ECC 1-bit error. | true: enables generation of an internal reset when the error occurs from Data flash ECC 1-bit error. false: disables generation of an internal reset when the error occurs from Data flash ECC 1-bit error.
          boolean McuEcmErrorNMIDelayTimer: set at post-build, origin=Renesas_v1.0.0, default-value=false  # This parameter enables or disables delay timer start caused by non-maskable interrupts in response to errors from Data flash ECC 1-bit error. | true: enables delay timer start caused by non-maskable interrupts in response to errors from Data flash ECC 1-bit error. false: disables delay timer start caused by non-maskable interrupts in response to errors from Data flash ECC 1-bit error.
          boolean McuEcmErrorMIDelayTimer: set at post-build, origin=Renesas_v1.0.0, default-value=false  # This parameter enables or disables delay timer start caused by maskable interrupts in response to errors from Data flash ECC 1-bit error. | true: enables delay timer start caused by maskable interrupts in response to errors from Data flash ECC 1-bit error. false: disables delay timer start caused by maskable interrupts in response to errors from Data flash ECC 1-bit error.
          boolean McuEcmErrorOutputMask: set at post-build, origin=Renesas_v1.0.0, default-value=true  # This parameter mask or unmask the individual error sources of the error pin output from Data flash ECC 1-bit error. | true: mask the individual error sources of the error pin output from Data flash ECC 1-bit error. false: unmask the individual error sources of the error pin output from Data flash ECC 1-bit error.
          function name McuMiNotification [0..1]: set at post-build, origin=Renesas_v1.0.0, default-value=NULL_PTR, regular-expression=[a-zA-Z][a-zA-Z0-9_]*  # This parameter contains notification function for MI notification. | The syntax for McuMiNotification should be provided as Mcu_EcmMINotification.
          function name McuNmiNotification [0..1]: set at post-build, origin=Renesas_v1.0.0, default-value=NULL_PTR, regular-expression=[a-zA-Z][a-zA-Z0-9_]*  # This parameter contains notification function for NMI notification. | The syntax for McuNmiNotification should be provided as Mcu_EcmNMINotification.
        container McuEcmErrorSource38  # This container contains all the supported configuration parameters of the related error source from DTS RAM ECC 1-bit error.
          boolean McuEcmErrorMaskableInterrupt: set at post-build, origin=Renesas_v1.0.0, default-value=false  # This parameter enables or disables generation of a maskable interrupt when the error occurs from DTS RAM ECC 1-bit error. | true: enables generation of a maskable interrupt when the error occurs from DTS RAM ECC 1-bit error. false: disables generation of a maskable interrupt when the error occurs from DTS RAM ECC 1-bit error.
          boolean McuEcmErrorNonMaskableInterrupt: set at post-build, origin=Renesas_v1.0.0, default-value=false  # This parameter enables or disables generation of a non-maskable interrupt when the error occurs from DTS RAM ECC 1-bit error. | true: enables generation of a non-maskable interrupt when the error occurs from DTS RAM ECC 1-bit error. false: disables generation of a non-maskable interrupt when the error occurs from DTS RAM ECC 1-bit error.
          boolean McuEcmErrorInternalReset: set at post-build, origin=Renesas_v1.0.0, default-value=false  # This parameter enables or disables generation of an internal reset when the error occurs from DTS RAM ECC 1-bit error. | true: enables generation of an internal reset when the error occurs from DTS RAM ECC 1-bit error. false: disables generation of an internal reset when the error occurs from DTS RAM ECC 1-bit error.
          boolean McuEcmErrorNMIDelayTimer: set at post-build, origin=Renesas_v1.0.0, default-value=false  # This parameter enables or disables delay timer start caused by non-maskable interrupts in response to errors from DTS RAM ECC 1-bit error. | true: enables delay timer start caused by non-maskable interrupts in response to errors from DTS RAM ECC 1-bit error. false: disables delay timer start caused by non-maskable interrupts in response to errors from DTS RAM ECC 1-bit error.
          boolean McuEcmErrorMIDelayTimer: set at post-build, origin=Renesas_v1.0.0, default-value=false  # This parameter enables or disables delay timer start caused by maskable interrupts in response to errors from DTS RAM ECC 1-bit error. | true: enables delay timer start caused by maskable interrupts in response to errors from DTS RAM ECC 1-bit error. false: disables delay timer start caused by maskable interrupts in response to errors from DTS RAM ECC 1-bit error.
          boolean McuEcmErrorOutputMask: set at post-build, origin=Renesas_v1.0.0, default-value=true  # This parameter mask or unmask the individual error sources of the error pin output from DTS RAM ECC 1-bit error. | true: mask the individual error sources of the error pin output from DTS RAM ECC 1-bit error. false: unmask the individual error sources of the error pin output from DTS RAM ECC 1-bit error.
          function name McuMiNotification [0..1]: set at post-build, origin=Renesas_v1.0.0, default-value=NULL_PTR, regular-expression=[a-zA-Z][a-zA-Z0-9_]*  # This parameter contains notification function for MI notification. | The syntax for McuMiNotification should be provided as Mcu_EcmMINotification.
          function name McuNmiNotification [0..1]: set at post-build, origin=Renesas_v1.0.0, default-value=NULL_PTR, regular-expression=[a-zA-Z][a-zA-Z0-9_]*  # This parameter contains notification function for NMI notification. | The syntax for McuNmiNotification should be provided as Mcu_EcmNMINotification.
        container McuEcmErrorSource39  # This container contains all the supported configuration parameters of the related error source from All peripheral functions RAM ECC 1-bit error.
          boolean McuEcmErrorMaskableInterrupt: set at post-build, origin=Renesas_v1.0.0, default-value=false  # This parameter enables or disables generation of a maskable interrupt when the error occurs from All peripheral functions RAM ECC 1-bit error. | true: enables generation of a maskable interrupt when the error occurs from All peripheral functions RAM ECC 1-bit error. false: disables generation of a maskable interrupt when the error occurs from All peripheral functions RAM ECC 1-bit error.
          boolean McuEcmErrorNonMaskableInterrupt: set at post-build, origin=Renesas_v1.0.0, default-value=false  # This parameter enables or disables generation of a non-maskable interrupt when the error occurs from All peripheral functions RAM ECC 1-bit error. | true: enables generation of a non-maskable interrupt when the error occurs from All peripheral functions RAM ECC 1-bit error. false: disables generation of a non-maskable interrupt when the error occurs from All peripheral functions RAM ECC 1-bit error.
          boolean McuEcmErrorInternalReset: set at post-build, origin=Renesas_v1.0.0, default-value=false  # This parameter enables or disables generation of an internal reset when the error occurs from All peripheral functions RAM ECC 1-bit error. | true: enables generation of an internal reset when the error occurs from All peripheral functions RAM ECC 1-bit error. false: disables generation of an internal reset when the error occurs from All peripheral functions RAM ECC 1-bit error.
          boolean McuEcmErrorNMIDelayTimer: set at post-build, origin=Renesas_v1.0.0, default-value=false  # This parameter enables or disables delay timer start caused by non-maskable interrupts in response to errors from All peripheral functions RAM ECC 1-bit error. | true: enables delay timer start caused by non-maskable interrupts in response to errors from All peripheral functions RAM ECC 1-bit error. false: disables delay timer start caused by non-maskable interrupts in response to errors from All peripheral functions RAM ECC 1-bit error.
          boolean McuEcmErrorMIDelayTimer: set at post-build, origin=Renesas_v1.0.0, default-value=false  # This parameter enables or disables delay timer start caused by maskable interrupts in response to errors from All peripheral functions RAM ECC 1-bit error. | true: enables delay timer start caused by maskable interrupts in response to errors from All peripheral functions RAM ECC 1-bit error. false: disables delay timer start caused by maskable interrupts in response to errors from All peripheral functions RAM ECC 1-bit error.
          boolean McuEcmErrorOutputMask: set at post-build, origin=Renesas_v1.0.0, default-value=true  # This parameter mask or unmask the individual error sources of the error pin output from All peripheral functions RAM ECC 1-bit error. | true: mask the individual error sources of the error pin output from All peripheral functions RAM ECC 1-bit error. false: unmask the individual error sources of the error pin output from All peripheral functions RAM ECC 1-bit error.
          function name McuMiNotification [0..1]: set at post-build, origin=Renesas_v1.0.0, default-value=NULL_PTR, regular-expression=[a-zA-Z][a-zA-Z0-9_]*  # This parameter contains notification function for MI notification. | The syntax for McuMiNotification should be provided as Mcu_EcmMINotification.
          function name McuNmiNotification [0..1]: set at post-build, origin=Renesas_v1.0.0, default-value=NULL_PTR, regular-expression=[a-zA-Z][a-zA-Z0-9_]*  # This parameter contains notification function for NMI notification. | The syntax for McuNmiNotification should be provided as Mcu_EcmNMINotification.
        container McuEcmErrorSource40  # This container contains all the supported configuration parameters of the related error source from BIST code ECC 1-bit error.
          boolean McuEcmErrorMaskableInterrupt: set at post-build, origin=Renesas_v1.0.0, default-value=false  # This parameter enables or disables generation of a maskable interrupt when the error occurs from BIST code ECC 1-bit error. | true: enables generation of a maskable interrupt when the error occurs from BIST code ECC 1-bit error. false: disables generation of a maskable interrupt when the error occurs from BIST code ECC 1-bit error.
          boolean McuEcmErrorNonMaskableInterrupt: set at post-build, origin=Renesas_v1.0.0, default-value=false  # This parameter enables or disables generation of a non-maskable interrupt when the error occurs from BIST code ECC 1-bit error. | true: enables generation of a non-maskable interrupt when the error occurs from BIST code ECC 1-bit error. false: disables generation of a non-maskable interrupt when the error occurs from BIST code ECC 1-bit error.
          boolean McuEcmErrorInternalReset: set at post-build, origin=Renesas_v1.0.0, default-value=false  # This parameter enables or disables generation of an internal reset when the error occurs from BIST code ECC 1-bit error. | true: enables generation of an internal reset when the error occurs from BIST code ECC 1-bit error. false: disables generation of an internal reset when the error occurs from BIST code ECC 1-bit error.
          boolean McuEcmErrorNMIDelayTimer: set at post-build, origin=Renesas_v1.0.0, default-value=false  # This parameter enables or disables delay timer start caused by non-maskable interrupts in response to errors from BIST code ECC 1-bit error. | true: enables delay timer start caused by non-maskable interrupts in response to errors from BIST code ECC 1-bit error. false: disables delay timer start caused by non-maskable interrupts in response to errors from BIST code ECC 1-bit error.
          boolean McuEcmErrorMIDelayTimer: set at post-build, origin=Renesas_v1.0.0, default-value=false  # This parameter enables or disables delay timer start caused by maskable interrupts in response to errors from BIST code ECC 1-bit error. | true: enables delay timer start caused by maskable interrupts in response to errors from BIST code ECC 1-bit error. false: disables delay timer start caused by maskable interrupts in response to errors from BIST code ECC 1-bit error.
          boolean McuEcmErrorOutputMask: set at post-build, origin=Renesas_v1.0.0, default-value=true  # This parameter mask or unmask the individual error sources of the error pin output from BIST code ECC 1-bit error. | true: mask the individual error sources of the error pin output from BIST code ECC 1-bit error. false: unmask the individual error sources of the error pin output from BIST code ECC 1-bit error.
          function name McuMiNotification [0..1]: set at post-build, origin=Renesas_v1.0.0, default-value=NULL_PTR, regular-expression=[a-zA-Z][a-zA-Z0-9_]*  # This parameter contains notification function for MI notification. | The syntax for McuMiNotification should be provided as Mcu_EcmMINotification.
          function name McuNmiNotification [0..1]: set at post-build, origin=Renesas_v1.0.0, default-value=NULL_PTR, regular-expression=[a-zA-Z][a-zA-Z0-9_]*  # This parameter contains notification function for NMI notification. | The syntax for McuNmiNotification should be provided as Mcu_EcmNMINotification.
        container McuEcmErrorSource41  # This container contains all the supported configuration parameters of the related error source from BIST code ECC 2-bit error.
          boolean McuEcmErrorMaskableInterrupt: set at post-build, origin=Renesas_v1.0.0, default-value=false  # This parameter enables or disables generation of a maskable interrupt when the error occurs from BIST code ECC 2-bit error. | true: enables generation of a maskable interrupt when the error occurs from BIST code ECC 2-bit error. false: disables generation of a maskable interrupt when the error occurs from BIST code ECC 2-bit error.
          boolean McuEcmErrorNonMaskableInterrupt: set at post-build, origin=Renesas_v1.0.0, default-value=false  # This parameter enables or disables generation of a non-maskable interrupt when the error occurs from BIST code ECC 2-bit error. | true: enables generation of a non-maskable interrupt when the error occurs from BIST code ECC 2-bit error. false: disables generation of a non-maskable interrupt when the error occurs from BIST code ECC 2-bit error.
          boolean McuEcmErrorInternalReset: set at post-build, origin=Renesas_v1.0.0, default-value=false  # This parameter enables or disables generation of an internal reset when the error occurs from BIST code ECC 2-bit error. | true: enables generation of an internal reset when the error occurs from BIST code ECC 2-bit error. false: disables generation of an internal reset when the error occurs from BIST code ECC 2-bit error.
          boolean McuEcmErrorNMIDelayTimer: set at post-build, origin=Renesas_v1.0.0, default-value=false  # This parameter enables or disables delay timer start caused by non-maskable interrupts in response to errors from BIST code ECC 2-bit error. | true: enables delay timer start caused by non-maskable interrupts in response to errors from BIST code ECC 2-bit error. false: disables delay timer start caused by non-maskable interrupts in response to errors from BIST code ECC 2-bit error.
          boolean McuEcmErrorMIDelayTimer: set at post-build, origin=Renesas_v1.0.0, default-value=false  # This parameter enables or disables delay timer start caused by maskable interrupts in response to errors from BIST code ECC 2-bit error. | true: enables delay timer start caused by maskable interrupts in response to errors from BIST code ECC 2-bit error. false: disables delay timer start caused by maskable interrupts in response to errors from BIST code ECC 2-bit error.
          boolean McuEcmErrorOutputMask: set at post-build, origin=Renesas_v1.0.0, default-value=true  # This parameter mask or unmask the individual error sources of the error pin output from BIST code ECC 2-bit error. | true: mask the individual error sources of the error pin output from BIST code ECC 2-bit error. false: unmask the individual error sources of the error pin output from BIST code ECC 2-bit error.
          function name McuMiNotification [0..1]: set at post-build, origin=Renesas_v1.0.0, default-value=NULL_PTR, regular-expression=[a-zA-Z][a-zA-Z0-9_]*  # This parameter contains notification function for MI notification. | The syntax for McuMiNotification should be provided as Mcu_EcmMINotification.
          function name McuNmiNotification [0..1]: set at post-build, origin=Renesas_v1.0.0, default-value=NULL_PTR, regular-expression=[a-zA-Z][a-zA-Z0-9_]*  # This parameter contains notification function for NMI notification. | The syntax for McuNmiNotification should be provided as Mcu_EcmNMINotification.
        container McuEcmErrorSource42  # This container contains all the supported configuration parameters of the related error source from FACI reset transfer error.
          boolean McuEcmErrorMaskableInterrupt: set at post-build, origin=Renesas_v1.0.0, default-value=false  # This parameter enables or disables generation of a maskable interrupt when the error occurs from FACI reset transfer error. | true: enables generation of a maskable interrupt when the error occurs from FACI reset transfer error. false: disables generation of a maskable interrupt when the error occurs from FACI reset transfer error.
          boolean McuEcmErrorNonMaskableInterrupt: set at post-build, origin=Renesas_v1.0.0, default-value=false  # This parameter enables or disables generation of a non-maskable interrupt when the error occurs from FACI reset transfer error. | true: enables generation of a non-maskable interrupt when the error occurs from FACI reset transfer error. false: disables generation of a non-maskable interrupt when the error occurs from FACI reset transfer error.
          boolean McuEcmErrorInternalReset: set at post-build, origin=Renesas_v1.0.0, default-value=false  # This parameter enables or disables generation of an internal reset when the error occurs from FACI reset transfer error. | true: enables generation of an internal reset when the error occurs from FACI reset transfer error. false: disables generation of an internal reset when the error occurs from FACI reset transfer error.
          boolean McuEcmErrorNMIDelayTimer: set at post-build, origin=Renesas_v1.0.0, default-value=false  # This parameter enables or disables delay timer start caused by non-maskable interrupts in response to errors from FACI reset transfer error. | true: enables delay timer start caused by non-maskable interrupts in response to errors from FACI reset transfer error. false: disables delay timer start caused by non-maskable interrupts in response to errors from FACI reset transfer error.
          boolean McuEcmErrorMIDelayTimer: set at post-build, origin=Renesas_v1.0.0, default-value=false  # This parameter enables or disables delay timer start caused by maskable interrupts in response to errors from FACI reset transfer error. | true: enables delay timer start caused by maskable interrupts in response to errors from FACI reset transfer error. false: disables delay timer start caused by maskable interrupts in response to errors from FACI reset transfer error.
          boolean McuEcmErrorOutputMask: set at post-build, origin=Renesas_v1.0.0, default-value=true  # This parameter mask or unmask the individual error sources of the error pin output from FACI reset transfer error. | true: mask the individual error sources of the error pin output from FACI reset transfer error. false: unmask the individual error sources of the error pin output from FACI reset transfer error.
          function name McuMiNotification [0..1]: set at post-build, origin=Renesas_v1.0.0, default-value=NULL_PTR, regular-expression=[a-zA-Z][a-zA-Z0-9_]*  # This parameter contains notification function for MI notification. | The syntax for McuMiNotification should be provided as Mcu_EcmMINotification.
          function name McuNmiNotification [0..1]: set at post-build, origin=Renesas_v1.0.0, default-value=NULL_PTR, regular-expression=[a-zA-Z][a-zA-Z0-9_]*  # This parameter contains notification function for NMI notification. | The syntax for McuNmiNotification should be provided as Mcu_EcmNMINotification.
        container McuEcmErrorSource129  # This container contains all the supported configuration parameters of the related error source for ecm delay timer overflow.
          boolean McuEcmErrorInternalReset: set at post-build, origin=Renesas_v1.0.0, default-value=false  # This parameter enables or disables generation of an internal reset when the ecm delay timer overflow error occurs. | true: enables generation of an internal reset when the ecm delay timer overflow error occurs. false: disables generation of an internal reset when the ecm delay timer overflow error occurs.
          boolean McuEcmErrorOutputMask: set at post-build, origin=Renesas_v1.0.0, default-value=true  # This parameter mask or unmask the individual error sources of the error pin output when the ecm delay timer overflow error occurs. | true: mask the individual error sources of the error pin output when the ecm delay timer overflow error occurs. false: unmask the individual error sources of the error pin output when the ecm delay timer overflow error occurs.
      container McuDemEventParameterRefs  # Container for the references to DemEventParameter elements which shall be invoked using the API Dem_ReportErrorStatus API in case the corresponding error occurs. The EventId is taken from the referenced DemEventParameter's DemEventId value. The standardized errors are provided in the container and can be extended by vendor specific error references.
        symbolic name reference MCU_E_CLOCK_FAILURE: set at pre-compile, destination=DemEventParameter  # Reference to configured DEM event to report "Clock source failure".
        symbolic name reference MCU_E_WRITE_TIMEOUT_FAILURE: set at pre-compile, origin=Renesas_v1.0.0, destination=DemEventParameter  # Reference to configured DEM event to report "write failure".
        symbolic name reference MCU_E_CVM_SELFDIAG_FAILURE [0..1]: set at pre-compile, origin=Renesas_v1.0.0, destination=DemEventParameter  # Reference to configured DEM event to report "CVM self diagnostic failure".
        symbolic name reference MCU_E_CLM_SELFDIAG_FAILURE [0..1]: set at pre-compile, origin=Renesas_v1.0.0, destination=DemEventParameter  # Reference to configured DEM event to report "CLM self diagnostic failure".
        symbolic name reference MCU_E_ECM_SELFDIAG_FAILURE [0..1]: set at pre-compile, origin=Renesas_v1.0.0, destination=DemEventParameter  # Reference to configured DEM event to report "ECM self diagnostic failure".
        symbolic name reference MCU_E_LOCKSTEP_SELFDIAG_FAILURE [0..1]: set at pre-compile, origin=Renesas_v1.1.1, destination=DemEventParameter  # Reference to configured DEM event to report "LockStep self diagnostic failure".
      container McuModeSettingConf  # This container contains the configuration (parameters) for the Mode setting of the MCU. Please see MCU035 for more information on the MCU mode settings. This container is not used for implementation.
        enumeration McuModeType: {RUN_MODE}, set at pre-compile, origin=Renesas_v1.0.0, default-value=RUN_MODE  # This parameter contains the power save mode type. The value for this parameter should not be repeated within same configuration set. | RUN_MODE: under power and running.
        integer McuMode: 0..0, set at pre-compile, symbolic-name-value=true, default-value=0  # The parameter represents the MCU Mode settings.
      container McuRamSectorSettingConf [0..*]  # This container contains the configuration (parameters) for the RAM Sector setting. Please see MCU030 for more information on RAM sector settings.
        integer McuRamDefaultValue: 0..255, set at post-build, default-value=255  # This parameter specifies the data to be filled in the memory location while invoking Mcu_InitRamSection.
        integer McuRamSectionBaseAddress: 4273864704..4273995775, set at post-build, default-value=4273864704  # This parameter shall represent the MCU RAM section base address. For LOCAL RAM 128KB having address range 4273864704 to 4273995775.
        integer McuRamSectionSize: 1..131072, set at post-build, default-value=256  # This parameter shall represent the MCU RAM Section size in bytes. For LOCAL RAM 128KB having range 1 to 131072.
        enumeration McuRamTypeSel: {LOCAL_RAM_4273864704_4273995775}, set at post-build, origin=Renesas_v1.0.0, default-value=LOCAL_RAM_4273864704_4273995775  # This parameter contains the RAM selection type. | LOCAL_RAM_4273864704_4273995775: For Local Ram.
