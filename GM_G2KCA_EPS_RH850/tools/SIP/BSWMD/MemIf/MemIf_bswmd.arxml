AUTOSAR XML (schema 4-0-3)
package /MICROSAR
  module definition MemIf [0..1]: category=VENDOR_SPECIFIC_MODULE_DEFINITION, refined-module-def=MemIf, variants pre-compile  # Configuration of the MemIf (Memory Abstraction Interface) module.
    container MemIfGeneral  # MemIf General | General configuration parameters of the MemIf.
      boolean MemIfDevErrorDetect: set at pre-compile, default-value=true  # Development Error Detection | This parameter switches the Development Error Detection and Notification ON or OFF. true: Development error detection is enabled. false: Development error detection is disabled. Note: In general, the development error detection is recommended during pre-test phase. It is not recommended to enable the development error detection in production code due to increased runtime and ROM needs. | true: Development error detection enabled. false: Development error detection disabled.
      integer MemIfNumberOfDevices [0..1]: 1..255, set at pre-compile, default-value=1  # Number of devices | Not used! This value specifies the concrete number of underlying memory abstraction modules. | Calculation Formula: Count number of configured EA and FEE modules.
      boolean MemIfVersionInfoApi: set at pre-compile, default-value=false  # Version Info Api | This parameter enables/disables the function MemIf_GetVersionInfo() to get major, minor and patch version information. | true: Version info API enabled. false: Version info API disabled.
      container MemIfDevErrorChecks  # Development Error Checks | This container includes additional configuration items for the development error detection.
        string MemIfCfgIncludeDet: set at pre-compile, origin=Vector Informatik, default-value=Det.h  # Det Include File | This parameter defines the header include file of the Errorhook function for development error reporting.
        boolean MemIfDevErrorReport: set at pre-compile, origin=Vector Informatik, default-value=true  # Development Error Reporting | This parameter defines if development error reporting is enabled.
        string MemIfErrorhook: set at pre-compile, origin=Vector Informatik, default-value=Det_ReportError  # Det Error Hook | This parameter defines the Errorhook function for development error reporting.
    container MemIfMemHwA [1..16]  # Memory Hardware Abstraction | This container includes the configuration of one underlaying Memory Hardware Abstraction module.
      integer MemIfMemHwAId: 0..254, set at pre-compile, origin=Vector Informatik, symbolic-name-value=true, default-value=0  # Memory Hardware Abstraction Id | This value specifies the unique handle to address the underlaying Memory Hardware Abstraction module.
      choice reference MemIfMemHwARef: set at pre-compile, origin=Vector Informatik, destination=[FeeGeneral, EaGeneral]  # Reference to Fee / Ea | Reference to the underlaying Memory Hardware Abstraction module (FEE or EA).
      container MemIfMemHwAAPI [0..1]  # Memory Hardware Abstraction API | Container for API names of memory hardware abstraction device
        function name MemIfMemHwACancel: set at pre-compile, origin=Vector Informatik, default-value=Fee_Cancel  # Cancel API | Determines the API service name of the FEE / EA which is used to cancel a current job.
        string MemIfMemHwACbkIncludeFile: set at pre-compile, origin=Vector Informatik, default-value=Fee_Cbk.h  # Callback Include File | Determines the callback include file of the FEE / EA which declares the callback service names.
        function name MemIfMemHwAEraseImmediateBlock: set at pre-compile, origin=Vector Informatik, default-value=Fee_EraseImmediateBlock  # EraseImmediate API | Determines the API service name of the FEE / EA which is used to erase a block which is configured to hold high priority data.
        function name MemIfMemHwAGetJobResult: set at pre-compile, origin=Vector Informatik, default-value=Fee_GetJobResult  # GetJobResult API | Determines the API service name of the FEE / EA which is used to get the result of the last requested job.
        function name MemIfMemHwAGetStatus: set at pre-compile, origin=Vector Informatik, default-value=Fee_GetStatus  # GetStatus API | Determines the API service name of the FEE / EA which is used to get the current status of the FEE / EA.
        string MemIfMemHwAIncludeFile: set at pre-compile, origin=Vector Informatik, default-value=Fee.h  # Include File | Determines the include file of the FEE / EA which declares the API service names.
        function name MemIfMemHwAInvalidateBlock: set at pre-compile, origin=Vector Informatik, default-value=Fee_InvalidateBlock  # InvalidateBlock API | Determines the API service name of the FEE / EA which is used to invalidate a block.
        function name MemIfMemHwARead: set at pre-compile, origin=Vector Informatik, default-value=Fee_Read  # Read API | Determines the API service name of the FEE / EA which is used to read data.
        function name MemIfMemHwASetMode: set at pre-compile, origin=Vector Informatik, default-value=Fee_SetMode  # SetMode API | Determines the API service name of the FEE / EA which is used to set the mode.
        function name MemIfMemHwAWrite: set at pre-compile, origin=Vector Informatik, default-value=Fee_Write  # Write API | Determines the API service name of the FEE / EA which is used to write data.
  bsw implementation MemIf_Impl: programming-language=C, sw-version=3.01.00, used-code-generator=DaVinci Configurator, vendor-id=30, ar-release-version=4.00.03, preconfigured-configuration=MemIf_Pre, recommended-configuration=MemIf_Rec, vendor-specific-module-def=MemIf
  module config MemIf_Pre: definition=MemIf
  module config MemIf_Rec: definition=MemIf
