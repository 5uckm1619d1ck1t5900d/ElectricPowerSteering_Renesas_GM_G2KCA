AUTOSAR XML (schema 4-0-3)
package /MICROSAR
  module definition NvM [0..1]: category=VENDOR_SPECIFIC_MODULE_DEFINITION, refined-module-def=NvM, variants pre-compile  # Configuration of the NvM (NvRam Manager) module.
    container NvMBlockDescriptor [1..65536]  # This container includes the configuration of one NVM block. At least one block is required to be configured. The NVRAM block descriptors are condensed in the NVRAM block descriptor table.
      enumeration NvMBlockCrcType [0..1]: {NVM_CRC16, NVM_CRC32}, set at pre-compile, default-value=NVM_CRC16  # Crc Type | This parameter defines CRC data width for the NVRAM block. Hint: The parameter is only applicable if (NvMBlockUseCrc == true).
      integer NvMBlockJobPriority: 0..255, set at pre-compile, default-value=127  # Priority | This value specifies the job priority for a NVRAM block (0 = Immediate priority).
      enumeration NvMBlockManagementType: {NVM_BLOCK_DATASET, NVM_BLOCK_NATIVE, NVM_BLOCK_REDUNDANT}, set at pre-compile, default-value=NVM_BLOCK_NATIVE  # Management Type | Defines the block management type for the NVRAM block. NVM_BLOCK_DATASET: NVRAM block is configured to be of dataset type. The application has to decide which of the n data set is handled. NVM_BLOCK_NATIVE: NVRAM block is configured to be of native type. The data is stored at one position. NVM_BLOCK_REDUNDANT : NVRAM block is configured to be of redundant type. The data is stored twice. If reading the first element fails, the modules automatically tries to read the second element.
      boolean NvMBlockUseCrc: set at pre-compile, default-value=false  # Crc usage | This parameter defines if CRC usage for the NVRAM block is enabled. Hint: The type of CRC has to be configured in NvMBlockCrcType. | true: CRC will be used for this NVRAM block. false: CRC will not be used for this NVRAM block.
      boolean NvMBlockUseSyncMechanism: set at pre-compile, default-value=false  # Use Synchronization Mechanism | This parameter defines whether an explicit synchronization mechanism with a RAM mirror and callback routines for transferring data to and from NvM module's RAM mirror is used for this block. If used, both, NvMReadRamBlockFromNvCallback and NvMWriteRamBlockToNvCallback must be set to names of appropriate functions.
      boolean NvMBlockWriteProt: set at pre-compile, default-value=false  # Write Protection | This parameter defines the initial write protection of the NV block. true: Initial block write protection is enabled. false: Initial block write protection is disabled. | true: Initial block write protection is enabled. false: Initial block write protection is disabled.
      boolean NvMBswMBlockStatusInformation: set at pre-compile, default-value=false  # Block Status Information | This parameter defines whether BswM is informed about the current status of this block. | True: Call BswM_NvM_CurrentBlockMode on changes False: Don&rsquo;t inform BswM at all
      boolean NvMCalcRamBlockCrc [0..1]: set at pre-compile, default-value=false  # Calculate Ram Block Crc | This parameter defines CRC (re)calculation for the permanent RAM block. true: CRC will be (re)calculated for this permanent RAM block. false: CRC will not be (re)calculated for this permanent RAM block. | true: CRC will be (re)calculated for this permanent RAM block. false: CRC will not be (re)calculated for this permanent RAM block.
      function name NvMInitBlockCallback: set at pre-compile, default-value=NULL_PTR  # Init Block Callback | This parameter defines the block specific callback routine which shall be called if no ROM data is available for initialization of the NVRAM block. If a NULL pointer is configured, no specific callback routine shall be called for initialization of the NVRAM block with default data. | If not configured, no specific callback routine shall be called for initialization of the NVRAM block with default data.
      integer NvMMaxNumOfReadRetries [0..1]: 0..7, set at pre-compile, default-value=0  # Maximum number of read retries | Not used! This parameter defines the maximum number of read retries.
      integer NvMMaxNumOfWriteRetries [0..1]: 0..7, set at pre-compile, default-value=0  # Maximum number of write retries | Not used! This parameter defines the maximum number of write retries for a NVRAM block
      integer NvMNvBlockBaseNumber [0..1]: 1..65534, set at pre-compile  # Block Base Number | Not Used! This value specifies the link between the NVM_NVRAM_BLOCK_IDENTIFIER used by the SW-Cs and the FEE_BLOCK_NUMBER expected by the memory abstraction modules. The parameter value equals the FEE_BLOCK_NUMBER or EA_BLOCK_NUMBER shifted to the right by NvMDatasetSelectionBits bits. | Calculation Formula: value = TargetBlockReference.[Ea/Fee]BlockConfiguration.[Ea/Fee]BlockNumber >> NvMDatasetSelectionBits
      integer NvMNvBlockLength: 1..65535, set at pre-compile, default-value=1  # Block Length | This value specifies the NV block data length. Hint: If a NvMRamBlockDataAddress or NvMRomBlockDataAddress is given for this block, the length given here has to match exactly the variable sizes. | Note: The implementer can add the attribute 'withAuto' to the parameter definition which indicates that the length can be calculated by the generator automatically (e.g. by using the sizeof operator). When 'withAuto' is set to 'true' for this parameter definition the 'isAutoValue' can be set to 'true'. If 'isAutoValue' is set to 'true' the actual value will not be considered during ECU Configuration but will be (re-)calculated by the code generator and stored in the value attribute afterwards.
      integer NvMNvBlockNum: 1..255, set at pre-compile, default-value=1  # Datasets | This value specifies the number of multiple NV blocks in a contiguous area according to the given block management type. 1-255 For NVRAM blocks to be configured of block management type NVM_BLOCK_DATASET. The actual range is limited according to NVM148. 1 For NVRAM blocks to be configured of block management type NVM_BLOCK_NATIVE 2 For NVRAM blocks to be configured of block management type NVM_BLOCK_REDUNDANT | 1-255 For NVRAM blocks to be configured of block management type NVM_BLOCK_DATASET. The actual range is limited according to NVM444. 1 For NVRAM blocks to be configured of block management type NVM_BLOCK_NATIVE 2 For NVRAM blocks to be configured of block management type NVM_BLOCK_REDUNDANT
      integer NvMNvramBlockIdentifier: 1..65535, set at pre-compile, symbolic-name-value=true, default-value=2  # Block Identifier | This value specifies the identification of a NVRAM block via a unique block identifier. Implementation Type: NvM_BlockIdType. min = 0 max = 2^(16- NVM_DATASET_SELECTION_BITS)-1 Reserved NVRAM block IDs: 0 -> to derive multi block request results via NvM_GetErrorStatus 1 -> redundant NVRAM block which holds the configuration ID | Implementation Type: NvM_BlockIdType. min = 2 max = 2^(16- NVM_DATASET_SELECTION_BITS)-1 Reserved NVRAM block IDs: 0 -> to derive multi block request results via NvM_GetErrorStatus 1 -> redundant NVRAM block which holds the configuration ID
      integer NvMNvramDeviceId [0..1]: 0..254, set at pre-compile  # Device Id | Not used! This value specifies the NVRAM device ID where the NVRAM block is located. Calculation Formula: "value = TargetBlockReference.[Ea/Fee]BlockConfiguration.[Ea/Fee]DeviceIndex" | Calculation Formula: value = TargetBlockReference.[Ea/Fee]BlockConfiguration.[Ea/Fee]DeviceIndex
      string NvMRamBlockDataAddress: set at pre-compile, default-value=NULL_PTR  # Ram Block Data | This parameter defines the variable name of the RAM block data. If a NULL pointer is configured, no permanent RAM data block is available for this block. | If this is not configured, no permanent RAM data block is available for the selected block management type.
      function name NvMReadRamBlockFromNvCallback: set at pre-compile, default-value=NULL_PTR  # Read Ram Block From Nv Callback | This parameter defines the block specific callback routine which shall be called in order to let the application copy data from the NvM module's mirror to RAM block. | Implementation type: Std_ReturnType E_OK: copy was successful E_NOT_OK: copy was not successful, callback routine to be called again
      boolean NvMResistantToChangedSw: set at pre-compile, default-value=true  # Resistant To Changed Software | This parameter defines whether a NVRAM block shall be treated resistant to configuration changes or not. If there is no default data available at configuration time then the application shall be responsible for providing the default initialization data. In this case the application has to use NvM_GetErrorStatus() to be able to distinguish between first initialization and corrupted data. | true: NVRAM block is resistant to changed software. false: NVRAM block is not resistant to changed software.
      string NvMRomBlockDataAddress: set at pre-compile, default-value=NULL_PTR  # Rom Block Data | This parameter defines the variable name of the ROM block data. If a NULL pointer is configured, no ROM block is available for this block. | If not configured, no ROM block is available for the selected block management type.
      integer NvMRomBlockNum [0..1]: 0..255, set at pre-compile, default-value=0  # Rom Block Number | Not Used! This value specifies the number of multiple ROM blocks in a contiguous area according to the given block management type. 0-255 For NVRAM blocks to be configured of block management type NVM_BLOCK_DATASET. The actual range is limited according to NVM148. 0-1 For NVRAM blocks to be configured of block management type NVM_BLOCK_NATIVE 0-1 For NVRAM blocks to be configured of block management type NVM_BLOCK_REDUNDANT | 0-255 For NVRAM blocks to be configured of block management type NVM_BLOCK_DATASET. The actual range is limited according to NVM444. 0-1 For NVRAM blocks to be configured of block management type NVM_BLOCK_NATIVE 0-1 For NVRAM blocks to be configured of block management type NVM_BLOCK_REDUNDANT
      boolean NvMSelectBlockForReadAll: set at pre-compile, default-value=true  # Select Block For ReadAll | This parameter defines whether the NVRAM block shall be processed during NvM_ReadAll or not. This configuration parameter has only influence on those NVRAM blocks which are configured to have a permanent RAM block. | true: NVRAM block shall be processed by NvM_ReadAll false: NVRAM block shall not be processed by NvM_ReadAll
      boolean NvMSelectBlockForWriteAll: set at pre-compile, default-value=true  # Select Block For WriteAll | This parameter defines whether the NVRAM block shall be processed during NvM_WriteAll or not. This configuration parameter has only influence on those NVRAM blocks which are configured to have a permanent RAM block. | true: NVRAM block shall be processed by NvM_WriteAll false: NVRAM block shall not be processed by NvM_WriteAll
      function name NvMSingleBlockCallback: set at pre-compile, default-value=NULL_PTR  # Single Block Callback | This parameter defines the block specific callback routine which shall be invoked on termination of each asynchronous single block request. Does not care, if "Use Job End Callback" was disabled, or if "Use Service Ports" was enabled (then the name is derived automatically).
      boolean NvMStaticBlockIDCheck [0..1]: set at pre-compile, default-value=false  # Static Block Id Check | Not used! This parameter defines if the Static Block ID check is enabled. | false: Static Block ID check is disabled. true: Static Block ID check is enabled.
      boolean NvMWriteBlockOnce: set at pre-compile, default-value=false  # Write Block Once | This parameter defines if write protection after first write is enabled. The NVRAM manager sets the write protection bit after the NV block was written the first time. This means that some of the NV blocks in the NVRAM should never be erased nor be replaced with the default ROM data after first initialization. | true: Defines write protection after first write is enabled. false: Defines write protection after first write is disabled.
      function name NvMWriteRamBlockToNvCallback: set at pre-compile, default-value=NULL_PTR  # Write Ram Block To Nv Callback | This parameter defines the block specific callback routine which shall be called in order to let the application copy data from RAM block to NvM module's mirror. | Implementation type: Std_ReturnType E_OK: copy was successful E_NOT_OK: copy was not successful, callback routine to be called again
      boolean NvMWriteVerification [0..1]: set at pre-compile, default-value=false  # Write Verification | Not used! This parameter defines if Write Verification is enabled. | false: Write verification is disabled. true: Write Verification is enabled.
      integer NvMWriteVerificationDataSize [0..1]: 1..65536, set at pre-compile, default-value=1  # Write Verification Data Size | Not used! This value specifies the number of bytes to compare in each step when comparing the content of a RAM Block and a block read back.
      boolean NvMUseServicePorts: set at pre-compile, origin=Vector Informatik, default-value=false  # Use Service Ports | This parameter defines if this block is accessible via service ports. The PortName will be derived from the block name.
      boolean NvMUseJobendCallback: set at pre-compile, origin=Vector Informatik, default-value=true  # Use Job End Callback | This parameter defines whether the block specific "Single Block Job End Notification" shall be invoked upon completion of block processing. If enabled, the name of the function must be specified in "Single Block Callback", unless "Use Service Ports" was enabled (then the name is derived automatically).
      boolean NvMUseInitCallback: set at pre-compile, origin=Vector Informatik, default-value=false  # Use Init Callback | This parameter defines if the configured Init Callback is used to provide default data. Note: Since the initialization status of the RTE during ReadAll processing is currently unclear (according to AUTOSAR it is not initialized), the init callback cannot be used by SW-Cs via RTE - the setting will be ignored.
      choice container NvMTargetBlockReference  # Target Block Reference | This container either includes configuration of a reference to an EA or FEE block.
        container NvMEaRef [0..1]  # Ea Reference | This container includes the reference to an EEPROM Abstraction block.
          symbolic name reference NvMNameOfEaBlock: set at pre-compile, destination=EaBlockConfiguration  # Name of Ea Block | Reference to one block in the EA configuration.
        container NvMFeeRef [0..1]  # Fee Reference | This container includes the reference to a FEE block.
          symbolic name reference NvMNameOfFeeBlock: set at pre-compile, destination=FeeBlockConfiguration  # Name Of Fee Block | Reference to one block in the FEE configuration.
    container NvMCommon  # This container includes the common configuration options.
      enumeration NvMApiConfigClass: {NVM_API_CONFIG_CLASS_1, NVM_API_CONFIG_CLASS_2, NVM_API_CONFIG_CLASS_3}, set at pre-compile, default-value=NVM_API_CONFIG_CLASS_3  # API Configuration Class | This parameter defines the API configuration class.
      boolean NvMBswMMultiBlockJobStatusInformation: set at pre-compile, default-value=false  # Multiblock Job Status Information | This parameter defines whether BswM is informed about the current status of the multi block job. | True: call BswM_NvM_CurrentJobMode if ReadAll and WriteAll are started, finished, canceled False: do not inform BswM at all
      integer NvMCompiledConfigId: 0..65535, set at pre-compile, default-value=1  # Compiled Configuration Id | This value specifies the Configuration ID regarding the NV memory layout. This configuration ID shall be published as e.g. a SW-C shall have the possibility to write it to NV memory.
      integer NvMCrcNumOfBytes: 1..65535, set at pre-compile, default-value=64  # Crc Number of Bytes | This parameter defines the maximum number of bytes which shall be processed within one single NvM_MainFunctionCall for CRC calculation as well as for internal copy operations. Therefore this parameter has influence on maximum duration of NvM_MainFucntion, hence it also influences the setting of "Call Cycle of NvM_MainFunction" (NvMMainFunctionPeriod). In general, smaller values of "Crc Number of Bytes" allow smaller (faster) call cycles, and vice versa. Note that one NvM_MainFunction call may perform two CRC calculations of "Crc Number of Bytes". Additionally an internal copy operation (performed instead of a CRC calculation) processes more bytes (because copying step requires less CPU-instructions than CRC clacluation).
      integer NvMDatasetSelectionBits: 0..8, set at pre-compile, default-value=4  # Dataset Selection Bits | This value specifies the number of least significant bits which shall be used to address a certain dataset of a NVRAM block within the interface to the memory hardware abstraction. 0..8: Number of bits which are used for dataset or redundant block addressing. 0: No dataset or redundant NVRAM blocks are configured at all, no selection bits required. 1: In case of redundant NVRAM blocks are configured, but no dataset NVRAM blocks. | 0..8: Number of bits which are used for dataset or redundant block addressing. 0: No dataset or redundant NVRAM blocks are configured at all, no selection bits required. 1: In case of redundant NVRAM blocks are configured, but no dataset NVRAM blocks.
      boolean NvMDevErrorDetect: set at pre-compile, default-value=true  # Development Error Detection | This parameter switches the Development Error Detection and Notification ON or OFF. true: Development error detection is enabled. false: Development error detection is disabled. Note: In general, the development error detection is recommended during pre-test phase. It is not recommended to enable the development error detection in production code due to increased runtime and ROM needs. | true: Development error detection enabled. false: Development error detection disabled.
      boolean NvMDrvModeSwitch: set at pre-compile, default-value=true  # Drivers Mode Switch | This parameter defines switching memory drivers to fast mode during performing NvM_ReadAll and NvM_WriteAll. true: Fast mode enabled. false: Fast mode disabled. | true: Fast mode enabled. false: Fast mode disabled.
      boolean NvMDynamicConfiguration: set at pre-compile, default-value=false  # Dynamic Configuration Handling | This parameter defines to enable the dynamic configuration management handling by the NvM_ReadAll request. true: Dynamic configuration management handling enabled. false: Dynamic configuration management handling disabled. | true: Dynamic configuration management handling enabled. false: Dynamic configuration management handling disabled.
      boolean NvMJobPrioritization: set at pre-compile, default-value=false  # Job Prioritization | This parameter defines if job prioritization handling is enabled. true: Job prioritization handling enabled. false: Job prioritization handling disabled. | true: Job prioritization handling enabled. false: Job prioritization handling disabled.
      function name NvMMultiBlockCallback: set at pre-compile, default-value=NULL_PTR  # Multi Block Callback | This parameter defines the common callback routine which shall be invoked on termination of each asynchronous multi block request.
      boolean NvMPollingMode: set at pre-compile, default-value=true  # Polling Mode | This parameter defines if the polling mode in the NVRAM Manager is enabled. At the same time the callback functions useable by lower layers is disabled. true: Polling mode enabled, callback function usage disabled. false: Polling mode disabled, callback function usage enabled. | true: Polling mode enabled, callback function usage disabled. false: Polling mode disabled, callback function usage enabled.
      integer NvMRepeatMirrorOperations [0..1]: 0..7, set at pre-compile, default-value=0  # Repeat Mirror Operations | Not used! This value specifies the number of retries to let the application copy data to or from the NvM module's mirror before postponing the current job.
      boolean NvMSetRamBlockStatusApi: set at pre-compile, default-value=true  # SetRamBlockStatus API | This parameter defines if API NvM_SetRamBlockStatus is available. true: API NvM_SetRamBlockStatus enabled. false: API NvM_SetRamBlockStatus disabled. | true: API NvM_SetRamBlockStatus enabled. false: API NvM_SetRamBlockStatus disabled.
      integer NvMSizeImmediateJobQueue [0..1]: 1..255, set at pre-compile, default-value=1  # Size Of Immediate Job Queue | This value specifies the number of queue entries for the immediate priority job queue. Hint: If (NvMJobPrioritization == false) this parameter is ignored.
      integer NvMSizeStandardJobQueue: 1..255, set at pre-compile, default-value=8  # Size Of Standard Job Queue | This value specifies the number of queue entries for the standard job queue.
      boolean NvMVersionInfoApi: set at pre-compile, default-value=false  # Version Information API | This parameter enables/disables the function NvM_GetVersionInfo() to get major, minor and patch version information. | true: Version info API enabled. false: Version info API disabled.
      integer NvMMaxNoOfWriteRetries: 0..7, set at pre-compile, origin=Vector Informatik, default-value=1  # Maximum Number of Write Retries | This value specifies the maximum number of write retries for a NVRAM block. Regardless of configuration a consistency check and write retries are always forced for each block which is processed by the request NvM_WriteAll and NvM_WriteBlock.
      float NvMMainFunctionPeriod: 0.001..1, set at pre-compile, origin=Vector Informatik, default-value=0.01  # Call Cycle of NvM_MainFunction | Specify fixed call cycle for NvM_MainFunction. This information affects RTE's (SchM's) settings. NVM itself does not depend on a fixed cycle time; in can be triggered at arbitrary rates. It is not necessary to rigger NVM faster than its lower layers (FEE/EA and FLS/EEP). Also consider NvMCrcNumOf Bytes, which limits the maximim MainFunction processing times during CRC Calculation as well as internal copie operations. The faster you want NvM_MainFunction being triggered, the smaller this value should be and vice versa. Note, that notifcation functions may arbitrarily extend NvM_MainFunction's maximum duration. This is an issue especially for init callbacks as well as for explicit synchronization callbacks, as they would have to process a block at once.
      boolean NvMUseBlockIdCheck: set at pre-compile, origin=Vector Informatik, default-value=false  # Use Block Id Check for Blocks with Crc | If enabled, the NvM checks the data, delivered via underlying modules, to belong to the requested NvM Block. Since the NvM uses the Crc, this is only working for Blocks configured with Crc! If there is no Block with Crc, this feature will remain unused!
      boolean NvMRepairRedundantBlocksApi: set at pre-compile, origin=Vector Informatik, default-value=false  # Repair Redundant Blocks Api | Enables the NvM background job "Repair Redundant Blocks", which iterates over all configured redundant blocks and checks their redundancy within the NV RAM. If the redundancy is lost, the job will try to repair it.
    container NvmDemEventParameterRefs [0..1]  # This container includes references to DemEventParameter elements which shall be invoked using the API Dem_ReportErrorStatus API in case the corresponding error occurs. The EventId is taken from the referenced DemEventParameter's DemEventId value.
      symbolic name reference NVM_E_INTEGRITY_FAILED [0..1]: set at pre-compile, destination=DemEventParameter  # Reference to the DemEventParameter which shall be issued when the error "API request integrity failed" has occurred.
      symbolic name reference NVM_E_LOSS_OF_REDUNDANCY [0..1]: set at pre-compile, destination=DemEventParameter  # Reference to the DemEventParameter which shall be issued when the error "loss of redundancy" has occurred.
      symbolic name reference NVM_E_QUEUE_OVERFLOW [0..1]: set at pre-compile, destination=DemEventParameter  # Reference to the DemEventParameter which shall be issued when the error "NVRAM Managers job queue overflow" has occurred.
      symbolic name reference NVM_E_REQ_FAILED [0..1]: set at pre-compile, destination=DemEventParameter  # Reference to the DemEventParameter which shall be issued when the error "API request failed" has occurred.
      symbolic name reference NVM_E_VERIFY_FAILED [0..1]: set at pre-compile, destination=DemEventParameter  # Reference to the DemEventParameter which shall be issued when the error "Write Verification failed" has occurred.
      symbolic name reference NVM_E_WRITE_PROTECTED [0..1]: set at pre-compile, destination=DemEventParameter  # Reference to the DemEventParameter which shall be issued when the error "write attempt to NVRAM block with write protection" has occurred.
      symbolic name reference NVM_E_WRONG_BLOCK_ID [0..1]: set at pre-compile, destination=DemEventParameter  # Reference to the DemEventParameter which shall be issued when the error "Static Block ID check failed" has occurred.
    container NvMCommonVendorParams  # Common Vendor Parameter | This container includes Vector specific Module Configuration Parameters.
      string NvMCfgIncludeDem [0..1]: set at published-information, origin=Vector Informatik, default-value=Dem.h  # Dem Include File | This parameter defines the name of the header file containing the defines, variables, types and functions of the DEM.
      function name NvMSeterror [0..1]: set at published-information, origin=Vector Informatik, default-value=Dem_ReportErrorStatus  # Dem Error Hook | This parameter defines the DEM's error reporting function: void <Name>(Dem_EventIdType EventId, DemEventStatusType EventStatus).
      string NvMCfgCbkIncludeList [0..*]: set at pre-compile, origin=Vector Informatik, default-value=Application.h  # Callback Include File List | This parameter contains the header file(s) declaring the call back functions, and the blocks' symbol declarations, i.e. the multi block callback the single block call backs, the block init callbacks, the ram block symbols as well as the rom block symbols.
      string NvMMultiblockId: set at pre-compile, origin=Vector Informatik, default-value=MultiBlockRequest  # Multiblock Id | This parameter defines the symbolic name of the multi block ID (Block Id 0).
      boolean NvMCrcIntBuffer: set at pre-compile, origin=Vector Informatik, default-value=true  # Crc Internal Buffer | This paremter defines if the CRC Buffer is module internally. true: The NVM provides the buffer for the CRC value internally. Memory for CRC must not be allocated at the end of Ram Block variable. false: The NVM does not provide the buffer for the CRC value.. Memory for CRC at the end of Ram Block variable is necessary!
      boolean NvMKillWriteAllApi: set at pre-compile, origin=Vector Informatik, default-value=true  # Kill WriteAll API | This parameter defines if the API NvM_KillWriteAll is available. The API gives users (i.e. EcuM) the possibility to time-out WriteAll cancellation (NvM_CancelWriteAll).
      container NvMDevErrorChecks [0..1]  # Development Error Checks | This container includes additional configuration items for the development error detection.
        boolean NvMCfgChkStatusUninit: set at pre-compile, origin=Vector Informatik, default-value=true  # Uninitialization Check | This parameter defines if the module uninitialization is enabled.
        boolean NvMCfgChkRomBlockLengths: set at pre-compile, origin=Vector Informatik, default-value=true  # Rom Block Length Check | This parameter defines if ROM Blocks' Lengths are checked at startup during NvM_Init(), using the sizeof operator. Related DET Error Code: NVM_E_RAM_BLOCK_LENGTH
        boolean NvMCfgChkRamBlockLengths: set at pre-compile, origin=Vector Informatik, default-value=true  # Ram Block Length Check | This parameter defines if RAM Blocks' Lengths are checked at startup during NvM_Init(), using the sizeof operator. Related DET Error Code: NVM_E_ROM_BLOCK_LENGTH
        boolean NvMCfgChkParamPointer: set at pre-compile, origin=Vector Informatik, default-value=true  # Parameter Pointer Check | This parameter defines if pointers are checked not to be a NULL_PTR in all applicable APIs.
        boolean NvMCfgChkParamDataIndex: set at pre-compile, origin=Vector Informatik, default-value=true  # Parameter Data Index Check | This parameter defines if the DataIndex is checked in NvM_SetDataIndex().
        boolean NvMCfgChkParamBlockid: set at pre-compile, origin=Vector Informatik, default-value=true  # Parameter Block Id Check | This parameter defines if BlockId is checked in all services expecting a BlockId as parameter.
        boolean NvMCfgChkMngmtType: set at pre-compile, origin=Vector Informatik, default-value=true  # Management Type Check | This parameter defines if the block's Managmement Type is checked in NvM_SetDataIndex() and NvM_GetDataIndex() APIs.
        boolean NvMCfgChkDoParamChk: set at pre-compile, origin=Vector Informatik, default-value=true  # Parameter Checks | This parameter defines if the parameter checks for BlockId, DataIndex and Pointer are globally enabled.
        boolean NvMCfgChkBlockPending: set at pre-compile, origin=Vector Informatik, default-value=true  # Block Pendiing Check | This parameter defines if PENDING block is checked in APIs. According to specification there may only be one request per Block pending.
        boolean NvMCfgChkBlockLengthStrict: set at pre-compile, origin=Vector Informatik, default-value=true  # Block Length Strict Check | This parameter defines if block length checks are strict or loose. Strict checks require the RAM/ROM Blocks to match the configured Block Lengths exactly. Loose checks require the RAM/ROM Block sizes to be greater than or equal to the related block size. The strict check shall help to detect alignment issues in compiler, which would make user data larger than specified in NVM configuration. As a result the NVM would not write/read all user data to/from NV memory.
        boolean NvMCfgChkBlockProtection: set at pre-compile, origin=Vector Informatik, default-value=true  # Block Write Protection Check | This parameter defines if a Block's write protection in NvM_WriteBlock(), NvM_InvalidateNvBlock() and NvM_EraseNvBlock() is checked.
        string NvMCfgIncludeDet [0..1]: set at pre-compile, origin=Vector Informatik, default-value=Det.h  # Det Include File | This parameter defines the header file, declaring the Devolopment Error reporting function.
        boolean NvMDebugReporting: set at pre-compile, origin=Vector Informatik, default-value=true  # Development Error Reporting | This parameter defines if the reporting to DET in Development Mode is enabled. Has no effects, if (NvmDevErrorDetect == OFF)
        string NvMErrorhook [0..1]: set at pre-compile, origin=Vector Informatik, default-value=Det_ReportError  # Det Error Hook | This parameter defines the development error reporting function. It has the following prototype: void <Name>(uint16 ModuleId, uint8 InstanceId, uint8 ServiceId, uint8 ErrorCode);
  module config NvM_Pre: definition=NvM
    NvMConfigBlock (NvMBlockDescriptor):
      NvMNvramBlockIdentifier = 1
      NvMBlockManagementType = NVM_BLOCK_REDUNDANT
      NvMNvBlockNum = 2
      NvMBlockUseCrc = 1
      NvMNvBlockLength = 2
      NvMSelectBlockForReadAll = 1
      NvMResistantToChangedSw = 1
      NvMUseInitCallback = 0
      NvMSelectBlockForWriteAll = 1
      NvMCalcRamBlockCrc = 0
      NvMRomBlockDataAddress = NULL_PTR
  module config NvM_Rec: definition=NvM
    NvMConfigBlock (NvMBlockDescriptor): NvMBlockCrcType=NVM_CRC16
  bsw implementation NvM_Impl: programming-language=C, sw-version=5.02.02, used-code-generator=DaVinci Configurator, vendor-id=30, ar-release-version=4.00.03, behavior=NvMBehavior, preconfigured-configuration=NvM_Pre, recommended-configuration=NvM_Rec, vendor-specific-module-def=NvM
