[part 1 of 4: package /Renesas/EcucDefs_Port]
AUTOSAR XML (schema 4-0-3)
# COPYRIGHT
# Copyright(c) 2014-2015 Renesas Electronics Corporation
package /Renesas/EcucDefs_Port
  ecuc definition collection RenesasParameterDefinition_Port: module=Port
  module definition Port: refined-module-def=Port, variants post-build  # Configuration of the Port module.
    container PortConfigSet: multiple-configuration-container=true  # This container is the base of a multiple configuration set.
      container PortContainer [1..*]  # Container collecting the PortPins. This container is not used for implementation.
        integer PortNumberOfPortPins: 1..1, set at pre-compile, default-value=1  # The number of specified PortPins in this PortContainer. This parameter is not used for implementation.
        container PortPin [1..*]  # Configuration of the individual port pins. This container is not used for implementation.
          enumeration PortPinDirection: {PORT_PIN_IN, PORT_PIN_OUT}, set at post-build, default-value=PORT_PIN_IN  # The initial direction of the pin (IN or OUT). If the direction is not changeable, the value configured here is fixed. This parameter is not used for implementation The direction must match the pin mode. E.g. a pin used for an ADC must be configured to be an in port. Implementation Type: Port_PinDirectionType.
          boolean PortPinDirectionChangeable: set at post-build, default-value=false  # Parameter to indicate if the direction is changeable on a port pin during runtime. This parameter is not used for implementation. true: Port Pin direction changeable enabled. false: Port Pin direction changeable disabled.
          integer PortPinId: 1..65535, set at pre-compile, symbolic-name-value=true, default-value=1  # Pin Id of the port pin. This value will be assigned to the symbolic name derived from the port pin container short name. This parameter is not used for implementation.
          enumeration PortPinInitialMode: {PORT_PIN_MODE_ADC, PORT_PIN_MODE_CAN, PORT_PIN_MODE_DIO, PORT_PIN_MODE_DIO_GPT, PORT_PIN_MODE_DIO_WDG, PORT_PIN_MODE_FLEXRAY, PORT_PIN_MODE_ICU, PORT_PIN_MODE_LIN, PORT_PIN_MODE_MEM, PORT_PIN_MODE_PWM, PORT_PIN_MODE_SPI}, set at post-build, default-value=PORT_PIN_MODE_ADC  # Port pin mode from mode list for use with Port_Init() function. This parameter is not used for implementation.
          enumeration PortPinLevelValue: {PORT_PIN_LEVEL_HIGH, PORT_PIN_LEVEL_LOW}, set at post-build, default-value=PORT_PIN_LEVEL_HIGH  # Port Pin Level value from Port pin list. This parameter is not used for implementation.
          enumeration PortPinMode: {PORT_PIN_MODE_ADC, PORT_PIN_MODE_CAN, PORT_PIN_MODE_DIO, PORT_PIN_MODE_DIO_GPT, PORT_PIN_MODE_DIO_WDG, PORT_PIN_MODE_FLEXRAY, PORT_PIN_MODE_ICU, PORT_PIN_MODE_LIN, PORT_PIN_MODE_MEM, PORT_PIN_MODE_PWM, PORT_PIN_MODE_SPI}, set at post-build, default-value=PORT_PIN_MODE_ADC  # Port pin mode from mode list. This parameter is not used for implementation.
          boolean PortPinModeChangeable: set at post-build, default-value=false  # Parameter to indicate if the mode of a port pin is changeable during runtime by API function Port_SetPinMode. Including this API is controlled by PortSetPinModeApi. true: Port Pin mode is changeable. false: Port Pin mode is not changeable.
      container PortFilterGroupConfig  # This container contains configuration for the Port Filter Functionality.
        container SamplingClockSourceSelection [0..1]  # This container contains configuration for the digital noise sampling clock source of the Port Filter Functionality.
          enumeration PortClockSource0: {CLK_HSB_DNFCKS100C, CLK_HSB_BY_2_DNFCKS100C}, set at post-build, origin=Renesas_v1.0.0, default-value=CLK_HSB_DNFCKS100C  # This parameter updates the clock source for digital noise sampling clock (DNFATCKI) using DNFCKS100C register and the value configured for this clock source is applicable for PortDigitalFilterGroup0, PortDigitalFilterGroup1, PortDigitalFilterGroup3, PortDigitalFilterGroup4 and PortDigitalFilterGroup5 digital filter groups. CLK_HSB_DNFCKS100C: Selects a clock source for digital filter sampling clock(DNFATCKI) and updates the DNFCKS100C register CKSCn[1:0] bit as 0 1. CLK_HSB_BY_2_DNFCKS100C: Selects a clock source for digital filter sampling clock(DNFATCKI) and updates the DNFCKS100C register CKSCn[1:0] bit as 1 0.
          enumeration PortClockSource1: {CLK_HSB_DNFCKS108C, CLK_HSB_BY_2_DNFCKS108C}, set at post-build, origin=Renesas_v1.0.0, default-value=CLK_HSB_DNFCKS108C  # This parameter updates the clock source for digital noise sampling clock (DNFATCKI) using DNFCKS1018C the value configured for this clock source is applicable for PortDigitalFilterGroup5, PortDigitalFilterGroup6, PortDigitalFilterGroup7, PortDigitalFilterGroup48 and PortDigitalFilterGroup9 digital filter groups. CLK_HSB_DNFCKS108C: Selects a clock source for digital filter sampling clock(DNFATCKI) and updates the DNFCKS108C register CKSCn[1:0] bit as 0 1. CLK_HSB_BY_2_DNFCKS108C: Selects a clock source for digital filter sampling clock(DNFATCKI) and updates the DNFCKS108C register CKSCn[1:0] bit as 1 0.
          enumeration PortClockSource2: {CLK_HSB_DNFCKS109C, CLK_HSB_BY_2_DNFCKS109C, TAUD1TCKEN0_DNFCKS109C}, set at post-build, origin=Renesas_v1.0.0, default-value=CLK_HSB_DNFCKS109C  # This parameter updates the clock source for digital noise sampling clock (DNFATCKI) using DNFCKS109C the value configured for this clock source is applicable for PortDigitalFilterGroup10, PortDigitalFilterGroup11, PortDigitalFilterGroup12, PortDigitalFilterGroup13 and PortDigitalFilterGroup14 digital filter groups. CLK_HSB_DNFCKS109C: Selects a clock source for digital filter sampling clock(DNFATCKI) and updates the DNFCKS109C register CKSCn[1:0] bit as 0 1. CLK_HSB_BY_2_DNFCKS109C: Selects a clock source for digital filter sampling clock(DNFATCKI) and updates the DNFCKS109C register CKSCn[1:0] bit as 1 0. TAUD1TCKEN0_DNFCKS109C: Selects a clock source for digital filter sampling clock(DNFATCKI) and updates the DNFCKS112C register CKSCn[1:0] bit as 1 1.
          enumeration PortClockSource3: {CLK_HSB_DNFCKS110C, CLK_HSB_BY_2_DNFCKS110C, TAUD2TCKEN0_DNFCKS110C}, set at post-build, origin=Renesas_v1.0.3, default-value=CLK_HSB_DNFCKS110C  # This parameter updates the clock source for digital noise sampling clock (DNFATCKI) using DNFCKS110C the value configured for this clock source is applicable for PortDigitalFilterGroup15, PortDigitalFilterGroup16, PortDigitalFilterGroup17, PortDigitalFilterGroup18 and PortDigitalFilterGroup19 digital filter groups. CLK_HSB_DNFCKS110C: Selects a clock source for digital filter sampling clock(DNFATCKI) and updates the DNFCKS110C register CKSCn[1:0] bit as 0 1. CLK_HSB_BY_2_DNFCKS110C: Selects a clock source for digital filter sampling clock(DNFATCKI) and updates the DNFCKS110C register CKSCn[1:0] bit as 1 0. TAUD2TCKEN0_DNFCKS110C: Selects a clock source for digital filter sampling clock(DNFATCKI) and updates the DNFCKS112C register CKSCn[1:0] bit as 1 1.
          enumeration PortClockSource4: {CLK_HSB_DNFCKS112C, CLK_HSB_BY_2_DNFCKS112C, TAUJ0TCKEN0_DNFCKS112C}, set at post-build, origin=Renesas_v1.0.3, default-value=CLK_HSB_DNFCKS112C  # This parameter updates the clock source for digital noise sampling clock (DNFATCKI) using DNFCKS112C the value configured for this clock source is applicable for PortDigitalFilterGroup20, PortDigitalFilterGroup21 and PortDigitalFilterGroup23 digital filter groups. CLK_HSB_DNFCKS112C: Selects a clock source for digital filter sampling clock(DNFATCKI) and updates the DNFCKS112C register CKSCn[1:0] bit as 0 1. CLK_HSB_BY_2_DNFCKS112C: Selects a clock source for digital filter sampling clock(DNFATCKI) and updates the DNFCKS112C register CKSCn[1:0] bit as 1 0. TAUJ0TCKEN0_DNFCKS112C: Selects a clock source for digital filter sampling clock(DNFATCKI) and updates the DNFCKS112C register CKSCn[1:0] bit as 1 1.
          enumeration PortClockSource5: {CLK_HSB_DNFCKS113C, CLK_HSB_BY_2_DNFCKS113C, TAUJ1TCKEN0_DNFCKS113C}, set at post-build, origin=Renesas_v1.0.3, default-value=CLK_HSB_DNFCKS113C  # This parameter updates the clock source for digital noise sampling clock (DNFATCKI) using DNFCKS113C the value configured for this clock source is applicable for PortDigitalFilterGroup24, PortDigitalFilterGroup25, PortDigitalFilterGroup26 and PortDigitalFilterGroup27 digital filter groups. CLK_HSB_DNFCKS113C: Selects a clock source for digital filter sampling clock(DNFATCKI) and updates the DNFCKS113C register CKSCn[1:0] bit as 0 1. CLK_HSB_BY_2_DNFCKS113C: Selects a clock source for digital filter sampling clock(DNFATCKI) and updates the DNFCKS113C register CKSCn[1:0] bit as 1 0. TAUJ1TCKEN0_DNFCKS113C: Selects a clock source for digital filter sampling clock(DNFATCKI) and updates the DNFCKS113C register CKSCn[1:0] bit as 1 1.
          enumeration PortClockSource6: {CLK_HSB_DNFCKS114C, CLK_HSB_BY_2_DNFCKS114C, TAUJ2TCKEN0_DNFCKS114C}, set at post-build, origin=Renesas_v1.0.3, default-value=CLK_HSB_DNFCKS114C  # This parameter updates the clock source for digital noise sampling clock (DNFATCKI) using DNFCKS114C the value configured for this clock source is applicable for PortDigitalFilterGroup28, PortDigitalFilterGroup29, PortDigitalFilterGroup30 and PortDigitalFilterGroup31 digital filter groups. CLK_HSB_DNFCKS114C: Selects a clock source for digital filter sampling clock(DNFATCKI) and updates the DNFCKS114C register CKSCn[1:0] bit as 0 1. CLK_HSB_BY_2_DNFCKS114C: Selects a clock source for digital filter sampling clock(DNFATCKI) and updates the DNFCKS114C register CKSCn[1:0] bit as 1 0. TAUJ2TCKEN0_DNFCKS114C: Selects a clock source for digital filter sampling clock(DNFATCKI) and updates the DNFCKS114C register CKSCn[1:0] bit as 1 1.
          enumeration PortClockSource7: {CLK_HSB_DNFCKS104C, CLK_HSB_BY_2_DNFCKS104C}, set at post-build, origin=Renesas_v1.0.3, default-value=CLK_HSB_DNFCKS104C  # This parameter updates the clock source for digital noise sampling clock (DNFATCKI) using DNFCKS104C the value configured for this clock source is applicable for PortDigitalFilterGroup32, PortDigitalFilterGroup33, PortDigitalFilterGroup34 and PortDigitalFilterGroup38 digital filter groups. CLK_HSB_DNFCKS104C: Selects a clock source for digital filter sampling clock(DNFATCKI) and updates the DNFCKS104C register CKSCn[1:0] bit as 0 1. CLK_HSB_BY_2_DNFCKS104C: Selects a clock source for digital filter sampling clock(DNFATCKI) and updates the DNFCKS104C register CKSCn[1:0] bit as 1 0.
          enumeration PortClockSource8: {CLK_HSB_DNFCKS105C, CLK_HSB_BY_2_DNFCKS105C}, set at post-build, origin=Renesas_v1.0.3, default-value=CLK_HSB_DNFCKS105C  # This parameter updates the clock source for digital noise sampling clock (DNFATCKI) using DNFCKS105C the value configured for this clock source is applicable for PortDigitalFilterGroup35, PortDigitalFilterGroup36, PortDigitalFilterGroup37 and PortDigitalFilterGroup39 digital filter groups. CLK_HSB_DNFCKS105C: Selects a clock source for digital filter sampling clock(DNFATCKI) and updates the DNFCKS105C register CKSCn[1:0] bit as 0 1. CLK_HSB_BY_2_DNFCKS105C: Selects a clock source for digital filter sampling clock(DNFATCKI) and updates the DNFCKS105C register CKSCn[1:0] bit as 1 0.
          enumeration PortClockSource9: {CLK_HSB_DNFCKS102C, CLK_HSB_BY_2_DNFCKS102C}, set at post-build, origin=Renesas_v1.0.3, default-value=CLK_HSB_DNFCKS102C  # This parameter updates the clock source for digital noise sampling clock (DNFATCKI) using DNFCKS102C register to PortDigitalFilterGroup40 digital filter group. CLK_HSB_DNFCKS102C: Selects a clock source for digital filter sampling clock(DNFATCKI) and updates the DNFCKS102C register CKSCn[1:0] bit as 0 1. CLK_HSB_BY_2_DNFCKS102C: Selects a clock source for digital filter sampling clock(DNFATCKI) and updates the DNFCKS102C register CKSCn[1:0] bit as 1 0.
          enumeration PortClockSource10: {CLK_HSB_DNFCKS101C, CLK_HSB_BY_2_DNFCKS101C}, set at post-build, origin=Renesas_v1.0.3, default-value=CLK_HSB_DNFCKS101C  # This parameter updates the clock source for digital noise sampling clock (DNFATCKI) using DNFCKS101C register to PortDigitalFilterGroup41 digital filter group. CLK_HSB_DNFCKS101C: Selects a clock source for digital filter sampling clock(DNFATCKI) and updates the DNFCKS101C register CKSCn[1:0] bit as 0 1. CLK_HSB_BY_2_DNFCKS101C: Selects a clock source for digital filter sampling clock(DNFATCKI) and updates the DNFCKS101C register CKSCn[1:0] bit as 1 0.
          enumeration PortClockSource11: {CLK_HSB_DNFCKS106C, CLK_HSB_BY_2_DNFCKS106C}, set at post-build, origin=Renesas_v1.0.3, default-value=CLK_HSB_DNFCKS106C  # This parameter updates the clock source for digital noise sampling clock (DNFATCKI) using DNFCKS106C register to PortDigitalFilterGroup42 digital filter group. CLK_HSB_DNFCKS106C: Selects a clock source for digital filter sampling clock(DNFATCKI) and updates the DNFCKS106C register CKSCn[1:0] bit as 0 1. CLK_HSB_BY_2_DNFCKS106C: Selects a clock source for digital filter sampling clock(DNFATCKI) and updates the DNFCKS106C register CKSCn[1:0] bit as 1 0.
          enumeration PortClockSource12: {CLK_HSB_DNFCKS107C, CLK_HSB_BY_2_DNFCKS107C}, set at post-build, origin=Renesas_v1.0.3, default-value=CLK_HSB_DNFCKS107C  # This parameter updates the clock source for digital noise sampling clock (DNFATCKI) using DNFCKS107C register to PortDigitalFilterGroup43 digital filter group. CLK_HSB_DNFCKS107C: Selects a clock source for digital filter sampling clock(DNFATCKI) and updates the DNFCKS107C register CKSCn[1:0] bit as 0 1. CLK_HSB_BY_2_DNFCKS107C: Selects a clock source for digital filter sampling clock(DNFATCKI) and updates the DNFCKS107C register CKSCn[1:0] bit as 1 0.
        container PortDigitalFilterGroup0 [0..1]  # This container contains the Port Digital Filter Functionality for the signals INTP0/SCI30RX, INTP1/SCI31RX or INTP2/SCI32RX and uses the clock source mentioned in PortClockSource0 parameter of SamplingClockSourceSelection container.
          enumeration PortSameLevelSamples: {TWO_SAMPLES, THREE_SAMPLES, FOUR_SAMPLES, FIVE_SAMPLES}, set at post-build, origin=Renesas_v1.0.0, default-value=TWO_SAMPLES  # This parameter specifies the number of same level samples, i.e. the number of samples with the same level to judge an external signal pulse as valid. TWO_SAMPLES: Two samples are enabled. THREE_SAMPLES: Three samples are enabled. FOUR_SAMPLES: Four samples are enabled. FIVE_SAMPLES: Five samples are enabled.
          enumeration PortSamplingClockFrequency: {DNFATCKI_DIV_BY_1, DNFATCKI_DIV_BY_2}, set at post-build, origin=Renesas_v1.0.0, default-value=DNFATCKI_DIV_BY_1  # This parameter specifies the Digital filter sampling clock frequency. DNFATCKI_DIV_BY_1: DNFATCKI / 1 clock frequency is enabled. DNFATCKI_DIV_BY_2: DNFATCKI / 2 clock frequency is enabled.
          enumeration PortDigitalFilterEnableInput0: {BYPASSED_FCLA1CTL0, ENABLED_FCLA1CTL0, DISABLED}, set at post-build, origin=Renesas_v1.0.0, default-value=DISABLED  # This parameter enables/disables for the signal INTP0/SCI30RX. ENABLED;_CTL<Instance>: Filter is enabled. BYPASSED<Instance>_CTL<Instance>_ADC<Instance>: Filter bypass is enabled. DISABLED: Filter is disabled.
          enumeration PortDigitalFilterEdgeControl0: {RISING_FCLA1CTL0, FALLING_FCLA1CTL0, DISABLED}, set at post-build, origin=Renesas_v1.0.0, default-value=DISABLED  # This parameter enables/disables for the signal INTP0/SCI30RX. | DISABLED: Digital noise elimination disabled. RISING_FCLA<Instance>_CTL<Instance>: Enables rising edge. FALLING_FCLA<Instance>_CTL<Instance>: Enables falling edge.
          enumeration PortDigitalFilterEnableInput1: {ENABLED_FCLA1CTL1, BYPASSED_FCLA1CTL1, DISABLED}, set at post-build, origin=Renesas_v1.0.0, default-value=DISABLED  # This parameter enables/disables for the signal INTP1/SCI31RX. ENABLED;_CTL<Instance>: Filter is enabled. BYPASSED<Instance>_CTL<Instance>_ADC<Instance>: Filter bypass is enabled. DISABLED: Filter is disabled.
          enumeration PortDigitalFilterEdgeControl1: {RISING_FCLA1CTL1, FALLING_FCLA1CTL1, DISABLED}, set at post-build, origin=Renesas_v1.0.0, default-value=DISABLED  # This parameter enables/disables for the signal INTP1/SCI31RX. | DISABLED: Digital noise elimination disabled. RISING_FCLA<Instance>_CTL<Instance>: Enables rising edge. FALLING_FCLA<Instance>_CTL<Instance>: Enables falling edge.
          enumeration PortDigitalFilterEnableInput2: {ENABLED_FCLA1CTL2, BYPASSED_FCLA1CTL2, DISABLED}, set at post-build, origin=Renesas_v1.0.0, default-value=DISABLED  # This parameter enables/disables for the signal INTP2/SCI32RX. ENABLED;_CTL<Instance>: Filter is enabled. BYPASSED<Instance>_CTL<Instance>_ADC<Instance>: Filter bypass is enabled. DISABLED: Filter is disabled.
          enumeration PortDigitalFilterEdgeControl2: {RISING_FCLA1CTL2, FALLING_FCLA1CTL2, DISABLED}, set at post-build, origin=Renesas_v1.0.0, default-value=DISABLED  # This parameter enables/disables for the signal INTP2/SCI32RX. | DISABLED: Digital noise elimination disabled. RISING_FCLA<Instance>_CTL<Instance>: Enables rising edge. FALLING_FCLA<Instance>_CTL<Instance>: Enables falling edge.
        container PortDigitalFilterGroup1 [0..1]  # This container contains the Port Digital Filter Functionality for the signals INTP3/RLIN30RX or INTP4/RLIN31RX and uses the clock source mentioned in PortClockSource0 parameter of SamplingClockSourceSelection container.
          enumeration PortSameLevelSamples: {TWO_SAMPLES, THREE_SAMPLES, FOUR_SAMPLES, FIVE_SAMPLES}, set at post-build, origin=Renesas_v1.0.0, default-value=TWO_SAMPLES  # This parameter specifies the number of same level samples, i.e. the number of samples with the same level to judge an external signal pulse as valid. TWO_SAMPLES: Two samples are enabled. THREE_SAMPLES: Three samples are enabled. FOUR_SAMPLES: Four samples are enabled. FIVE_SAMPLES: Five samples are enabled.
          enumeration PortSamplingClockFrequency: {DNFATCKI_DIV_BY_1, DNFATCKI_DIV_BY_2}, set at post-build, origin=Renesas_v1.0.0, default-value=DNFATCKI_DIV_BY_1  # This parameter specifies the Digital filter sampling clock frequency. DNFATCKI_DIV_BY_1: DNFATCKI / 1 clock frequency is enabled. DNFATCKI_DIV_BY_2: DNFATCKI / 2 clock frequency is enabled.
          enumeration PortDigitalFilterEnableInput0: {ENABLED_FCLA1CTL3, BYPASSED_FCLA1CTL3, DISABLED}, set at post-build, origin=Renesas_v1.0.0, default-value=DISABLED  # This parameter enables/disables for the signal INTP3/RLIN30RX. ENABLED;_CTL<Instance>: Filter is enabled. BYPASSED<Instance>_CTL<Instance>_ADC<Instance>: Filter bypass is enabled. DISABLED: Filter is disabled.
          enumeration PortDigitalFilterEdgeControl0: {RISING_FCLA1CTL3, FALLING_FCLA1CTL3, DISABLED}, set at post-build, origin=Renesas_v1.0.0, default-value=DISABLED  # This parameter enables/disables for the signal INTP3/RLIN30RX. | DISABLED: Digital noise elimination disabled. RISING_FCLA<Instance>_CTL<Instance>: Enables rising edge. FALLING_FCLA<Instance>_CTL<Instance>: Enables falling edge.
          enumeration PortDigitalFilterEnableInput1: {ENABLED_FCLA1CTL4, BYPASSED_FCLA1CTL4, DISABLED}, set at post-build, origin=Renesas_v1.0.0, default-value=DISABLED  # This parameter enables/disables for the signal INTP4/RLIN31RX. ENABLED;_CTL<Instance>: Filter is enabled. BYPASSED<Instance>_CTL<Instance>_ADC<Instance>: Filter bypass is enabled. DISABLED: Filter is disabled.
          enumeration PortDigitalFilterEdgeControl1: {RISING_FCLA1CTL4, FALLING_FCLA1CTL4, DISABLED}, set at post-build, origin=Renesas_v1.0.0, default-value=DISABLED  # This parameter enables/disables for the signal INTP4/RLIN31RX. | DISABLED: Digital noise elimination disabled. RISING_FCLA<Instance>_CTL<Instance>: Enables rising edge. FALLING_FCLA<Instance>_CTL<Instance>: Enables falling edge.
        container PortDigitalFilterGroup2 [0..1]  # This container contains the Port Digital Filter Functionality for the signals INPT5/RSCAN0RX0, INTP6/RSCAN0RX1, INTP10, INTP11/FLX0RXDA, INTP12/FLX0RXDB and uses the clock source mentioned in PortClockSource0 parameter of SamplingClockSourceSelection container.
          enumeration PortSameLevelSamples: {TWO_SAMPLES, THREE_SAMPLES, FOUR_SAMPLES, FIVE_SAMPLES}, set at post-build, origin=Renesas_v1.0.0, default-value=TWO_SAMPLES  # This parameter specifies the number of same level samples, i.e. the number of samples with the same level to judge an external signal pulse as valid. TWO_SAMPLES: Two samples are enabled. THREE_SAMPLES: Three samples are enabled. FOUR_SAMPLES: Four samples are enabled. FIVE_SAMPLES: Five samples are enabled.
          enumeration PortSamplingClockFrequency: {DNFATCKI_DIV_BY_1, DNFATCKI_DIV_BY_2}, set at post-build, origin=Renesas_v1.0.0, default-value=DNFATCKI_DIV_BY_1  # This parameter specifies the Digital filter sampling clock frequency. DNFATCKI_DIV_BY_1: DNFATCKI / 1 clock frequency is enabled. DNFATCKI_DIV_BY_2: DNFATCKI / 2 clock frequency is enabled.
          enumeration PortDigitalFilterEnableInput0: {ENABLED_FCLA1CTL5, RISING_FCLA1CTL5, FALLING_FCLA1CTL5, BYPASSED_FCLA1CTL5, DISABLED}, set at post-build, origin=Renesas_v1.0.0, default-value=DISABLED  # This parameter enables/disables for the signal INPT5/RSCAN0RX0. ENABLED;_CTL<Instance>: Filter is enabled. BYPASSED<Instance>_CTL<Instance>_ADC<Instance>: Filter bypass is enabled. DISABLED: Filter is disabled.
          enumeration PortDigitalFilterEdgeControl0: {RISING_FCLA1CTL5, FALLING_FCLA1CTL5, DISABLED}, set at post-build, origin=Renesas_v1.0.0, default-value=DISABLED  # This parameter enables/disables for the signal INPT5/RSCAN0RX0. | DISABLED: Digital noise elimination disabled. RISING_FCLA<Instance>_CTL<Instance>: Enables rising edge. FALLING_FCLA<Instance>_CTL<Instance>: Enables falling edge.
          enumeration PortDigitalFilterEnableInput1: {ENABLED_FCLA1CTL6, BYPASSED_FCLA1CTL6, DISABLED}, set at post-build, origin=Renesas_v1.0.0, default-value=DISABLED  # This parameter enables/disables for the signal INTP6/RSCAN0RX1. ENABLED;_CTL<Instance>: Filter is enabled. BYPASSED<Instance>_CTL<Instance>_ADC<Instance>: Filter bypass is enabled. DISABLED: Filter is disabled.
          enumeration PortDigitalFilterEdgeControl1: {RISING_FCLA1CTL6, FALLING_FCLA1CTL6, DISABLED}, set at post-build, origin=Renesas_v1.0.0, default-value=DISABLED  # This parameter enables/disables for the signal INTP6/RSCAN0RX1. | DISABLED: Digital noise elimination disabled. RISING_FCLA<Instance>_CTL<Instance>: Enables rising edge. FALLING_FCLA<Instance>_CTL<Instance>: Enables falling edge.
          enumeration PortDigitalFilterEnableInput2: {ENABLED_FCLA2CTL2, BYPASSED_FCLA2CTL2, DISABLED}, set at post-build, origin=Renesas_v1.0.0, default-value=DISABLED  # This parameter enables/disables for the signal INTP10/RSCAN0RX2. ENABLED;_CTL<Instance>: Filter is enabled. BYPASSED<Instance>_CTL<Instance>_ADC<Instance>: Filter bypass is enabled. DISABLED: Filter is disabled.
          enumeration PortDigitalFilterEdgeControl2: {RISING_FCLA2CTL2, FALLING_FCLA2CTL2, DISABLED}, set at post-build, origin=Renesas_v1.0.0, default-value=DISABLED  # This parameter enables/disables for the signal INTP10/RSCAN0RX2. | DISABLED: Digital noise elimination disabled. RISING_FCLA<Instance>_CTL<Instance>: Enables rising edge. FALLING_FCLA<Instance>_CTL<Instance>: Enables falling edge.
          enumeration PortDigitalFilterEnableInput3: {ENABLED_FCLA2CTL3, BYPASSED_FCLA2CTL3, DISABLED}, set at post-build, origin=Renesas_v1.0.0, default-value=DISABLED  # This parameter enables/disables for the signal INTP11/FLX0RXDA. ENABLED;_CTL<Instance>: Filter is enabled. BYPASSED<Instance>_CTL<Instance>_ADC<Instance>: Filter bypass is enabled. DISABLED: Filter is disabled.
          enumeration PortDigitalFilterEdgeControl3: {RISING_FCLA2CTL3, FALLING_FCLA2CTL3, DISABLED}, set at post-build, origin=Renesas_v1.0.0, default-value=DISABLED  # This parameter enables/disables for the signal INTP11/FLX0RXDA. | DISABLED: Digital noise elimination disabled. RISING_FCLA<Instance>_CTL<Instance>: Enables rising edge. FALLING_FCLA<Instance>_CTL<Instance>: Enables falling edge.
          enumeration PortDigitalFilterEnableInput4: {ENABLED_FCLA2CTL4, BYPASSED_FCLA2CTL4, DISABLED}, set at post-build, origin=Renesas_v1.0.0, default-value=DISABLED  # This parameter enables/disables for the signal INTP12/FLX0RXDB. ENABLED;_CTL<Instance>: Filter is enabled. BYPASSED<Instance>_CTL<Instance>_ADC<Instance>: Filter bypass is enabled. DISABLED: Filter is disabled.
          enumeration PortDigitalFilterEdgeControl4: {RISING_FCLA2CTL4, FALLING_FCLA2CTL4, DISABLED}, set at post-build, origin=Renesas_v1.0.0, default-value=DISABLED  # This parameter enables/disables for the signal INTP12/FLX0RXDB. | DISABLED: Digital noise elimination disabled. RISING_FCLA<Instance>_CTL<Instance>: Enables rising edge. FALLING_FCLA<Instance>_CTL<Instance>: Enables falling edge.
        container PortDigitalFilterGroup3 [0..1]  # This container contains the Port Digital Filter Functionality for the signals INTP7/TAPA0ESO, INTP8/TAPA1ESO and uses the clock source mentioned in PortClockSource0 parameter of SamplingClockSourceSelection container.
          enumeration PortSameLevelSamples: {TWO_SAMPLES, THREE_SAMPLES, FOUR_SAMPLES, FIVE_SAMPLES}, set at post-build, origin=Renesas_v1.0.0, default-value=TWO_SAMPLES  # This parameter specifies the number of same level samples, i.e. the number of samples with the same level to judge an external signal pulse as valid. TWO_SAMPLES: Two samples are enabled. THREE_SAMPLES: Three samples are enabled. FOUR_SAMPLES: Four samples are enabled. FIVE_SAMPLES: Five samples are enabled.
          enumeration PortSamplingClockFrequency: {DNFATCKI_DIV_BY_1, DNFATCKI_DIV_BY_2}, set at post-build, origin=Renesas_v1.0.0, default-value=DNFATCKI_DIV_BY_1  # This parameter specifies the Digital filter sampling clock frequency. DNFATCKI_DIV_BY_1: DNFATCKI / 1 clock frequency is enabled. DNFATCKI_DIV_BY_2: DNFATCKI / 2 clock frequency is enabled.
          enumeration PortDigitalFilterEnableInput0: {ENABLED_FCLA1CTL7, BYPASSED_FCLA1CTL7, DISABLED}, set at post-build, origin=Renesas_v1.0.0, default-value=DISABLED  # This parameter enables/disables for the signal INTP7/TAPA0ESO ENABLED;_CTL<Instance>: Filter is enabled. BYPASSED<Instance>_CTL<Instance>_ADC<Instance>: Filter bypass is enabled. DISABLED: Filter is disabled.
          enumeration PortDigitalFilterEdgeControl0: {RISING_FCLA1CTL7, FALLING_FCLA1CTL7, DISABLED}, set at post-build, origin=Renesas_v1.0.0, default-value=DISABLED  # This parameter enables/disables for the signal INTP7/TAPA0ESO. | DISABLED: Digital noise elimination disabled. RISING_FCLA<Instance>_CTL<Instance>: Enables rising edge. FALLING_FCLA<Instance>_CTL<Instance>: Enables falling edge.
          enumeration PortDigitalFilterEnableInput1: {ENABLED_FCLA2CTL0, BYPASSED_FCLA2CTL0, DISABLED}, set at post-build, origin=Renesas_v1.0.0, default-value=DISABLED  # This parameter enables/disables for the signal INTP8/TAPA1ESO. ENABLED;_CTL<Instance>: Filter is enabled. BYPASSED<Instance>_CTL<Instance>_ADC<Instance>: Filter bypass is enabled. DISABLED: Filter is disabled.
          enumeration PortDigitalFilterEdgeControl1: {RISING_FCLA2CTL0, FALLING_FCLA2CTL0, DISABLED}, set at post-build, origin=Renesas_v1.0.0, default-value=DISABLED  # This parameter enables/disables for the signal INTP8/TAPA1ESO. | DISABLED: Digital noise elimination disabled. RISING_FCLA<Instance>_CTL<Instance>: Enables rising edge. FALLING_FCLA<Instance>_CTL<Instance>: Enables falling edge.
        container PortDigitalFilterGroup4 [0..1]  # This container contains the Port Digital Filter Functionality for the signal INTP9 uses the clock source mentioned in PortClockSource0 parameter of SamplingClockSourceSelection container.
          enumeration PortSameLevelSamples: {TWO_SAMPLES, THREE_SAMPLES, FOUR_SAMPLES, FIVE_SAMPLES}, set at post-build, origin=Renesas_v1.0.0, default-value=TWO_SAMPLES  # This parameter specifies the number of same level samples, i.e. the number of samples with the same level to judge an external signal pulse as valid. TWO_SAMPLES: Two samples are enabled. THREE_SAMPLES: Three samples are enabled. FOUR_SAMPLES: Four samples are enabled. FIVE_SAMPLES: Five samples are enabled.
          enumeration PortSamplingClockFrequency: {DNFATCKI_DIV_BY_1, DNFATCKI_DIV_BY_2}, set at post-build, origin=Renesas_v1.0.0, default-value=DNFATCKI_DIV_BY_1  # This parameter specifies the Digital filter sampling clock frequency. DNFATCKI_DIV_BY_1: DNFATCKI / 1 clock frequency is enabled. DNFATCKI_DIV_BY_2: DNFATCKI / 2 clock frequency is enabled.
          enumeration PortDigitalFilterEnableInput0: {ENABLED_FCLA2CTL1, BYPASSED_FCLA2CTL1, DISABLED}, set at post-build, origin=Renesas_v1.0.0, default-value=DISABLED  # This parameter enables/disables for the signal INTP9. ENABLED;_CTL<Instance>: Filter is enabled. BYPASSED<Instance>_CTL<Instance>_ADC<Instance>: Filter bypass is enabled. DISABLED: Filter is disabled.
          enumeration PortDigitalFilterEdgeControl0: {RISING_FCLA2CTL1, FALLING_FCLA2CTL1, DISABLED}, set at post-build, origin=Renesas_v1.0.0, default-value=DISABLED  # This parameter enables/disables for the signal INTP9. | DISABLED: Digital noise elimination disabled. RISING_FCLA<Instance>_CTL<Instance>: Enables rising edge. FALLING_FCLA<Instance>_CTL<Instance>: Enables falling edge.
          enumeration PortDigitalFilterEnableInput1: {ENABLED_FCLA0CTL0, BYPASSED_FCLA0CTL0, DISABLED}, set at post-build, origin=Renesas_v1.0.0, default-value=DISABLED  # This parameter enables/disables for the signal NMI. ENABLED;_CTL<Instance>: Filter is enabled. BYPASSED<Instance>_CTL<Instance>_ADC<Instance>: Filter bypass is enabled. DISABLED: Filter is disabled.
          enumeration PortDigitalFilterEdgeControl1: {RISING_FCLA0CTL0, FALLING_FCLA0CTL0, DISABLED}, set at post-build, origin=Renesas_v1.0.0, default-value=DISABLED  # This parameter enables/disables for the signal NMI. | DISABLED: Digital noise elimination disabled. RISING_FCLA<Instance>_CTL<Instance>: Enables rising edge. FALLING_FCLA<Instance>_CTL<Instance>: Enables falling edge.
        container PortDigitalFilterGroup5 [0..1]  # This container contains the Port Digital Filter Functionality for the signals TAUD0I0 or TAUD0I1 and uses the clock source mentioned in PortClockSource1 parameter of SamplingClockSourceSelection container.
          enumeration PortSameLevelSamples: {TWO_SAMPLES, THREE_SAMPLES, FOUR_SAMPLES, FIVE_SAMPLES}, set at post-build, origin=Renesas_v1.0.0, default-value=TWO_SAMPLES  # This parameter specifies the number of same level samples, i.e. the number of samples with the same level to judge an external signal pulse as valid. TWO_SAMPLES: Two samples are enabled. THREE_SAMPLES: Three samples are enabled. FOUR_SAMPLES: Four samples are enabled. FIVE_SAMPLES: Five samples are enabled.
          enumeration PortSamplingClockFrequency: {DNFATCKI_DIV_BY_1, DNFATCKI_DIV_BY_2}, set at post-build, origin=Renesas_v1.0.0, default-value=DNFATCKI_DIV_BY_1  # This parameter specifies the Digital filter sampling clock frequency. DNFATCKI_DIV_BY_1: DNFATCKI / 1 clock frequency is enabled. DNFATCKI_DIV_BY_2: DNFATCKI / 2 clock frequency is enabled.
          enumeration PortDigitalFilterEnableInput0: {FIXED_LOW_LEVEL, BYPASSED}, set at post-build, origin=Renesas_v1.0.0, default-value=FIXED_LOW_LEVEL  # This parameter enables/disables for the signal TAUD1I0. FIXED_LOW_LEVEL: Fixed low level output signal is enabled. BYPASSED: Filter bypass is enabled.
          enumeration PortDigitalFilterEnableInput1: {FIXED_LOW_LEVEL, BYPASSED}, set at post-build, origin=Renesas_v1.0.0, default-value=FIXED_LOW_LEVEL  # This parameter enables/disables for the signal TAUD1I1. FIXED_LOW_LEVEL: Fixed low level output signal is enabled. BYPASSED: Filter bypass is enabled.
        container PortDigitalFilterGroup6 [0..1]  # This container contains the Port Digital Filter Functionality for the signals TAUD0I2 or TAUD0I3 and uses the clock source mentioned in PortClockSource1 parameter of SamplingClockSourceSelection container.
          enumeration PortSameLevelSamples: {TWO_SAMPLES, THREE_SAMPLES, FOUR_SAMPLES, FIVE_SAMPLES}, set at post-build, origin=Renesas_v1.0.0, default-value=TWO_SAMPLES  # This parameter specifies the number of same level samples, i.e. the number of samples with the same level to judge an external signal pulse as valid. TWO_SAMPLES: Two samples are enabled. THREE_SAMPLES: Three samples are enabled. FOUR_SAMPLES: Four samples are enabled. FIVE_SAMPLES: Five samples are enabled.
          enumeration PortSamplingClockFrequency: {DNFATCKI_DIV_BY_1, DNFATCKI_DIV_BY_2}, set at post-build, origin=Renesas_v1.0.0, default-value=DNFATCKI_DIV_BY_1  # This parameter specifies the Digital filter sampling clock frequency. DNFATCKI_DIV_BY_1: DNFATCKI / 1 clock frequency is enabled. DNFATCKI_DIV_BY_2: DNFATCKI / 2 clock frequency is enabled.
          enumeration PortDigitalFilterEnableInput6: {FIXED_LOW_LEVEL, BYPASSED}, set at post-build, origin=Renesas_v1.0.0, default-value=FIXED_LOW_LEVEL  # This parameter enables/disables for the signal TAUD1I2. FIXED_LOW_LEVEL: Fixed low level output signal is enabled. BYPASSED: Filter bypass is enabled.
          enumeration PortDigitalFilterEnableInput1: {FIXED_LOW_LEVEL, BYPASSED}, set at post-build, origin=Renesas_v1.0.0, default-value=FIXED_LOW_LEVEL  # This parameter enables/disables for the signal TAUD1I3. FIXED_LOW_LEVEL: Fixed low level output signal is enabled. BYPASSED: Filter bypass is enabled.
        container PortDigitalFilterGroup7 [0..1]  # This container contains the Port Digital Filter Functionality for the signals TAUD0I4 or TAUD0I5 and uses the clock source mentioned in PortClockSource1 parameter of SamplingClockSourceSelection container.
          enumeration PortSameLevelSamples: {TWO_SAMPLES, THREE_SAMPLES, FOUR_SAMPLES, FIVE_SAMPLES}, set at post-build, origin=Renesas_v1.0.0, default-value=TWO_SAMPLES  # This parameter specifies the number of same level samples, i.e. the number of samples with the same level to judge an external signal pulse as valid. TWO_SAMPLES: Two samples are enabled. THREE_SAMPLES: Three samples are enabled. FOUR_SAMPLES: Four samples are enabled. FIVE_SAMPLES: Five samples are enabled.
          enumeration PortSamplingClockFrequency: {DNFATCKI_DIV_BY_1, DNFATCKI_DIV_BY_2}, set at post-build, origin=Renesas_v1.0.0, default-value=DNFATCKI_DIV_BY_1  # This parameter specifies the Digital filter sampling clock frequency. DNFATCKI_DIV_BY_1: DNFATCKI / 1 clock frequency is enabled. DNFATCKI_DIV_BY_2: DNFATCKI / 2 clock frequency is enabled.
          enumeration PortDigitalFilterEnableInput0: {FIXED_LOW_LEVEL, BYPASSED}, set at post-build, origin=Renesas_v1.0.0, default-value=FIXED_LOW_LEVEL  # This parameter enables/disables for the signal TAUD1I4. FIXED_LOW_LEVEL: Fixed low level output signal is enabled. BYPASSED: Filter bypass is enabled.
          enumeration PortDigitalFilterEnableInput1: {FIXED_LOW_LEVEL, BYPASSED}, set at post-build, origin=Renesas_v1.0.0, default-value=FIXED_LOW_LEVEL  # This parameter enables/disables for the signal TAUD1I5. FIXED_LOW_LEVEL: Fixed low level output signal is enabled. BYPASSED: Filter bypass is enabled.
        container PortDigitalFilterGroup8 [0..1]  # This container contains the Port Digital Filter Functionality for the signals TAUD0I6 or TAUD0I7 and uses the clock source mentioned in PortClockSource1 parameter of SamplingClockSourceSelection container.
          enumeration PortSameLevelSamples: {TWO_SAMPLES, THREE_SAMPLES, FOUR_SAMPLES, FIVE_SAMPLES}, set at post-build, origin=Renesas_v1.0.0, default-value=TWO_SAMPLES  # This parameter specifies the number of same level samples, i.e. the number of samples with the same level to judge an external signal pulse as valid. TWO_SAMPLES: Two samples are enabled. THREE_SAMPLES: Three samples are enabled. FOUR_SAMPLES: Four samples are enabled. FIVE_SAMPLES: Five samples are enabled.
          enumeration PortSamplingClockFrequency: {DNFATCKI_DIV_BY_1, DNFATCKI_DIV_BY_2}, set at post-build, origin=Renesas_v1.0.0, default-value=DNFATCKI_DIV_BY_1  # This parameter specifies the Digital filter sampling clock frequency. DNFATCKI_DIV_BY_1: DNFATCKI / 1 clock frequency is enabled. DNFATCKI_DIV_BY_2: DNFATCKI / 2 clock frequency is enabled.
          enumeration PortDigitalFilterEnableInput0: {FIXED_LOW_LEVEL, BYPASSED}, set at post-build, origin=Renesas_v1.0.0, default-value=FIXED_LOW_LEVEL  # This parameter enables/disables for the signal TAUD1I6. FIXED_LOW_LEVEL: Fixed low level output signal is enabled. BYPASSED: Filter bypass is enabled.
          enumeration PortDigitalFilterEnableInput1: {FIXED_LOW_LEVEL, BYPASSED}, set at post-build, origin=Renesas_v1.0.0, default-value=FIXED_LOW_LEVEL  # This parameter enables/disables for the signal TAUD1I7. FIXED_LOW_LEVEL: Fixed low level output signal is enabled. BYPASSED: Filter bypass is enabled.
        container PortDigitalFilterGroup9 [0..1]  # This container contains the Port Digital Filter Functionality for the signals TAUD0I9, TAUD0I10, TAUD0I11, TAUD0I12, TAUD0I13, TAUD0I14 or TAUD0I15 and uses the clock source mentioned in PortClockSource1 parameter of SamplingClockSourceSelection container.
          enumeration PortSameLevelSamples: {TWO_SAMPLES, THREE_SAMPLES, FOUR_SAMPLES, FIVE_SAMPLES}, set at post-build, origin=Renesas_v1.0.0, default-value=TWO_SAMPLES  # This parameter specifies the number of same level samples, i.e. the number of samples with the same level to judge an external signal pulse as valid. TWO_SAMPLES: Two samples are enabled. THREE_SAMPLES: Three samples are enabled. FOUR_SAMPLES: Four samples are enabled. FIVE_SAMPLES: Five samples are enabled.
          enumeration PortSamplingClockFrequency: {DNFATCKI_DIV_BY_1, DNFATCKI_DIV_BY_2}, set at post-build, origin=Renesas_v1.0.0, default-value=DNFATCKI_DIV_BY_1  # This parameter specifies the Digital filter sampling clock frequency. DNFATCKI_DIV_BY_1: DNFATCKI / 1 clock frequency is enabled. DNFATCKI_DIV_BY_2: DNFATCKI / 2 clock frequency is enabled.
          enumeration PortDigitalFilterEnableInput0: {FIXED_LOW_LEVEL, BYPASSED}, set at post-build, origin=Renesas_v1.0.0, default-value=FIXED_LOW_LEVEL  # This parameter enables/disables for the signal TAUD1I8. FIXED_LOW_LEVEL: Fixed low level output signal is enabled. BYPASSED: Filter bypass is enabled.
          enumeration PortDigitalFilterEnableInput1: {FIXED_LOW_LEVEL, BYPASSED}, set at post-build, origin=Renesas_v1.0.0, default-value=FIXED_LOW_LEVEL  # This parameter enables/disables for the signal TAUD1I9. FIXED_LOW_LEVEL: Fixed low level output signal is enabled. BYPASSED: Filter bypass is enabled.
          enumeration PortDigitalFilterEnableInput2: {FIXED_LOW_LEVEL, BYPASSED}, set at post-build, origin=Renesas_v1.0.0, default-value=FIXED_LOW_LEVEL  # This parameter enables/disables for the signal TAUD1I10. FIXED_LOW_LEVEL: Fixed low level output signal is enabled. BYPASSED: Filter bypass is enabled.
          enumeration PortDigitalFilterEnableInput3: {FIXED_LOW_LEVEL, BYPASSED}, set at post-build, origin=Renesas_v1.0.0, default-value=FIXED_LOW_LEVEL  # This parameter enables/disables for the signal TAUD1I11. FIXED_LOW_LEVEL: Fixed low level output signal is enabled. BYPASSED: Filter bypass is enabled.
          enumeration PortDigitalFilterEnableInput4: {FIXED_LOW_LEVEL, BYPASSED}, set at post-build, origin=Renesas_v1.0.0, default-value=FIXED_LOW_LEVEL  # This parameter enables/disables for the signal TAUD1I12. FIXED_LOW_LEVEL: Fixed low level output signal is enabled. BYPASSED: Filter bypass is enabled.
          enumeration PortDigitalFilterEnableInput5: {FIXED_LOW_LEVEL, BYPASSED}, set at post-build, origin=Renesas_v1.0.0, default-value=FIXED_LOW_LEVEL  # This parameter enables/disables for the signal TAUD1I13. FIXED_LOW_LEVEL: Fixed low level output signal is enabled. BYPASSED: Filter bypass is enabled.
          enumeration PortDigitalFilterEnableInput6: {FIXED_LOW_LEVEL, BYPASSED}, set at post-build, origin=Renesas_v1.0.0, default-value=FIXED_LOW_LEVEL  # This parameter enables/disables for the signal TAUD1I14. FIXED_LOW_LEVEL: Fixed low level output signal is enabled. BYPASSED: Filter bypass is enabled.
          enumeration PortDigitalFilterEnableInput7: {FIXED_LOW_LEVEL, BYPASSED}, set at post-build, origin=Renesas_v1.0.0, default-value=FIXED_LOW_LEVEL  # This parameter enables/disables for the signal TAUD1I15. FIXED_LOW_LEVEL: Fixed low level output signal is enabled. BYPASSED: Filter bypass is enabled.
        container PortDigitalFilterGroup10 [0..1]  # This container contains the Port Digital Filter Functionality for the signals TAUD1I0 or TAUD1I1. uses the clock source mentioned in PortClockSource2 parameter of SamplingClockSourceSelection container.
          enumeration PortSameLevelSamples: {TWO_SAMPLES, THREE_SAMPLES, FOUR_SAMPLES, FIVE_SAMPLES}, set at post-build, origin=Renesas_v1.0.0, default-value=TWO_SAMPLES  # This parameter specifies the number of same level samples, i.e. the number of samples with the same level to judge an external signal pulse as valid. TWO_SAMPLES: Two samples are enabled. THREE_SAMPLES: Three samples are enabled. FOUR_SAMPLES: Four samples are enabled. FIVE_SAMPLES: Five samples are enabled.
          enumeration PortSamplingClockFrequency: {DNFATCKI_DIV_BY_1, DNFATCKI_DIV_BY_2}, set at post-build, origin=Renesas_v1.0.0, default-value=DNFATCKI_DIV_BY_1  # This parameter specifies the Digital filter sampling clock frequency. DNFATCKI_DIV_BY_1: DNFATCKI / 1 clock frequency is enabled. DNFATCKI_DIV_BY_2: DNFATCKI / 2 clock frequency is enabled.
          enumeration PortDigitalFilterEnableInput0: {FIXED_LOW_LEVEL, BYPASSED}, set at post-build, origin=Renesas_v1.0.0, default-value=FIXED_LOW_LEVEL  # This parameter enables/disables for the signal TAUD1I0. FIXED_LOW_LEVEL: Fixed low level output signal is enabled. BYPASSED: Filter bypass is enabled.
          enumeration PortDigitalFilterEnableInput1: {FIXED_LOW_LEVEL, BYPASSED}, set at post-build, origin=Renesas_v1.0.0, default-value=FIXED_LOW_LEVEL  # This parameter enables/disables for the signal TAUD1I1. FIXED_LOW_LEVEL: Fixed low level output signal is enabled. BYPASSED: Filter bypass is enabled.
        container PortDigitalFilterGroup11 [0..1]  # This container contains the Port Digital Filter Functionality for the signals TAUD1I2 or TAUD1I3 and uses the clock source mentioned in PortClockSource02 parameter of SamplingClockSourceSelection container.
          enumeration PortSameLevelSamples: {TWO_SAMPLES, THREE_SAMPLES, FOUR_SAMPLES, FIVE_SAMPLES}, set at post-build, origin=Renesas_v1.0.0, default-value=TWO_SAMPLES  # This parameter specifies the number of same level samples, i.e. the number of samples with the same level to judge an external signal pulse as valid. TWO_SAMPLES: Two samples are enabled. THREE_SAMPLES: Three samples are enabled. FOUR_SAMPLES: Four samples are enabled. FIVE_SAMPLES: Five samples are enabled.
          enumeration PortSamplingClockFrequency: {DNFATCKI_DIV_BY_1, DNFATCKI_DIV_BY_2}, set at post-build, origin=Renesas_v1.0.0, default-value=DNFATCKI_DIV_BY_1  # This parameter specifies the Digital filter sampling clock frequency. DNFATCKI_DIV_BY_1: DNFATCKI / 1 clock frequency is enabled. DNFATCKI_DIV_BY_2: DNFATCKI / 2 clock frequency is enabled.
          enumeration PortDigitalFilterEnableInput0: {FIXED_LOW_LEVEL, BYPASSED}, set at post-build, origin=Renesas_v1.0.0, default-value=FIXED_LOW_LEVEL  # This parameter enables/disables for the signal TAUD1I2. FIXED_LOW_LEVEL: Fixed low level output signal is enabled. BYPASSED: Filter bypass is enabled.
          enumeration PortDigitalFilterEnableInput1: {FIXED_LOW_LEVEL, BYPASSED}, set at post-build, origin=Renesas_v1.0.0, default-value=FIXED_LOW_LEVEL  # This parameter enables/disables for the signal TAUD1I3. FIXED_LOW_LEVEL: Fixed low level output signal is enabled. BYPASSED: Filter bypass is enabled.
        container PortDigitalFilterGroup12 [0..1]  # This container contains the Port Digital Filter Functionality for the signals TAUD1I4 or TAUD1I5 and uses the clock source mentioned in PortClockSource2 parameter of SamplingClockSourceSelection container.
          enumeration PortSameLevelSamples: {TWO_SAMPLES, THREE_SAMPLES, FOUR_SAMPLES, FIVE_SAMPLES}, set at post-build, origin=Renesas_v1.0.0, default-value=TWO_SAMPLES  # This parameter specifies the number of same level samples, i.e. the number of samples with the same level to judge an external signal pulse as valid. TWO_SAMPLES: Two samples are enabled. THREE_SAMPLES: Three samples are enabled. FOUR_SAMPLES: Four samples are enabled. FIVE_SAMPLES: Five samples are enabled.
          enumeration PortSamplingClockFrequency: {DNFATCKI_DIV_BY_1, DNFATCKI_DIV_BY_2}, set at post-build, origin=Renesas_v1.0.0, default-value=DNFATCKI_DIV_BY_1  # This parameter specifies the Digital filter sampling clock frequency. DNFATCKI_DIV_BY_1: DNFATCKI / 1 clock frequency is enabled. DNFATCKI_DIV_BY_2: DNFATCKI / 2 clock frequency is enabled.
          enumeration PortDigitalFilterEnableInput0: {FIXED_LOW_LEVEL, BYPASSED}, set at post-build, origin=Renesas_v1.0.0, default-value=FIXED_LOW_LEVEL  # This parameter enables/disables for the signal TAUD1I6. FIXED_LOW_LEVEL: Fixed low level output signal is enabled. BYPASSED: Filter bypass is enabled.
          enumeration PortDigitalFilterEnableInput1: {FIXED_LOW_LEVEL, BYPASSED}, set at post-build, origin=Renesas_v1.0.0, default-value=FIXED_LOW_LEVEL  # This parameter enables/disables for the signal TAUD1I7. FIXED_LOW_LEVEL: Fixed low level output signal is enabled. BYPASSED: Filter bypass is enabled.
        container PortDigitalFilterGroup13 [0..1]  # This container contains the Port Digital Filter Functionality for the signals TAUD1I8 or TAUD1I9 and uses the clock source mentioned in PortClockSource2 parameter of SamplingClockSourceSelection container.
          enumeration PortSameLevelSamples: {TWO_SAMPLES, THREE_SAMPLES, FOUR_SAMPLES, FIVE_SAMPLES}, set at post-build, origin=Renesas_v1.0.0, default-value=TWO_SAMPLES  # This parameter specifies the number of same level samples, i.e. the number of samples with the same level to judge an external signal pulse as valid. TWO_SAMPLES: Two samples are enabled. THREE_SAMPLES: Three samples are enabled. FOUR_SAMPLES: Four samples are enabled. FIVE_SAMPLES: Five samples are enabled.
          enumeration PortSamplingClockFrequency: {DNFATCKI_DIV_BY_1, DNFATCKI_DIV_BY_2}, set at post-build, origin=Renesas_v1.0.0, default-value=DNFATCKI_DIV_BY_1  # This parameter specifies the Digital filter sampling clock frequency. DNFATCKI_DIV_BY_1: DNFATCKI / 1 clock frequency is enabled. DNFATCKI_DIV_BY_2: DNFATCKI / 2 clock frequency is enabled.
          enumeration PortDigitalFilterEnableInput0: {FIXED_LOW_LEVEL, BYPASSED}, set at post-build, origin=Renesas_v1.0.0, default-value=FIXED_LOW_LEVEL  # This parameter enables/disables for the signal TAUD1I8. FIXED_LOW_LEVEL: Fixed low level output signal is enabled. BYPASSED: Filter bypass is enabled.
          enumeration PortDigitalFilterEnableInput1: {FIXED_LOW_LEVEL, BYPASSED}, set at post-build, origin=Renesas_v1.0.0, default-value=FIXED_LOW_LEVEL  # This parameter enables/disables for the signal TAUD1I9. FIXED_LOW_LEVEL: Fixed low level output signal is enabled. BYPASSED: Filter bypass is enabled.
        container PortDigitalFilterGroup14 [0..1]  # This container contains the Port Digital Filter Functionality for the signals TAUD1I8, TAUD1I9, TAUD1I10, TAUD1I11, TAUD1I12, TAUD1I13, TAUD1I14 or TAUD1I15 and uses the clock source mentioned in PortClockSource2 parameter of SamplingClockSourceSelection container.
          enumeration PortSameLevelSamples: {TWO_SAMPLES, THREE_SAMPLES, FOUR_SAMPLES, FIVE_SAMPLES}, set at post-build, origin=Renesas_v1.0.0, default-value=TWO_SAMPLES  # This parameter specifies the number of same level samples, i.e. the number of samples with the same level to judge an external signal pulse as valid. TWO_SAMPLES: Two samples are enabled. THREE_SAMPLES: Three samples are enabled. FOUR_SAMPLES: Four samples are enabled. FIVE_SAMPLES: Five samples are enabled.
          enumeration PortSamplingClockFrequency: {DNFATCKI_DIV_BY_1, DNFATCKI_DIV_BY_2}, set at post-build, origin=Renesas_v1.0.0, default-value=DNFATCKI_DIV_BY_1  # This parameter specifies the Digital filter sampling clock frequency. DNFATCKI_DIV_BY_1: DNFATCKI / 1 clock frequency is enabled. DNFATCKI_DIV_BY_2: DNFATCKI / 2 clock frequency is enabled.
          enumeration PortDigitalFilterEnableInput0: {FIXED_LOW_LEVEL, BYPASSED}, set at post-build, origin=Renesas_v1.0.0, default-value=FIXED_LOW_LEVEL  # This parameter enables/disables for the signal TAUD1I8. FIXED_LOW_LEVEL: Fixed low level output signal is enabled. BYPASSED: Filter bypass is enabled.
          enumeration PortDigitalFilterEnableInput1: {FIXED_LOW_LEVEL, BYPASSED}, set at post-build, origin=Renesas_v1.0.0, default-value=FIXED_LOW_LEVEL  # This parameter enables/disables for the signal TAUD1I9. FIXED_LOW_LEVEL: Fixed low level output signal is enabled. BYPASSED: Filter bypass is enabled.
          enumeration PortDigitalFilterEnableInput2: {FIXED_LOW_LEVEL, BYPASSED}, set at post-build, origin=Renesas_v1.0.0, default-value=FIXED_LOW_LEVEL  # This parameter enables/disables for the signal TAUD1I10. FIXED_LOW_LEVEL: Fixed low level output signal is enabled. BYPASSED: Filter bypass is enabled.
          enumeration PortDigitalFilterEnableInput3: {FIXED_LOW_LEVEL, BYPASSED}, set at post-build, origin=Renesas_v1.0.0, default-value=FIXED_LOW_LEVEL  # This parameter enables/disables for the signal TAUD1I11. FIXED_LOW_LEVEL: Fixed low level output signal is enabled. BYPASSED: Filter bypass is enabled.
          enumeration PortDigitalFilterEnableInput4: {FIXED_LOW_LEVEL, BYPASSED}, set at post-build, origin=Renesas_v1.0.0, default-value=FIXED_LOW_LEVEL  # This parameter enables/disables for the signal TAUD1I12. FIXED_LOW_LEVEL: Fixed low level output signal is enabled. BYPASSED: Filter bypass is enabled.
          enumeration PortDigitalFilterEnableInput5: {FIXED_LOW_LEVEL, BYPASSED}, set at post-build, origin=Renesas_v1.0.0, default-value=FIXED_LOW_LEVEL  # This parameter enables/disables for the signal TAUD1I13. FIXED_LOW_LEVEL: Fixed low level output signal is enabled. BYPASSED: Filter bypass is enabled.
          enumeration PortDigitalFilterEnableInput6: {FIXED_LOW_LEVEL, BYPASSED}, set at post-build, origin=Renesas_v1.0.0, default-value=FIXED_LOW_LEVEL  # This parameter enables/disables for the signal TAUD1I14. FIXED_LOW_LEVEL: Fixed low level output signal is enabled. BYPASSED: Filter bypass is enabled.
          enumeration PortDigitalFilterEnableInput7: {FIXED_LOW_LEVEL, BYPASSED}, set at post-build, origin=Renesas_v1.0.0, default-value=FIXED_LOW_LEVEL  # This parameter enables/disables for the signal TAUD1I15. FIXED_LOW_LEVEL: Fixed low level output signal is enabled. BYPASSED: Filter bypass is enabled.
        container PortDigitalFilterGroup15 [0..1]  # This container contains the Port Digital Filter Functionality for the signals TAUD2I0 or TAUD2I1 and uses the clock source mentioned in PortClockSource3 parameter of SamplingClockSourceSelection container.
          enumeration PortSameLevelSamples: {TWO_SAMPLES, THREE_SAMPLES, FOUR_SAMPLES, FIVE_SAMPLES}, set at post-build, origin=Renesas_v1.0.0, default-value=TWO_SAMPLES  # This parameter specifies the number of same level samples, i.e. the number of samples with the same level to judge an external signal pulse as valid. TWO_SAMPLES: Two samples are enabled. THREE_SAMPLES: Three samples are enabled. FOUR_SAMPLES: Four samples are enabled. FIVE_SAMPLES: Five samples are enabled.
          enumeration PortSamplingClockFrequency: {DNFATCKI_DIV_BY_1, DNFATCKI_DIV_BY_2}, set at post-build, origin=Renesas_v1.0.0, default-value=DNFATCKI_DIV_BY_1  # This parameter specifies the Digital filter sampling clock frequency. DNFATCKI_DIV_BY_1: DNFATCKI / 1 clock frequency is enabled. DNFATCKI_DIV_BY_2: DNFATCKI / 2 clock frequency is enabled.
          enumeration PortDigitalFilterEnableInput0: {FIXED_LOW_LEVEL, BYPASSED}, set at post-build, origin=Renesas_v1.0.0, default-value=FIXED_LOW_LEVEL  # This parameter enables/disables for the signal TAUD2I0. FIXED_LOW_LEVEL: Fixed low level output signal is enabled. BYPASSED: Filter bypass is enabled.
          enumeration PortDigitalFilterEnableInput1: {FIXED_LOW_LEVEL, BYPASSED}, set at post-build, origin=Renesas_v1.0.0, default-value=FIXED_LOW_LEVEL  # This parameter enables/disables for the signal TAUD2I1. FIXED_LOW_LEVEL: Fixed low level output signal is enabled. BYPASSED: Filter bypass is enabled.
        container PortDigitalFilterGroup16 [0..1]  # This container contains the Port Digital Filter Functionality for the signals TAUD2I2 or TAUD2I3 and uses the clock source mentioned in PortClockSource3 parameter of SamplingClockSourceSelection container.
          enumeration PortSameLevelSamples: {TWO_SAMPLES, THREE_SAMPLES, FOUR_SAMPLES, FIVE_SAMPLES}, set at post-build, origin=Renesas_v1.0.0, default-value=TWO_SAMPLES  # This parameter specifies the number of same level samples, i.e. the number of samples with the same level to judge an external signal pulse as valid. TWO_SAMPLES: Two samples are enabled. THREE_SAMPLES: Three samples are enabled. FOUR_SAMPLES: Four samples are enabled. FIVE_SAMPLES: Five samples are enabled.
          enumeration PortSamplingClockFrequency: {DNFATCKI_DIV_BY_1, DNFATCKI_DIV_BY_2}, set at post-build, origin=Renesas_v1.0.0, default-value=DNFATCKI_DIV_BY_1  # This parameter specifies the Digital filter sampling clock frequency. DNFATCKI_DIV_BY_1: DNFATCKI / 1 clock frequency is enabled. DNFATCKI_DIV_BY_2: DNFATCKI / 2 clock frequency is enabled.
          enumeration PortDigitalFilterEnableInput0: {FIXED_LOW_LEVEL, BYPASSED}, set at post-build, origin=Renesas_v1.0.0, default-value=FIXED_LOW_LEVEL  # This parameter enables/disables for the signal TAUD2I2. FIXED_LOW_LEVEL: Fixed low level output signal is enabled. BYPASSED: Filter bypass is enabled.
          enumeration PortDigitalFilterEnableInput1: {FIXED_LOW_LEVEL, BYPASSED}, set at post-build, origin=Renesas_v1.0.0, default-value=FIXED_LOW_LEVEL  # This parameter enables/disables for the signal TAUD2I3. FIXED_LOW_LEVEL: Fixed low level output signal is enabled. BYPASSED: Filter bypass is enabled.
        container PortDigitalFilterGroup17 [0..1]  # This container contains the Port Digital Filter Functionality for the signals TAUD2I4 or TAUD2I5 and uses the clock source mentioned in PortClockSource3 parameter of SamplingClockSourceSelection container.
          enumeration PortSameLevelSamples: {TWO_SAMPLES, THREE_SAMPLES, FOUR_SAMPLES, FIVE_SAMPLES}, set at post-build, origin=Renesas_v1.0.0, default-value=TWO_SAMPLES  # This parameter specifies the number of same level samples, i.e. the number of samples with the same level to judge an external signal pulse as valid. TWO_SAMPLES: Two samples are enabled. THREE_SAMPLES: Three samples are enabled. FOUR_SAMPLES: Four samples are enabled. FIVE_SAMPLES: Five samples are enabled.
          enumeration PortSamplingClockFrequency: {DNFATCKI_DIV_BY_1, DNFATCKI_DIV_BY_2}, set at post-build, origin=Renesas_v1.0.0, default-value=DNFATCKI_DIV_BY_1  # This parameter specifies the Digital filter sampling clock frequency. DNFATCKI_DIV_BY_1: DNFATCKI / 1 clock frequency is enabled. DNFATCKI_DIV_BY_2: DNFATCKI / 2 clock frequency is enabled.
          enumeration PortDigitalFilterEnableInput0: {FIXED_LOW_LEVEL, BYPASSED}, set at post-build, origin=Renesas_v1.0.0, default-value=FIXED_LOW_LEVEL  # This parameter enables/disables for the signal TAUD2I4. FIXED_LOW_LEVEL: Fixed low level output signal is enabled. BYPASSED: Filter bypass is enabled.
          enumeration PortDigitalFilterEnableInput1: {FIXED_LOW_LEVEL, BYPASSED}, set at post-build, origin=Renesas_v1.0.0, default-value=FIXED_LOW_LEVEL  # This parameter enables/disables for the signal TAUD2I5. FIXED_LOW_LEVEL: Fixed low level output signal is enabled. BYPASSED: Filter bypass is enabled.
        container PortDigitalFilterGroup18 [0..1]  # This container contains the Port Digital Filter Functionality for the signals TAUD2I6 or TAUD2I7 and uses the clock source mentioned in PortClockSource3 parameter of SamplingClockSourceSelection container.
          enumeration PortSameLevelSamples: {TWO_SAMPLES, THREE_SAMPLES, FOUR_SAMPLES, FIVE_SAMPLES}, set at post-build, origin=Renesas_v1.0.0, default-value=TWO_SAMPLES  # This parameter specifies the number of same level samples, i.e. the number of samples with the same level to judge an external signal pulse as valid. TWO_SAMPLES: Two samples are enabled. THREE_SAMPLES: Three samples are enabled. FOUR_SAMPLES: Four samples are enabled. FIVE_SAMPLES: Five samples are enabled.
          enumeration PortSamplingClockFrequency: {DNFATCKI_DIV_BY_1, DNFATCKI_DIV_BY_2}, set at post-build, origin=Renesas_v1.0.0, default-value=DNFATCKI_DIV_BY_1  # This parameter specifies the Digital filter sampling clock frequency. DNFATCKI_DIV_BY_1: DNFATCKI / 1 clock frequency is enabled. DNFATCKI_DIV_BY_2: DNFATCKI / 2 clock frequency is enabled.
          enumeration PortDigitalFilterEnableInput0: {FIXED_LOW_LEVEL, BYPASSED}, set at post-build, origin=Renesas_v1.0.0, default-value=FIXED_LOW_LEVEL  # This parameter enables/disables for the signal TAUD2I6. FIXED_LOW_LEVEL: Fixed low level output signal is enabled. BYPASSED: Filter bypass is enabled.
          enumeration PortDigitalFilterEnableInput1: {FIXED_LOW_LEVEL, BYPASSED}, set at post-build, origin=Renesas_v1.0.0, default-value=FIXED_LOW_LEVEL  # This parameter enables/disables for the signal TAUD2I7. FIXED_LOW_LEVEL: Fixed low level output signal is enabled. BYPASSED: Filter bypass is enabled.
        container PortDigitalFilterGroup19 [0..1]  # This container contains the Port Digital Filter Functionality for the signals TAUD2I8, TAUD2I9, TAUD2I10, TAUD2I11, TAUD2I12, TAUD2I13, TAUD2I14 or TAUD2I15 and uses the clock source mentioned in PortClockSource3 parameter of SamplingClockSourceSelection container.
          enumeration PortSameLevelSamples: {TWO_SAMPLES, THREE_SAMPLES, FOUR_SAMPLES, FIVE_SAMPLES}, set at post-build, origin=Renesas_v1.0.0, default-value=TWO_SAMPLES  # This parameter specifies the number of same level samples, i.e. the number of samples with the same level to judge an external signal pulse as valid. TWO_SAMPLES: Two samples are enabled. THREE_SAMPLES: Three samples are enabled. FOUR_SAMPLES: Four samples are enabled. FIVE_SAMPLES: Five samples are enabled.
          enumeration PortSamplingClockFrequency: {DNFATCKI_DIV_BY_1, DNFATCKI_DIV_BY_2}, set at post-build, origin=Renesas_v1.0.0, default-value=DNFATCKI_DIV_BY_1  # This parameter specifies the Digital filter sampling clock frequency. DNFATCKI_DIV_BY_1: DNFATCKI / 1 clock frequency is enabled. DNFATCKI_DIV_BY_2: DNFATCKI / 2 clock frequency is enabled.
          enumeration PortDigitalFilterEnableInput0: {FIXED_LOW_LEVEL, BYPASSED}, set at post-build, origin=Renesas_v1.0.0, default-value=FIXED_LOW_LEVEL  # This parameter enables/disables for the signal TAUD2I8. FIXED_LOW_LEVEL: Fixed low level output signal is enabled. BYPASSED: Filter bypass is enabled.
          enumeration PortDigitalFilterEnableInput1: {FIXED_LOW_LEVEL, BYPASSED}, set at post-build, origin=Renesas_v1.0.0, default-value=FIXED_LOW_LEVEL  # This parameter enables/disables for the signal TAUD2I9. FIXED_LOW_LEVEL: Fixed low level output signal is enabled. BYPASSED: Filter bypass is enabled.
          enumeration PortDigitalFilterEnableInput2: {FIXED_LOW_LEVEL, BYPASSED}, set at post-build, origin=Renesas_v1.0.0, default-value=FIXED_LOW_LEVEL  # This parameter enables/disables for the signal TAUD2I10. FIXED_LOW_LEVEL: Fixed low level output signal is enabled. BYPASSED: Filter bypass is enabled.
          enumeration PortDigitalFilterEnableInput3: {FIXED_LOW_LEVEL, BYPASSED}, set at post-build, origin=Renesas_v1.0.0, default-value=FIXED_LOW_LEVEL  # This parameter enables/disables for the signal TAUD2I11. FIXED_LOW_LEVEL: Fixed low level output signal is enabled. BYPASSED: Filter bypass is enabled.
          enumeration PortDigitalFilterEnableInput4: {FIXED_LOW_LEVEL, BYPASSED}, set at post-build, origin=Renesas_v1.0.0, default-value=FIXED_LOW_LEVEL  # This parameter enables/disables for the signal TAUD2I12. FIXED_LOW_LEVEL: Fixed low level output signal is enabled. BYPASSED: Filter bypass is enabled.
          enumeration PortDigitalFilterEnableInput5: {FIXED_LOW_LEVEL, BYPASSED}, set at post-build, origin=Renesas_v1.0.0, default-value=FIXED_LOW_LEVEL  # This parameter enables/disables for the signal TAUD2I13. FIXED_LOW_LEVEL: Fixed low level output signal is enabled. BYPASSED: Filter bypass is enabled.
          enumeration PortDigitalFilterEnableInput6: {FIXED_LOW_LEVEL, BYPASSED}, set at post-build, origin=Renesas_v1.0.0, default-value=FIXED_LOW_LEVEL  # This parameter enables/disables for the signal TAUD2I14. FIXED_LOW_LEVEL: Fixed low level output signal is enabled. BYPASSED: Filter bypass is enabled.
          enumeration PortDigitalFilterEnableInput7: {FIXED_LOW_LEVEL, BYPASSED}, set at post-build, origin=Renesas_v1.0.0, default-value=FIXED_LOW_LEVEL  # This parameter enables/disables for the signal TAUD2I15. FIXED_LOW_LEVEL: Fixed low level output signal is enabled. BYPASSED: Filter bypass is enabled.
        container PortDigitalFilterGroup20 [0..1]  # This container contains the Port Digital Filter Functionality for the signals TAUJ0I0 and uses the clock source mentioned in PortClockSource4 parameter of SamplingClockSourceSelection container.
          enumeration PortSameLevelSamples: {TWO_SAMPLES, THREE_SAMPLES, FOUR_SAMPLES, FIVE_SAMPLES}, set at post-build, origin=Renesas_v1.0.0, default-value=TWO_SAMPLES  # This parameter specifies the number of same level samples, i.e. the number of samples with the same level to judge an external signal pulse as valid. TWO_SAMPLES: Two samples are enabled. THREE_SAMPLES: Three samples are enabled. FOUR_SAMPLES: Four samples are enabled. FIVE_SAMPLES: Five samples are enabled.
          enumeration PortSamplingClockFrequency: {DNFATCKI_DIV_BY_1, DNFATCKI_DIV_BY_2}, set at post-build, origin=Renesas_v1.0.0, default-value=DNFATCKI_DIV_BY_1  # This parameter specifies the Digital filter sampling clock frequency. DNFATCKI_DIV_BY_1: DNFATCKI / 1 clock frequency is enabled. DNFATCKI_DIV_BY_2: DNFATCKI / 2 clock frequency is enabled.
          enumeration PortDigitalFilterEnableInput0: {FIXED_LOW_LEVEL, BYPASSED}, set at post-build, origin=Renesas_v1.0.0, default-value=FIXED_LOW_LEVEL  # This parameter enables/disables for the signal TAUJ0I0. FIXED_LOW_LEVEL: Fixed low level output signal is enabled. BYPASSED: Filter bypass is enabled.
        container PortDigitalFilterGroup21 [0..1]  # This container contains the Port Digital Filter Functionality for the signals TAUJ0I1 and uses the clock source mentioned in PortClockSource4 parameter of SamplingClockSourceSelection container.
          enumeration PortSameLevelSamples: {TWO_SAMPLES, THREE_SAMPLES, FOUR_SAMPLES, FIVE_SAMPLES}, set at post-build, origin=Renesas_v1.0.0, default-value=TWO_SAMPLES  # This parameter specifies the number of same level samples, i.e. the number of samples with the same level to judge an external signal pulse as valid. TWO_SAMPLES: Two samples are enabled. THREE_SAMPLES: Three samples are enabled. FOUR_SAMPLES: Four samples are enabled. FIVE_SAMPLES: Five samples are enabled.
          enumeration PortSamplingClockFrequency: {DNFATCKI_DIV_BY_1, DNFATCKI_DIV_BY_2}, set at post-build, origin=Renesas_v1.0.0, default-value=DNFATCKI_DIV_BY_1  # This parameter specifies the Digital filter sampling clock frequency. DNFATCKI_DIV_BY_1: DNFATCKI / 1 clock frequency is enabled. DNFATCKI_DIV_BY_2: DNFATCKI / 2 clock frequency is enabled.
          enumeration PortDigitalFilterEnableInput0: {FIXED_LOW_LEVEL, BYPASSED}, set at post-build, origin=Renesas_v1.0.0, default-value=FIXED_LOW_LEVEL  # This parameter enables/disables for the signal TAUJ0I11. FIXED_LOW_LEVEL: Fixed low level output signal is enabled. BYPASSED: Filter bypass is enabled.
        container PortDigitalFilterGroup22 [0..1]  # This container contains the Port Digital Filter Functionality for the signals TAUJ0I2 and uses the clock source mentioned in PortClockSource4 parameter of SamplingClockSourceSelection container.
          enumeration PortSameLevelSamples: {TWO_SAMPLES, THREE_SAMPLES, FOUR_SAMPLES, FIVE_SAMPLES}, set at post-build, origin=Renesas_v1.0.0, default-value=TWO_SAMPLES  # This parameter specifies the number of same level samples, i.e. the number of samples with the same level to judge an external signal pulse as valid. TWO_SAMPLES: Two samples are enabled. THREE_SAMPLES: Three samples are enabled. FOUR_SAMPLES: Four samples are enabled. FIVE_SAMPLES: Five samples are enabled.
          enumeration PortSamplingClockFrequency: {DNFATCKI_DIV_BY_1, DNFATCKI_DIV_BY_2}, set at post-build, origin=Renesas_v1.0.0, default-value=DNFATCKI_DIV_BY_1  # This parameter specifies the Digital filter sampling clock frequency. DNFATCKI_DIV_BY_1: DNFATCKI / 1 clock frequency is enabled. DNFATCKI_DIV_BY_2: DNFATCKI / 2 clock frequency is enabled.
          enumeration PortDigitalFilterEnableInput0: {FIXED_LOW_LEVEL, BYPASSED}, set at post-build, origin=Renesas_v1.0.0, default-value=FIXED_LOW_LEVEL  # This parameter enables/disables for the signal TAUJ0I2. FIXED_LOW_LEVEL: Fixed low level output signal is enabled. BYPASSED: Filter bypass is enabled.
        container PortDigitalFilterGroup23 [0..1]  # This container contains the Port Digital Filter Functionality for the signals TAUJ0I3 and uses the clock source mentioned in PortClockSource4 parameter of SamplingClockSourceSelection container.
          enumeration PortSameLevelSamples: {TWO_SAMPLES, THREE_SAMPLES, FOUR_SAMPLES, FIVE_SAMPLES}, set at post-build, origin=Renesas_v1.0.0, default-value=TWO_SAMPLES  # This parameter specifies the number of same level samples, i.e. the number of samples with the same level to judge an external signal pulse as valid. TWO_SAMPLES: Two samples are enabled. THREE_SAMPLES: Three samples are enabled. FOUR_SAMPLES: Four samples are enabled. FIVE_SAMPLES: Five samples are enabled.
          enumeration PortSamplingClockFrequency: {DNFATCKI_DIV_BY_1, DNFATCKI_DIV_BY_2}, set at post-build, origin=Renesas_v1.0.0, default-value=DNFATCKI_DIV_BY_1  # This parameter specifies the Digital filter sampling clock frequency. DNFATCKI_DIV_BY_1: DNFATCKI / 1 clock frequency is enabled. DNFATCKI_DIV_BY_2: DNFATCKI / 2 clock frequency is enabled.
          enumeration PortDigitalFilterEnableInput0: {FIXED_LOW_LEVEL, BYPASSED}, set at post-build, origin=Renesas_v1.0.0, default-value=FIXED_LOW_LEVEL  # This parameter enables/disables for the signal TAUJ0I3. FIXED_LOW_LEVEL: Fixed low level output signal is enabled. BYPASSED: Filter bypass is enabled.
        container PortDigitalFilterGroup24 [0..1]  # This container contains the Port Digital Filter Functionality for the signals TAUJ1I0 and uses the clock source mentioned in PortClockSource5 parameter of SamplingClockSourceSelection container.
          enumeration PortSameLevelSamples: {TWO_SAMPLES, THREE_SAMPLES, FOUR_SAMPLES, FIVE_SAMPLES}, set at post-build, origin=Renesas_v1.0.0, default-value=TWO_SAMPLES  # This parameter specifies the number of same level samples, i.e. the number of samples with the same level to judge an external signal pulse as valid. TWO_SAMPLES: Two samples are enabled. THREE_SAMPLES: Three samples are enabled. FOUR_SAMPLES: Four samples are enabled. FIVE_SAMPLES: Five samples are enabled.
          enumeration PortSamplingClockFrequency: {DNFATCKI_DIV_BY_1, DNFATCKI_DIV_BY_2}, set at post-build, origin=Renesas_v1.0.0, default-value=DNFATCKI_DIV_BY_1  # This parameter specifies the Digital filter sampling clock frequency. DNFATCKI_DIV_BY_1: DNFATCKI / 1 clock frequency is enabled. DNFATCKI_DIV_BY_2: DNFATCKI / 2 clock frequency is enabled.
          enumeration PortDigitalFilterEnableInput0: {FIXED_LOW_LEVEL, BYPASSED}, set at post-build, origin=Renesas_v1.0.0, default-value=FIXED_LOW_LEVEL  # This parameter enables/disables for the signal TAUJ1I0. FIXED_LOW_LEVEL: Fixed low level output signal is enabled. BYPASSED: Filter bypass is enabled.
        container PortDigitalFilterGroup25 [0..1]  # This container contains the Port Digital Filter Functionality for the signals TAUJ1I1 and uses the clock source mentioned in PortClockSource5 parameter of SamplingClockSourceSelection container.
          enumeration PortSameLevelSamples: {TWO_SAMPLES, THREE_SAMPLES, FOUR_SAMPLES, FIVE_SAMPLES}, set at post-build, origin=Renesas_v1.0.0, default-value=TWO_SAMPLES  # This parameter specifies the number of same level samples, i.e. the number of samples with the same level to judge an external signal pulse as valid. TWO_SAMPLES: Two samples are enabled. THREE_SAMPLES: Three samples are enabled. FOUR_SAMPLES: Four samples are enabled. FIVE_SAMPLES: Five samples are enabled.
          enumeration PortSamplingClockFrequency: {DNFATCKI_DIV_BY_1, DNFATCKI_DIV_BY_2}, set at post-build, origin=Renesas_v1.0.0, default-value=DNFATCKI_DIV_BY_1  # This parameter specifies the Digital filter sampling clock frequency. DNFATCKI_DIV_BY_1: DNFATCKI / 1 clock frequency is enabled. DNFATCKI_DIV_BY_2: DNFATCKI / 2 clock frequency is enabled.
          enumeration PortDigitalFilterEnableInput0: {FIXED_LOW_LEVEL, BYPASSED}, set at post-build, origin=Renesas_v1.0.0, default-value=FIXED_LOW_LEVEL  # This parameter enables/disables for the signal TAUJ1I1. FIXED_LOW_LEVEL: Fixed low level output signal is enabled. BYPASSED: Filter bypass is enabled.
        container PortDigitalFilterGroup26 [0..1]  # This container contains the Port Digital Filter Functionality for the signals TAUJ1I2 and uses the clock source mentioned in PortClockSource5 parameter of SamplingClockSourceSelection container.
          enumeration PortSameLevelSamples: {TWO_SAMPLES, THREE_SAMPLES, FOUR_SAMPLES, FIVE_SAMPLES}, set at post-build, origin=Renesas_v1.0.0, default-value=TWO_SAMPLES  # This parameter specifies the number of same level samples, i.e. the number of samples with the same level to judge an external signal pulse as valid. TWO_SAMPLES: Two samples are enabled. THREE_SAMPLES: Three samples are enabled. FOUR_SAMPLES: Four samples are enabled. FIVE_SAMPLES: Five samples are enabled.
          enumeration PortSamplingClockFrequency: {DNFATCKI_DIV_BY_1, DNFATCKI_DIV_BY_2}, set at post-build, origin=Renesas_v1.0.0, default-value=DNFATCKI_DIV_BY_1  # This parameter specifies the Digital filter sampling clock frequency. DNFATCKI_DIV_BY_1: DNFATCKI / 1 clock frequency is enabled. DNFATCKI_DIV_BY_2: DNFATCKI / 2 clock frequency is enabled.
          enumeration PortDigitalFilterEnableInput0: {FIXED_LOW_LEVEL, BYPASSED}, set at post-build, origin=Renesas_v1.0.0, default-value=FIXED_LOW_LEVEL  # This parameter enables/disables for the signal TAUJ1I2. FIXED_LOW_LEVEL: Fixed low level output signal is enabled. BYPASSED: Filter bypass is enabled.
        container PortDigitalFilterGroup27 [0..1]  # This container contains the Port Digital Filter Functionality for the signals TAUJ1I3 and uses the clock source mentioned in PortClockSource5 parameter of SamplingClockSourceSelection container.
          enumeration PortSameLevelSamples: {TWO_SAMPLES, THREE_SAMPLES, FOUR_SAMPLES, FIVE_SAMPLES}, set at post-build, origin=Renesas_v1.0.0, default-value=TWO_SAMPLES  # This parameter specifies the number of same level samples, i.e. the number of samples with the same level to judge an external signal pulse as valid. TWO_SAMPLES: Two samples are enabled. THREE_SAMPLES: Three samples are enabled. FOUR_SAMPLES: Four samples are enabled. FIVE_SAMPLES: Five samples are enabled.
          enumeration PortSamplingClockFrequency: {DNFATCKI_DIV_BY_1, DNFATCKI_DIV_BY_2}, set at post-build, origin=Renesas_v1.0.0, default-value=DNFATCKI_DIV_BY_1  # This parameter specifies the Digital filter sampling clock frequency. DNFATCKI_DIV_BY_1: DNFATCKI / 1 clock frequency is enabled. DNFATCKI_DIV_BY_2: DNFATCKI / 2 clock frequency is enabled.
          enumeration PortDigitalFilterEnableInput0: {FIXED_LOW_LEVEL, BYPASSED}, set at post-build, origin=Renesas_v1.0.0, default-value=FIXED_LOW_LEVEL  # This parameter enables/disables for the signal TAUJ1I3. FIXED_LOW_LEVEL: Fixed low level output signal is enabled. BYPASSED: Filter bypass is enabled.
        container PortDigitalFilterGroup28 [0..1]  # This container contains the Port Digital Filter Functionality for the signals TAUJ2I0 and uses the clock source mentioned in PortClockSource6 parameter of SamplingClockSourceSelection container.
          enumeration PortSameLevelSamples: {TWO_SAMPLES, THREE_SAMPLES, FOUR_SAMPLES, FIVE_SAMPLES}, set at post-build, origin=Renesas_v1.0.0, default-value=TWO_SAMPLES  # This parameter specifies the number of same level samples, i.e. the number of samples with the same level to judge an external signal pulse as valid. TWO_SAMPLES: Two samples are enabled. THREE_SAMPLES: Three samples are enabled. FOUR_SAMPLES: Four samples are enabled. FIVE_SAMPLES: Five samples are enabled.
          enumeration PortSamplingClockFrequency: {DNFATCKI_DIV_BY_1, DNFATCKI_DIV_BY_2}, set at post-build, origin=Renesas_v1.0.0, default-value=DNFATCKI_DIV_BY_1  # This parameter specifies the Digital filter sampling clock frequency. DNFATCKI_DIV_BY_1: DNFATCKI / 1 clock frequency is enabled. DNFATCKI_DIV_BY_2: DNFATCKI / 2 clock frequency is enabled.
          enumeration PortDigitalFilterEnableInput0: {FIXED_LOW_LEVEL, BYPASSED}, set at post-build, origin=Renesas_v1.0.0, default-value=FIXED_LOW_LEVEL  # This parameter enables/disables for the signal TAUJ2I0. FIXED_LOW_LEVEL: Fixed low level output signal is enabled. BYPASSED: Filter bypass is enabled.
        container PortDigitalFilterGroup29 [0..1]  # This container contains the Port Digital Filter Functionality for the signals TAUJ2I1 and uses the clock source mentioned in PortClockSource6 parameter of SamplingClockSourceSelection container.
          enumeration PortSameLevelSamples: {TWO_SAMPLES, THREE_SAMPLES, FOUR_SAMPLES, FIVE_SAMPLES}, set at post-build, origin=Renesas_v1.0.0, default-value=TWO_SAMPLES  # This parameter specifies the number of same level samples, i.e. the number of samples with the same level to judge an external signal pulse as valid. TWO_SAMPLES: Two samples are enabled. THREE_SAMPLES: Three samples are enabled. FOUR_SAMPLES: Four samples are enabled. FIVE_SAMPLES: Five samples are enabled.
          enumeration PortSamplingClockFrequency: {DNFATCKI_DIV_BY_1, DNFATCKI_DIV_BY_2}, set at post-build, origin=Renesas_v1.0.0, default-value=DNFATCKI_DIV_BY_1  # This parameter specifies the Digital filter sampling clock frequency. DNFATCKI_DIV_BY_1: DNFATCKI / 1 clock frequency is enabled. DNFATCKI_DIV_BY_2: DNFATCKI / 2 clock frequency is enabled.
          enumeration PortDigitalFilterEnableInput0: {FIXED_LOW_LEVEL, BYPASSED}, set at post-build, origin=Renesas_v1.0.0, default-value=FIXED_LOW_LEVEL  # This parameter enables/disables for the signal TAUJ2I1. FIXED_LOW_LEVEL: Fixed low level output signal is enabled. BYPASSED: Filter bypass is enabled.
        container PortDigitalFilterGroup30 [0..1]  # This container contains the Port Digital Filter Functionality for the signals TAUJ2I2 and uses the clock source mentioned in PortClockSource6 parameter of SamplingClockSourceSelection container.
          enumeration PortSameLevelSamples: {TWO_SAMPLES, THREE_SAMPLES, FOUR_SAMPLES, FIVE_SAMPLES}, set at post-build, origin=Renesas_v1.0.0, default-value=TWO_SAMPLES  # This parameter specifies the number of same level samples, i.e. the number of samples with the same level to judge an external signal pulse as valid. TWO_SAMPLES: Two samples are enabled. THREE_SAMPLES: Three samples are enabled. FOUR_SAMPLES: Four samples are enabled. FIVE_SAMPLES: Five samples are enabled.
          enumeration PortSamplingClockFrequency: {DNFATCKI_DIV_BY_1, DNFATCKI_DIV_BY_2}, set at post-build, origin=Renesas_v1.0.0, default-value=DNFATCKI_DIV_BY_1  # This parameter specifies the Digital filter sampling clock frequency. DNFATCKI_DIV_BY_1: DNFATCKI / 1 clock frequency is enabled. DNFATCKI_DIV_BY_2: DNFATCKI / 2 clock frequency is enabled.
          enumeration PortDigitalFilterEnableInput0: {FIXED_LOW_LEVEL, BYPASSED}, set at post-build, origin=Renesas_v1.0.0, default-value=FIXED_LOW_LEVEL  # This parameter enables/disables for the signal TAUJ2I2. FIXED_LOW_LEVEL: Fixed low level output signal is enabled. BYPASSED: Filter bypass is enabled.
        container PortDigitalFilterGroup31 [0..1]  # This container contains the Port Digital Filter Functionality for the signals TAUJ2I3 and uses the clock source mentioned in PortClockSource6 parameter of SamplingClockSourceSelection container.
          enumeration PortSameLevelSamples: {TWO_SAMPLES, THREE_SAMPLES, FOUR_SAMPLES, FIVE_SAMPLES}, set at post-build, origin=Renesas_v1.0.0, default-value=TWO_SAMPLES  # This parameter specifies the number of same level samples, i.e. the number of samples with the same level to judge an external signal pulse as valid. TWO_SAMPLES: Two samples are enabled. THREE_SAMPLES: Three samples are enabled. FOUR_SAMPLES: Four samples are enabled. FIVE_SAMPLES: Five samples are enabled.
          enumeration PortSamplingClockFrequency: {DNFATCKI_DIV_BY_1, DNFATCKI_DIV_BY_2}, set at post-build, origin=Renesas_v1.0.0, default-value=DNFATCKI_DIV_BY_1  # This parameter specifies the Digital filter sampling clock frequency. DNFATCKI_DIV_BY_1: DNFATCKI / 1 clock frequency is enabled. DNFATCKI_DIV_BY_2: DNFATCKI / 2 clock frequency is enabled.
          enumeration PortDigitalFilterEnableInput0: {FIXED_LOW_LEVEL, BYPASSED}, set at post-build, origin=Renesas_v1.0.0, default-value=FIXED_LOW_LEVEL  # This parameter enables/disables for the signal TAUJ2I3. FIXED_LOW_LEVEL: Fixed low level output signal is enabled. BYPASSED: Filter bypass is enabled.
        container PortDigitalFilterGroup32 [0..1]  # This container contains the Port Digital Filter Functionality for the signals TSG30PTSI0/ENCA0E0 or TSG30PTSI1/ENCA0E1 and uses the clock source mentioned in PortClockSource7 parameter of SamplingClockSourceSelection container.
          enumeration PortSameLevelSamples: {TWO_SAMPLES, THREE_SAMPLES, FOUR_SAMPLES, FIVE_SAMPLES}, set at post-build, origin=Renesas_v1.0.0, default-value=TWO_SAMPLES  # This parameter specifies the number of same level samples, i.e. the number of samples with the same level to judge an external signal pulse as valid. TWO_SAMPLES: Two samples are enabled. THREE_SAMPLES: Three samples are enabled. FOUR_SAMPLES: Four samples are enabled. FIVE_SAMPLES: Five samples are enabled.
          enumeration PortSamplingClockFrequency: {DNFATCKI_DIV_BY_1, DNFATCKI_DIV_BY_2}, set at post-build, origin=Renesas_v1.0.0, default-value=DNFATCKI_DIV_BY_1  # This parameter specifies the Digital filter sampling clock frequency. DNFATCKI_DIV_BY_1: DNFATCKI / 1 clock frequency is enabled. DNFATCKI_DIV_BY_2: DNFATCKI / 2 clock frequency is enabled.
          enumeration PortDigitalFilterEnableInput0: {FIXED_LOW_LEVEL, BYPASSED}, set at post-build, origin=Renesas_v1.0.0, default-value=FIXED_LOW_LEVEL  # This parameter enables/disables for the signal TSG30PTSI0/ENCA0E0. FIXED_LOW_LEVEL: Fixed low level output signal is enabled. BYPASSED: Filter bypass is enabled.
          enumeration PortDigitalFilterEnableInput1: {FIXED_LOW_LEVEL, BYPASSED}, set at post-build, origin=Renesas_v1.0.0, default-value=FIXED_LOW_LEVEL  # This parameter enables/disables for the signal TSG30PTSI1/ENCA0E1. FIXED_LOW_LEVEL: Fixed low level output signal is enabled. BYPASSED: Filter bypass is enabled.
        container PortDigitalFilterGroup33 [0..1]  # This container contains the Port Digital Filter Functionality for the signals TSG30PTSI2/ENCA0EC and uses the clock source mentioned in PortClockSource7 parameter of SamplingClockSourceSelection container.
          enumeration PortSameLevelSamples: {TWO_SAMPLES, THREE_SAMPLES, FOUR_SAMPLES, FIVE_SAMPLES}, set at post-build, origin=Renesas_v1.0.0, default-value=TWO_SAMPLES  # This parameter specifies the number of same level samples, i.e. the number of samples with the same level to judge an external signal pulse as valid. TWO_SAMPLES: Two samples are enabled. THREE_SAMPLES: Three samples are enabled. FOUR_SAMPLES: Four samples are enabled. FIVE_SAMPLES: Five samples are enabled.
          enumeration PortSamplingClockFrequency: {DNFATCKI_DIV_BY_1, DNFATCKI_DIV_BY_2}, set at post-build, origin=Renesas_v1.0.0, default-value=DNFATCKI_DIV_BY_1  # This parameter specifies the Digital filter sampling clock frequency. DNFATCKI_DIV_BY_1: DNFATCKI / 1 clock frequency is enabled. DNFATCKI_DIV_BY_2: DNFATCKI / 2 clock frequency is enabled.
          enumeration PortDigitalFilterEnableInput0: {FIXED_LOW_LEVEL, BYPASSED}, set at post-build, origin=Renesas_v1.0.0, default-value=FIXED_LOW_LEVEL  # This parameter enables/disables for the signal TSG30PTSI2/ENCA0EC. FIXED_LOW_LEVEL: Fixed low level output signal is enabled. BYPASSED: Filter bypass is enabled.
        container PortDigitalFilterGroup34 [0..1]  # This container contains the Port Digital Filter Functionality for the signals TSG30CLKI and uses the clock source mentioned in PortClockSource7 parameter of SamplingClockSourceSelection container.
          enumeration PortSameLevelSamples: {TWO_SAMPLES, THREE_SAMPLES, FOUR_SAMPLES, FIVE_SAMPLES}, set at post-build, origin=Renesas_v1.0.0, default-value=TWO_SAMPLES  # This parameter specifies the number of same level samples, i.e. the number of samples with the same level to judge an external signal pulse as valid. TWO_SAMPLES: Two samples are enabled. THREE_SAMPLES: Three samples are enabled. FOUR_SAMPLES: Four samples are enabled. FIVE_SAMPLES: Five samples are enabled.
          enumeration PortSamplingClockFrequency: {DNFATCKI_DIV_BY_1, DNFATCKI_DIV_BY_2}, set at post-build, origin=Renesas_v1.0.0, default-value=DNFATCKI_DIV_BY_1  # This parameter specifies the Digital filter sampling clock frequency. DNFATCKI_DIV_BY_1: DNFATCKI / 1 clock frequency is enabled. DNFATCKI_DIV_BY_2: DNFATCKI / 2 clock frequency is enabled.
          enumeration PortDigitalFilterEnableInput0: {FIXED_LOW_LEVEL, BYPASSED}, set at post-build, origin=Renesas_v1.0.0, default-value=FIXED_LOW_LEVEL  # This parameter enables/disables for the signal TSG30CLKI. FIXED_LOW_LEVEL: Fixed low level output signal is enabled. BYPASSED: Filter bypass is enabled.
        container PortDigitalFilterGroup35 [0..1]  # This container contains the Port Digital Filter Functionality for the signals TSG31PTSI0/ENCA1E0 or TSG31PTSI1/ENCA1E1 and uses the clock source mentioned in PortClockSource8 parameter of SamplingClockSourceSelection container.
          enumeration PortSameLevelSamples: {TWO_SAMPLES, THREE_SAMPLES, FOUR_SAMPLES, FIVE_SAMPLES}, set at post-build, origin=Renesas_v1.0.0, default-value=TWO_SAMPLES  # This parameter specifies the number of same level samples, i.e. the number of samples with the same level to judge an external signal pulse as valid. TWO_SAMPLES: Two samples are enabled. THREE_SAMPLES: Three samples are enabled. FOUR_SAMPLES: Four samples are enabled. FIVE_SAMPLES: Five samples are enabled.
          enumeration PortSamplingClockFrequency: {DNFATCKI_DIV_BY_1, DNFATCKI_DIV_BY_2}, set at post-build, origin=Renesas_v1.0.0, default-value=DNFATCKI_DIV_BY_1  # This parameter specifies the Digital filter sampling clock frequency. DNFATCKI_DIV_BY_1: DNFATCKI / 1 clock frequency is enabled. DNFATCKI_DIV_BY_2: DNFATCKI / 2 clock frequency is enabled.
          enumeration PortDigitalFilterEnableInput0: {FIXED_LOW_LEVEL, BYPASSED}, set at post-build, origin=Renesas_v1.0.0, default-value=FIXED_LOW_LEVEL  # This parameter enables/disables for the signal TSG31PTSI0/ENCA1E0. FIXED_LOW_LEVEL: Fixed low level output signal is enabled. BYPASSED: Filter bypass is enabled.
          enumeration PortDigitalFilterEnableInput1: {FIXED_LOW_LEVEL, BYPASSED}, set at post-build, origin=Renesas_v1.0.0, default-value=FIXED_LOW_LEVEL  # This parameter enables/disables for the signal TSG31PTSI1/ENCA1E1. FIXED_LOW_LEVEL: Fixed low level output signal is enabled. BYPASSED: Filter bypass is enabled.
        container PortDigitalFilterGroup36 [0..1]  # This container contains the Port Digital Filter Functionality for the signals TSG31PTSI2/ENCA1EC and uses the clock source mentioned in PortClockSource8 parameter of SamplingClockSourceSelection container.
          enumeration PortSameLevelSamples: {TWO_SAMPLES, THREE_SAMPLES, FOUR_SAMPLES, FIVE_SAMPLES}, set at post-build, origin=Renesas_v1.0.0, default-value=TWO_SAMPLES  # This parameter specifies the number of same level samples, i.e. the number of samples with the same level to judge an external signal pulse as valid. TWO_SAMPLES: Two samples are enabled. THREE_SAMPLES: Three samples are enabled. FOUR_SAMPLES: Four samples are enabled. FIVE_SAMPLES: Five samples are enabled.
          enumeration PortSamplingClockFrequency: {DNFATCKI_DIV_BY_1, DNFATCKI_DIV_BY_2}, set at post-build, origin=Renesas_v1.0.0, default-value=DNFATCKI_DIV_BY_1  # This parameter specifies the Digital filter sampling clock frequency. DNFATCKI_DIV_BY_1: DNFATCKI / 1 clock frequency is enabled. DNFATCKI_DIV_BY_2: DNFATCKI / 2 clock frequency is enabled.
          enumeration PortDigitalFilterEnableInput0: {FIXED_LOW_LEVEL, BYPASSED}, set at post-build, origin=Renesas_v1.0.0, default-value=FIXED_LOW_LEVEL  # This parameter enables/disables for the signal TSG31PTSI2/ENCA1EC. FIXED_LOW_LEVEL: Fixed low level output signal is enabled. BYPASSED: Filter bypass is enabled.
        container PortDigitalFilterGroup37 [0..1]  # This container contains the Port Digital Filter Functionality for the signals TSG31CLKI and uses the clock source mentioned in PortClockSource8 parameter of SamplingClockSourceSelection container.
          enumeration PortSameLevelSamples: {TWO_SAMPLES, THREE_SAMPLES, FOUR_SAMPLES, FIVE_SAMPLES}, set at post-build, origin=Renesas_v1.0.0, default-value=TWO_SAMPLES  # This parameter specifies the number of same level samples, i.e. the number of samples with the same level to judge an external signal pulse as valid. TWO_SAMPLES: Two samples are enabled. THREE_SAMPLES: Three samples are enabled. FOUR_SAMPLES: Four samples are enabled. FIVE_SAMPLES: Five samples are enabled.
          enumeration PortSamplingClockFrequency: {DNFATCKI_DIV_BY_1, DNFATCKI_DIV_BY_2}, set at post-build, origin=Renesas_v1.0.0, default-value=DNFATCKI_DIV_BY_1  # This parameter specifies the Digital filter sampling clock frequency. DNFATCKI_DIV_BY_1: DNFATCKI / 1 clock frequency is enabled. DNFATCKI_DIV_BY_2: DNFATCKI / 2 clock frequency is enabled.
          enumeration PortDigitalFilterEnableInput0: {FIXED_LOW_LEVEL, BYPASSED}, set at post-build, origin=Renesas_v1.0.0, default-value=FIXED_LOW_LEVEL  # This parameter enables/disables for the signal TSG31CLKI. FIXED_LOW_LEVEL: Fixed low level output signal is enabled. BYPASSED: Filter bypass is enabled.
        container PortDigitalFilterGroup38 [0..1]  # This container contains the Port Digital Filter Functionality for the signals ENCA0I0 or ENCA0I1 uses the clock source mentioned in PortClockSource7 parameter of SamplingClockSourceSelection container.
          enumeration PortSameLevelSamples: {TWO_SAMPLES, THREE_SAMPLES, FOUR_SAMPLES, FIVE_SAMPLES}, set at post-build, origin=Renesas_v1.0.0, default-value=TWO_SAMPLES  # This parameter specifies the number of same level samples, i.e. the number of samples with the same level to judge an external signal pulse as valid. TWO_SAMPLES: Two samples are enabled. THREE_SAMPLES: Three samples are enabled. FOUR_SAMPLES: Four samples are enabled. FIVE_SAMPLES: Five samples are enabled.
          enumeration PortSamplingClockFrequency: {DNFATCKI_DIV_BY_1, DNFATCKI_DIV_BY_2}, set at post-build, origin=Renesas_v1.0.0, default-value=DNFATCKI_DIV_BY_1  # This parameter specifies the Digital filter sampling clock frequency. DNFATCKI_DIV_BY_1: DNFATCKI / 1 clock frequency is enabled. DNFATCKI_DIV_BY_2: DNFATCKI / 2 clock frequency is enabled.
          enumeration PortDigitalFilterEnableInput0: {FIXED_LOW_LEVEL, BYPASSED}, set at post-build, origin=Renesas_v1.0.0, default-value=FIXED_LOW_LEVEL  # This parameter enables/disables for the signal ENCA0I0. FIXED_LOW_LEVEL: Fixed low level output signal is enabled. BYPASSED: Filter bypass is enabled.
          enumeration PortDigitalFilterEnableInput1: {FIXED_LOW_LEVEL, BYPASSED}, set at post-build, origin=Renesas_v1.0.0, default-value=FIXED_LOW_LEVEL  # This parameter enables/disables for the signal ENCA0I1. FIXED_LOW_LEVEL: Fixed low level output signal is enabled. BYPASSED: Filter bypass is enabled.
        container PortDigitalFilterGroup39 [0..1]  # This container contains the Port Digital Filter Functionality for the signals ENCA1I0 or ENCA1I0 uses the clock source mentioned in PortClockSource8 parameter of SamplingClockSourceSelection container.
          enumeration PortSameLevelSamples: {TWO_SAMPLES, THREE_SAMPLES, FOUR_SAMPLES, FIVE_SAMPLES}, set at post-build, origin=Renesas_v1.0.0, default-value=TWO_SAMPLES  # This parameter specifies the number of same level samples, i.e. the number of samples with the same level to judge an external signal pulse as valid. TWO_SAMPLES: Two samples are enabled. THREE_SAMPLES: Three samples are enabled. FOUR_SAMPLES: Four samples are enabled. FIVE_SAMPLES: Five samples are enabled.
          enumeration PortSamplingClockFrequency: {DNFATCKI_DIV_BY_1, DNFATCKI_DIV_BY_2}, set at post-build, origin=Renesas_v1.0.0, default-value=DNFATCKI_DIV_BY_1  # This parameter specifies the Digital filter sampling clock frequency. DNFATCKI_DIV_BY_1: DNFATCKI / 1 clock frequency is enabled. DNFATCKI_DIV_BY_2: DNFATCKI / 2 clock frequency is enabled.
          enumeration PortDigitalFilterEnableInput0: {FIXED_LOW_LEVEL, BYPASSED}, set at post-build, origin=Renesas_v1.0.0, default-value=FIXED_LOW_LEVEL  # This parameter enables/disables for the signal ENCA1I0. FIXED_LOW_LEVEL: Fixed low level output signal is enabled. BYPASSED: Filter bypass is enabled.
          enumeration PortDigitalFilterEnableInput1: {FIXED_LOW_LEVEL, BYPASSED}, set at post-build, origin=Renesas_v1.0.0, default-value=FIXED_LOW_LEVEL  # This parameter enables/disables for the signal ENCA1I0. FIXED_LOW_LEVEL: Fixed low level output signal is enabled. BYPASSED: Filter bypass is enabled.
        container PortDigitalFilterGroup40 [0..1]  # This container contains the Port Digital Filter Functionality for the signals CSIG0RYI, CSIH0RYI, CSIH1RYI, CSIH2RYI or CSIH3RYI and uses the clock source mentioned in PortClockSource9 parameter of SamplingClockSourceSelection container.
          enumeration PortSameLevelSamples: {TWO_SAMPLES, THREE_SAMPLES, FOUR_SAMPLES, FIVE_SAMPLES}, set at post-build, origin=Renesas_v1.0.0, default-value=TWO_SAMPLES  # This parameter specifies the number of same level samples, i.e. the number of samples with the same level to judge an external signal pulse as valid. TWO_SAMPLES: Two samples are enabled. THREE_SAMPLES: Three samples are enabled. FOUR_SAMPLES: Four samples are enabled. FIVE_SAMPLES: Five samples are enabled.
          enumeration PortSamplingClockFrequency: {DNFATCKI_DIV_BY_1, DNFATCKI_DIV_BY_2}, set at post-build, origin=Renesas_v1.0.0, default-value=DNFATCKI_DIV_BY_1  # This parameter specifies the Digital filter sampling clock frequency. DNFATCKI_DIV_BY_1: DNFATCKI / 1 clock frequency is enabled. DNFATCKI_DIV_BY_2: DNFATCKI / 2 clock frequency is enabled.
          enumeration PortDigitalFilterEnableInput0: {FIXED_LOW_LEVEL, BYPASSED}, set at post-build, origin=Renesas_v1.0.0, default-value=FIXED_LOW_LEVEL  # This parameter enables/disables for the signal CSIG0RYI. FIXED_LOW_LEVEL: Fixed low level output signal is enabled. BYPASSED: Filter bypass is enabled.
          enumeration PortDigitalFilterEnableInput1: {FIXED_LOW_LEVEL, BYPASSED}, set at post-build, origin=Renesas_v1.0.0, default-value=FIXED_LOW_LEVEL  # This parameter enables/disables for the signal CSIH0RYI. FIXED_LOW_LEVEL: Fixed low level output signal is enabled. BYPASSED: Filter bypass is enabled.
          enumeration PortDigitalFilterEnableInput2: {FIXED_LOW_LEVEL, BYPASSED}, set at post-build, origin=Renesas_v1.0.0, default-value=FIXED_LOW_LEVEL  # This parameter enables/disables for the signal CSIH1RYI. FIXED_LOW_LEVEL: Fixed low level output signal is enabled. BYPASSED: Filter bypass is enabled.
          enumeration PortDigitalFilterEnableInput3: {FIXED_LOW_LEVEL, BYPASSED}, set at post-build, origin=Renesas_v1.0.0, default-value=FIXED_LOW_LEVEL  # This parameter enables/disables for the signal CSIH2RYI. FIXED_LOW_LEVEL: Fixed low level output signal is enabled. BYPASSED: Filter bypass is enabled.
          enumeration PortDigitalFilterEnableInput4: {FIXED_LOW_LEVEL, BYPASSED}, set at post-build, origin=Renesas_v1.0.0, default-value=FIXED_LOW_LEVEL  # This parameter enables/disables for the signal CSIH3RYI. FIXED_LOW_LEVEL: Fixed low level output signal is enabled. BYPASSED: Filter bypass is enabled.
        container PortDigitalFilterGroup41 [0..1]  # This container contains the Port Digital Filter Functionality for the signals ADCDTRG0 or ADCDTRG1 and uses the clock source mentioned in PortClockSource10 parameter of SamplingClockSourceSelection container.
          enumeration PortSameLevelSamples: {TWO_SAMPLES, THREE_SAMPLES, FOUR_SAMPLES, FIVE_SAMPLES}, set at post-build, origin=Renesas_v1.0.0, default-value=TWO_SAMPLES  # This parameter specifies the number of same level samples, i.e. the number of samples with the same level to judge an external signal pulse as valid. TWO_SAMPLES: Two samples are enabled. THREE_SAMPLES: Three samples are enabled. FOUR_SAMPLES: Four samples are enabled. FIVE_SAMPLES: Five samples are enabled.
          enumeration PortSamplingClockFrequency: {DNFATCKI_DIV_BY_1, DNFATCKI_DIV_BY_2}, set at post-build, origin=Renesas_v1.0.0, default-value=DNFATCKI_DIV_BY_1  # This parameter specifies the Digital filter sampling clock frequency. DNFATCKI_DIV_BY_1: DNFATCKI / 1 clock frequency is enabled. DNFATCKI_DIV_BY_2: DNFATCKI / 2 clock frequency is enabled.
          enumeration PortDigitalFilterEnableInput0: {FIXED_LOW_LEVEL, BYPASSED}, set at post-build, origin=Renesas_v1.0.0, default-value=FIXED_LOW_LEVEL  # This parameter enables/disables for the signal ADCDTRG0. FIXED_LOW_LEVEL: Fixed low level output signal is enabled. BYPASSED: Filter bypass is enabled.
          enumeration PortDigitalFilterEnableInput1: {FIXED_LOW_LEVEL, BYPASSED}, set at post-build, origin=Renesas_v1.0.0, default-value=FIXED_LOW_LEVEL  # This parameter enables/disables for the signal ADCDTRG1. FIXED_LOW_LEVEL: Fixed low level output signal is enabled. BYPASSED: Filter bypass is enabled.
        container PortDigitalFilterGroup42 [0..1]  # This container contains the Port Digital Filter Functionality for the signals SENT0RX, SENT1RX, SENT2RX, SENT3RX, SENT4RX or SENT5RX an duses the clock source mentioned in PortClockSource11 parameter of SamplingClockSourceSelection container.
          enumeration PortSameLevelSamples: {TWO_SAMPLES, THREE_SAMPLES, FOUR_SAMPLES, FIVE_SAMPLES}, set at post-build, origin=Renesas_v1.0.0, default-value=TWO_SAMPLES  # This parameter specifies the number of same level samples, i.e. the number of samples with the same level to judge an external signal pulse as valid. TWO_SAMPLES: Two samples are enabled. THREE_SAMPLES: Three samples are enabled. FOUR_SAMPLES: Four samples are enabled. FIVE_SAMPLES: Five samples are enabled.
          enumeration PortSamplingClockFrequency: {DNFATCKI_DIV_BY_1, DNFATCKI_DIV_BY_2}, set at post-build, origin=Renesas_v1.0.0, default-value=DNFATCKI_DIV_BY_1  # This parameter specifies the Digital filter sampling clock frequency. DNFATCKI_DIV_BY_1: DNFATCKI / 1 clock frequency is enabled. DNFATCKI_DIV_BY_2: DNFATCKI / 2 clock frequency is enabled.
          enumeration PortDigitalFilterEnableInput0: {ENABLED_FCLA3CTL0, BYPASSED_FCLA3CTL0, DISABLED}, set at post-build, origin=Renesas_v1.0.0, default-value=DISABLED  # This parameter enables/disables for the signal SENT0RX. ENABLED;_CTL<Instance>: Filter is enabled. BYPASSED<Instance>_CTL<Instance>_ADC<Instance>: Filter bypass is enabled. DISABLED: Filter is disabled.
          enumeration PortDigitalFilterEdgeControl0: {RISING_FCLA3CTL0, FALLING_FCLA3CTL0, DISABLED}, set at post-build, origin=Renesas_v1.0.0, default-value=DISABLED  # This parameter enables/disables for the signal SENT0RX. | DISABLED: Digital noise elimination disabled. RISING_FCLA<Instance>_CTL<Instance>: Enables rising edge. FALLING_FCLA<Instance>_CTL<Instance>: Enables falling edge.
          enumeration PortDigitalFilterEnableInput1: {ENABLED_FCLA3CTL1, BYPASSED_FCLA3CTL1, DISABLED}, set at post-build, origin=Renesas_v1.0.0, default-value=DISABLED  # This parameter enables/disables for the signal SENT1RX. ENABLED;_CTL<Instance>: Filter is enabled. BYPASSED<Instance>_CTL<Instance>_ADC<Instance>: Filter bypass is enabled. DISABLED: Filter is disabled.
          enumeration PortDigitalFilterEdgeControl1: {RISING_FCLA3CTL1, FALLING_FCLA3CTL1, DISABLED}, set at post-build, origin=Renesas_v1.0.0, default-value=DISABLED  # This parameter enables/disables for the signal SENT1RX. | DISABLED: Digital noise elimination disabled. RISING_FCLA<Instance>_CTL<Instance>: Enables rising edge. FALLING_FCLA<Instance>_CTL<Instance>: Enables falling edge.
          enumeration PortDigitalFilterEnableInput2: {ENABLED_FCLA3CTL2, BYPASSED_FCLA3CTL2, DISABLED}, set at post-build, origin=Renesas_v1.0.0, default-value=DISABLED  # This parameter enables/disables for the signal SENT2RX. ENABLED;_CTL<Instance>: Filter is enabled. BYPASSED<Instance>_CTL<Instance>_ADC<Instance>: Filter bypass is enabled. DISABLED: Filter is disabled.
          enumeration PortDigitalFilterEdgeControl2: {RISING_FCLA3CTL2, FALLING_FCLA3CTL2, DISABLED}, set at post-build, origin=Renesas_v1.0.0, default-value=DISABLED  # This parameter enables/disables for the signal SENT2RX. | DISABLED: Digital noise elimination disabled. RISING_FCLA<Instance>_CTL<Instance>: Enables rising edge. FALLING_FCLA<Instance>_CTL<Instance>: Enables falling edge.
          enumeration PortDigitalFilterEnableInput3: {ENABLED_FCLA3CTL3, BYPASSED_FCLA3CTL3, DISABLED}, set at post-build, origin=Renesas_v1.0.0, default-value=DISABLED  # This parameter enables/disables for the signal SENT3RX. ENABLED;_CTL<Instance>: Filter is enabled. BYPASSED<Instance>_CTL<Instance>_ADC<Instance>: Filter bypass is enabled. DISABLED: Filter is disabled.
          enumeration PortDigitalFilterEdgeControl3: {RISING_FCLA3CTL3, FALLING_FCLA3CTL3, DISABLED}, set at post-build, origin=Renesas_v1.0.0, default-value=DISABLED  # This parameter enables/disables for the signal SENT3RX. | DISABLED: Digital noise elimination disabled. RISING_FCLA<Instance>_CTL<Instance>: Enables rising edge. FALLING_FCLA<Instance>_CTL<Instance>: Enables falling edge.
          enumeration PortDigitalFilterEnableInput4: {ENABLED_FCLA3CTL4, BYPASSED_FCLA3CTL4, DISABLED}, set at post-build, origin=Renesas_v1.0.0, default-value=DISABLED  # This parameter enables/disables for the signal SENT4RX. ENABLED;_CTL<Instance>: Filter is enabled. BYPASSED<Instance>_CTL<Instance>_ADC<Instance>: Filter bypass is enabled. DISABLED: Filter is disabled.
          enumeration PortDigitalFilterEdgeControl4: {RISING_FCLA3CTL4, FALLING_FCLA3CTL4, DISABLED}, set at post-build, origin=Renesas_v1.0.0, default-value=DISABLED  # This parameter enables/disables for the signal SENT4RX. | DISABLED: Digital noise elimination disabled. RISING_FCLA<Instance>_CTL<Instance>: Enables rising edge. FALLING_FCLA<Instance>_CTL<Instance>: Enables falling edge.
          enumeration PortDigitalFilterEnableInput5: {ENABLED_FCLA3CTL5, BYPASSED_FCLA3CTL5, DISABLED}, set at post-build, origin=Renesas_v1.0.0, default-value=DISABLED  # This parameter enables/disables for the signal SENT5RX. ENABLED;_CTL<Instance>: Filter is enabled. BYPASSED<Instance>_CTL<Instance>_ADC<Instance>: Filter bypass is enabled. DISABLED: Filter is disabled.
          enumeration PortDigitalFilterEdgeControl5: {RISING_FCLA3CTL5, FALLING_FCLA3CTL5, DISABLED}, set at post-build, origin=Renesas_v1.0.0, default-value=DISABLED  # This parameter enables/disables for the signal SENT5RX. | DISABLED: Digital noise elimination disabled. RISING_FCLA<Instance>_CTL<Instance>: Enables rising edge. FALLING_FCLA<Instance>_CTL<Instance>: Enables falling edge.
        container PortDigitalFilterGroup43 [0..1]  # This container contains the Port Digital Filter Functionality for the signals PSI50DIN or PSI51DIN and uses the clock source mentioned in PortClockSource12 parameter of SamplingClockSourceSelection container.
          enumeration PortSameLevelSamples: {TWO_SAMPLES, THREE_SAMPLES, FOUR_SAMPLES, FIVE_SAMPLES}, set at post-build, origin=Renesas_v1.0.0, default-value=TWO_SAMPLES  # This parameter specifies the number of same level samples, i.e. the number of samples with the same level to judge an external signal pulse as valid. TWO_SAMPLES: Two samples are enabled. THREE_SAMPLES: Three samples are enabled. FOUR_SAMPLES: Four samples are enabled. FIVE_SAMPLES: Five samples are enabled.
          enumeration PortSamplingClockFrequency: {DNFATCKI_DIV_BY_1, DNFATCKI_DIV_BY_2}, set at post-build, origin=Renesas_v1.0.0, default-value=DNFATCKI_DIV_BY_1  # This parameter specifies the Digital filter sampling clock frequency. DNFATCKI_DIV_BY_1: DNFATCKI / 1 clock frequency is enabled. DNFATCKI_DIV_BY_2: DNFATCKI / 2 clock frequency is enabled.
          enumeration PortDigitalFilterEnableInput0: {ENABLED_FCLA4CTL0, BYPASSED_FCLA4CTL0, DISABLED}, set at post-build, origin=Renesas_v1.0.0, default-value=DISABLED  # This parameter enables/disables for the signal PSI50DIN. ENABLED;_CTL<Instance>: Filter is enabled. BYPASSED<Instance>_CTL<Instance>_ADC<Instance>: Filter bypass is enabled. DISABLED: Filter is disabled.
          enumeration PortDigitalFilterEdgeControl0: {RISING_FCLA4CTL0, FALLING_FCLA4CTL0, DISABLED}, set at post-build, origin=Renesas_v1.0.0, default-value=DISABLED  # This parameter enables/disables for the signal PSI50DIN. | DISABLED: Digital noise elimination disabled. RISING_FCLA<Instance>_CTL<Instance>: Enables rising edge. FALLING_FCLA<Instance>_CTL<Instance>: Enables falling edge.
          enumeration PortDigitalFilterEnableInput1: {ENABLED_FCLA4CTL1, BYPASSED_FCLA4CTL1, DISABLED}, set at post-build, origin=Renesas_v1.0.0, default-value=DISABLED  # This parameter enables/disables for the signal PSI51DIN. ENABLED;_CTL<Instance>: Filter is enabled. BYPASSED<Instance>_CTL<Instance>_ADC<Instance>: Filter bypass is enabled. DISABLED: Filter is disabled.
          enumeration PortDigitalFilterEdgeControl1: {RISING_FCLA4CTL1, FALLING_FCLA4CTL1, DISABLED}, set at post-build, origin=Renesas_v1.0.0, default-value=DISABLED  # This parameter enables/disables for the signal PSI51DIN. | DISABLED: Digital noise elimination disabled. RISING_FCLA<Instance>_CTL<Instance>: Enables rising edge. FALLING_FCLA<Instance>_CTL<Instance>: Enables falling edge.
      container PortGroup0  # This container contains the configuration (parameters) for Port Group 0.
        container PortPin0  # This container contains the configuration (parameters) for Port Pin 0.
          boolean PortPinDirectionChangeable: set at post-build, origin=Renesas_v1.0.0, default-value=false  # Parameter to indicate if the direction is changeable on a port pin during runtime. true: Port Pin direction changeable enabled. false: Port Pin direction changeable disabled.
          boolean PortPinDioAltModeChangeable: set at post-build, origin=Renesas_v1.0.0, default-value=false  # Parameter to indicate if the mode of a port pin is changeable between DIO and Alternate during runtime by API functions Port_SetToDioMode and Port_SetToAlternateMode. Including these APIs is controlled by PortSetToDioAltModeApi. true: Dio Alternate mode is changeable. false: Dio Alternate mode is not changeable.
          boolean PortPinModeChangeable: set at post-build, origin=Renesas_v1.0.0, default-value=false  # Parameter to indicate if the mode of a port pin is changeable during runtime by API function Port_SetPinMode. Including this API is controlled by PortSetPinModeApi. true: Port Pin mode is changeable. false: Port Pin mode is not changeable.
          enumeration PortPinLevelValue: {PORT_PIN_LEVEL_LOW, PORT_PIN_LEVEL_HIGH}, set at post-build, origin=Renesas_v1.0.0, default-value=PORT_PIN_LEVEL_LOW  # Parameter to indicate port pin level value for a port pin. PORT_PIN_LEVEL_LOW: Port pin Level is low. PORT_PIN_LEVEL_HIGH: Port pin Level is high.
          enumeration PortPinInitialMode: {TAUJ0I1_ALT1_IN, TAUJ0O1_ALT1_OUT, SENT3SPCO_ALT2_OUT, TAUD1ODI14_ALT3_IN, TAUD1O14_ALT3_OUT, ADCD0CNV2_ALT4_OUT, PSI50DOUT_ALT5_OUT, RLIN30TX_ALT6_OUT, DIO}, set at post-build, origin=Renesas_v1.0.0, default-value=DIO  # Mode of the port pin for use with Port_Init() function. <Input name>_ALT<Alternative instance>_IN: Provides alternative instance for selected input. <Output name>_ALT<Alternative instance>_OUT: Provides alternative instance for selected output.
          enumeration PortPinDirection: {PORT_PIN_OUT, PORT_PIN_IN}, set at post-build, origin=Renesas_v1.0.0, default-value=PORT_PIN_IN  # The initial direction of the pin (IN or OUT). If the direction is not changeable, the value configured here is fixed. The direction must match the pin mode. PORT_PIN_IN: Port pin direction set as input. PORT_PIN_OUT: Port pin direction set as output.
          boolean PortInputBufferControl: set at post-build, origin=Renesas_v1.0.0, default-value=false  # This parameter is used as one of the factors to enable/disable port pins input buffer in DIO Mode (PMC=0). true: Port pin's input buffer is ready to be enabled in DIO Mode. false: Port pin's input buffer is disabled in DIO Mode.
          boolean PortBiDirectionControl: set at post-build, origin=Renesas_v1.0.0, default-value=false  # This parameter forces port pins input buffer and output buffer at the same time. If activated, the effect is valid independently from any other port settings. true: Activate forced Bi-directional IO buffer of the port pin. false: Deactivate forced Bi-directional IO buffer of the port pin.
          boolean PortPullUpOption: set at post-build, origin=Renesas_v1.0.0, default-value=false  # This register switches on or off the port pins pull-up resistor. true: Port pin's pull-up resistor is enabled. false: Port pin's pull-up resistor is disabled.
          boolean PortPullDownOption: set at post-build, origin=Renesas_v1.0.0, default-value=false  # This parameter switches on or off the port pins pull-down resistor. true: Port pin's pull-down resistor is enabled. false: Port pin's pull-down resistor is disabled.
          enumeration PortOpenDrainControl_Expansion: {OpenDrain_PushPull, OpenDrain_N_Channel, OpenDrain_P_Channel}, set at post-build, origin=Renesas_v1.0.0, default-value=OpenDrain_PushPull  # This parameter selects port pins output buffer function in combination of PODC and PODCE . | OpenDrain_PushPull Specifies the OpenDrain_PushPull open drain type output circuit characteristics and updates both PODC and PODCE registers as 0 0 respectively. OpenDrain_N_Channel specifies the N-ch open drain type output circuit characteristics and updates the PODC and PODCE registers as 1 0 respectively. OpenDrain_P_Channel specifies the P-ch open drain type output circuit characteristics and updates the PODC and PODCE registers as 1 1 respectively.
          boolean PortOutputLevelInversion: set at post-build, origin=Renesas_v1.0.0, default-value=false  # This parameter specifies whether the output level from a pin is inverted or not.. true: Pin output level is inverted. false: Pin output level is not inverted.
          enumeration PortDriveStrengthControl: {SLOW, FAST, MIDDLE_0, MIDDLE_1}, set at post-build, origin=Renesas_v1.0.0, default-value=SLOW  # This parameter selects the port pins output drive strength as high strength or low strength type. This functionality is also referred to fast (high strength) and slow (low strength) behavior of output buffer. SLOW: Lower drive strength (slow mode) is selected for port pin's output buffer. FAST: Higher drive strength (fast mode) is selected for port pin's output buffer. MIDDLE_0: Lower drive strength (middle mode) is selected for port pin's output buffer. MIDDLE_1: Lower drive strength (middle mode) is selected for port pin's output buffer.
          enumeration PortUnlimitedCurrentControl: {SLOW, FAST, MIDDLE}, set at post-build, origin=Renesas_v4.0.0, default-value=SLOW  # This parameter selects the port pins output drive strength as high or low type. This functionality is also referred to fast (high strength) and slow (low strength) behavior of output buffer. The PortDriveStrengthControl must be enabled for this feature. | SLOW: Lower drive strength (slow mode) is selected for port pin's output buffer. FAST: Higher drive strength (fast mode) is selected for port pin's output buffer. MIDDLE: Lower drive strength (middle mode) is selected for port pin's output buffer.
        container PortPin1  # This container contains the configuration (parameters) for Port Pin 1.
          boolean PortPinDirectionChangeable: set at post-build, origin=Renesas_v1.0.0, default-value=false  # Parameter to indicate if the direction is changeable on a port pin during runtime. true: Port Pin direction changeable enabled. false: Port Pin direction changeable disabled.
          boolean PortPinDioAltModeChangeable: set at post-build, origin=Renesas_v1.0.0, default-value=false  # Parameter to indicate if the mode of a port pin is changeable between DIO and Alternate during runtime by API functions Port_SetToDioMode and Port_SetToAlternateMode. Including these APIs is controlled by PortSetToDioAltModeApi. true: Dio Alternate mode is changeable. false: Dio Alternate mode is not changeable.
          boolean PortPinModeChangeable: set at post-build, origin=Renesas_v1.0.0, default-value=false  # Parameter to indicate if the mode of a port pin is changeable during runtime by API function Port_SetPinMode. Including this API is controlled by PortSetPinModeApi. true: Port Pin mode is changeable. false: Port Pin mode is not changeable.
          enumeration PortPinLevelValue: {PORT_PIN_LEVEL_LOW, PORT_PIN_LEVEL_HIGH}, set at post-build, origin=Renesas_v1.0.0, default-value=PORT_PIN_LEVEL_LOW  # Parameter to indicate port pin level value for a port pin. PORT_PIN_LEVEL_LOW: Port pin Level is low. PORT_PIN_LEVEL_HIGH: Port pin Level is high.
          enumeration PortPinInitialMode: {TAUJ0I2_ALT1_IN, TAUJ0O2_ALT1_OUT, SENT4RX_ALT2_IN, SENT4SPCO_ALT2_OUT, TAUD1ODI15_ALT3_IN, TAUD1O15_ALT3_OUT, ADCD0CNV3_ALT4_OUT, INTP4_ALT6_IN, RLIN31RX_ALT6_IN, DIO}, set at post-build, origin=Renesas_v1.0.0, default-value=DIO  # Mode of the port pin for use with Port_Init() function. <Input name>_ALT<Alternative instance>_IN: Provides alternative instance for selected input. <Output name>_ALT<Alternative instance>_OUT: Provides alternative instance for selected output.
          enumeration PortPinDirection: {PORT_PIN_OUT, PORT_PIN_IN}, set at post-build, origin=Renesas_v1.0.0, default-value=PORT_PIN_IN  # The initial direction of the pin (IN or OUT).If the direction is not changeable, the value configured here is fixed. The direction must match the pin mode. PORT_PIN_IN: Port pin direction set as input. PORT_PIN_OUT: Port pin direction set as output.
          boolean PortInputBufferControl: set at post-build, origin=Renesas_v1.0.0, default-value=false  # This parameter is used as one of the factors to enable/disable port pins input buffer in DIO Mode (PMC=0). true: Port pin's input buffer is ready to be enabled in DIO Mode. false: Port pin's input buffer is disabled in DIO Mode.
          boolean PortBiDirectionControl: set at post-build, origin=Renesas_v1.0.0, default-value=false  # This parameter forces port pins input buffer and output buffer at the same time. If activated, the effect is valid independently from any other port settings. true: Activate forced Bi-directional IO buffer of the port pin. false: Deactivate forced Bi-directional IO buffer of the port pin.
          boolean PortPullUpOption: set at post-build, origin=Renesas_v1.0.0, default-value=false  # This register switches on or off the port pins pull-up resistor. true: Port pin's pull-up resistor is enabled. false: Port pin's pull-up resistor is disabled.
          boolean PortPullDownOption: set at post-build, origin=Renesas_v1.0.0, default-value=false  # This parameter switches on or off the port pins pull-down resistor. true: Port pin's pull-down resistor is enabled. false: Port pin's pull-down resistor is disabled.
          enumeration PortOpenDrainControl_Expansion: {OpenDrain_PushPull, OpenDrain_N_Channel, OpenDrain_P_Channel}, set at post-build, origin=Renesas_v1.0.0, default-value=OpenDrain_PushPull  # This parameter selects port pins output buffer function in combination of PODC and PODCE . | OpenDrain_PushPull Specifies the OpenDrain_PushPull open drain type output circuit characteristics and updates both PODC and PODCE registers as 0 0 respectively. OpenDrain_N_Channel specifies the N-ch open drain type output circuit characteristics and updates the PODC and PODCE registers as 1 0 respectively. OpenDrain_P_Channel specifies the P-ch open drain type output circuit characteristics and updates the PODC and PODCE registers as 1 1 respectively.
          boolean PortOutputLevelInversion: set at post-build, origin=Renesas_v1.0.0, default-value=false  # This parameter specifies whether the output level from a pin is inverted or not.. true: Pin output level is inverted. false: Pin output level is not inverted.
          enumeration PortDriveStrengthControl: {SLOW, FAST, MIDDLE_0, MIDDLE_1}, set at post-build, origin=Renesas_v1.0.0, default-value=SLOW  # This parameter selects the port pins output drive strength as high strength or low strength type. This functionality is also referred to fast (high strength) and slow (low strength) behavior of output buffer. SLOW: Lower drive strength (slow mode) is selected for port pin's output buffer. FAST: Higher drive strength (fast mode) is selected for port pin's output buffer. MIDDLE_0: Lower drive strength (middle mode) is selected for port pin's output buffer. MIDDLE_1: Lower drive strength (middle mode) is selected for port pin's output buffer.
          enumeration PortUnlimitedCurrentControl: {SLOW, FAST, MIDDLE}, set at post-build, origin=Renesas_v4.0.0, default-value=SLOW  # This parameter selects the port pins output drive strength as high or low type. This functionality is also referred to fast (high strength) and slow (low strength) behavior of output buffer. The PortDriveStrengthControl must be enabled for this feature. | SLOW: Lower drive strength (slow mode) is selected for port pin's output buffer. FAST: Higher drive strength (fast mode) is selected for port pin's output buffer. MIDDLE: Lower drive strength (middle mode) is selected for port pin's output buffer.
        container PortPin2  # This container contains the configuration (parameters) for Port Pin 2.
          boolean PortPinDirectionChangeable: set at post-build, origin=Renesas_v1.0.0, default-value=false  # Parameter to indicate if the direction is changeable on a port pin during runtime. true: Port Pin direction changeable enabled. false: Port Pin direction changeable disabled.
          boolean PortPinDioAltModeChangeable: set at post-build, origin=Renesas_v1.0.0, default-value=false  # Parameter to indicate if the mode of a port pin is changeable between DIO and Alternate during runtime by API functions Port_SetToDioMode and Port_SetToAlternateMode. Including these APIs is controlled by PortSetToDioAltModeApi. true: Dio Alternate mode is changeable. false: Dio Alternate mode is not changeable.
          boolean PortPinModeChangeable: set at post-build, origin=Renesas_v1.0.0, default-value=false  # Parameter to indicate if the mode of a port pin is changeable during runtime by API function Port_SetPinMode. Including this API is controlled by PortSetPinModeApi. true: Port Pin mode is changeable. false: Port Pin mode is not changeable.
          enumeration PortPinLevelValue: {PORT_PIN_LEVEL_LOW, PORT_PIN_LEVEL_HIGH}, set at post-build, origin=Renesas_v1.0.0, default-value=PORT_PIN_LEVEL_LOW  # Parameter to indicate port pin level value for a port pin. PORT_PIN_LEVEL_LOW: Port pin Level is low. PORT_PIN_LEVEL_HIGH: Port pin Level is high.
          enumeration PortPinInitialMode: {SCI30RX_ALT1_IN, INTP0_ALT1_IN, TAPA1ESO_ALT2_IN, INTP8_ALT2_IN, TAUD2I0_ALT3_IN, ADCD0CNV0_ALT3_OUT, TAUD2O0_ALT4_OUT, SENT5RX_ALT6_IN, SENT5SPCO_ALT6_OUT, DIO}, set at post-build, origin=Renesas_v1.0.0, default-value=DIO  # Mode of the port pin for use with Port_Init() function. <Input name>_ALT<Alternative instance>_IN: Provides alternative instance for selected input. <Output name>_ALT<Alternative instance>_OUT: Provides alternative instance for selected output.
          enumeration PortPinDirection: {PORT_PIN_OUT, PORT_PIN_IN}, set at post-build, origin=Renesas_v1.0.0, default-value=PORT_PIN_IN  # The initial direction of the pin (IN or OUT).If the direction is not changeable, the value configured here is fixed. The direction must match the pin mode. PORT_PIN_IN: Port pin direction set as input. PORT_PIN_OUT: Port pin direction set as output.
          boolean PortInputBufferControl: set at post-build, origin=Renesas_v1.0.0, default-value=false  # This parameter is used as one of the factors to enable/disable port pins input buffer in DIO Mode (PMC=0). true: Port pin's input buffer is ready to be enabled in DIO Mode. false: Port pin's input buffer is disabled in DIO Mode.
          boolean PortBiDirectionControl: set at post-build, origin=Renesas_v1.0.0, default-value=false  # This parameter forces port pins input buffer and output buffer at the same time. If activated, the effect is valid independently from any other port settings. true: Activate forced Bi-directional IO buffer of the port pin. false: Deactivate forced Bi-directional IO buffer of the port pin.
          boolean PortPullUpOption: set at post-build, origin=Renesas_v1.0.0, default-value=false  # This register switches on or off the port pins pull-up resistor. true: Port pin's pull-up resistor is enabled. false: Port pin's pull-up resistor is disabled.
          boolean PortPullDownOption: set at post-build, origin=Renesas_v1.0.0, default-value=false  # This parameter switches on or off the port pins pull-down resistor. true: Port pin's pull-down resistor is enabled. false: Port pin's pull-down resistor is disabled.
          enumeration PortOpenDrainControl_Expansion: {OpenDrain_PushPull, OpenDrain_N_Channel, OpenDrain_P_Channel}, set at post-build, origin=Renesas_v1.0.0, default-value=OpenDrain_PushPull  # This parameter selects port pins output buffer function in combination of PODC and PODCE . | OpenDrain_PushPull Specifies the OpenDrain_PushPull open drain type output circuit characteristics and updates both PODC and PODCE registers as 0 0 respectively. OpenDrain_N_Channel specifies the N-ch open drain type output circuit characteristics and updates the PODC and PODCE registers as 1 0 respectively. OpenDrain_P_Channel specifies the P-ch open drain type output circuit characteristics and updates the PODC and PODCE registers as 1 1 respectively.
          boolean PortOutputLevelInversion: set at post-build, origin=Renesas_v1.0.0, default-value=false  # This parameter specifies whether the output level from a pin is inverted or not.. true: Pin output level is inverted. false: Pin output level is not inverted.
          enumeration PortDriveStrengthControl: {SLOW, FAST, MIDDLE_0, MIDDLE_1}, set at post-build, origin=Renesas_v1.0.0, default-value=SLOW  # This parameter selects the port pins output drive strength as high strength or low strength type. This functionality is also referred to fast (high strength) and slow (low strength) behavior of output buffer. SLOW: Lower drive strength (slow mode) is selected for port pin's output buffer. FAST: Higher drive strength (fast mode) is selected for port pin's output buffer. MIDDLE_0: Lower drive strength (middle mode) is selected for port pin's output buffer. MIDDLE_1: Lower drive strength (middle mode) is selected for port pin's output buffer.
          enumeration PortUnlimitedCurrentControl: {SLOW, FAST, MIDDLE}, set at post-build, origin=Renesas_v4.0.0, default-value=SLOW  # This parameter selects the port pins output drive strength as high or low type. This functionality is also referred to fast (high strength) and slow (low strength) behavior of output buffer. The PortDriveStrengthControl must be enabled for this feature. | SLOW: Lower drive strength (slow mode) is selected for port pin's output buffer. FAST: Higher drive strength (fast mode) is selected for port pin's output buffer. MIDDLE: Lower drive strength (middle mode) is selected for port pin's output buffer.
        container PortPin3  # This container contains the configuration (parameters) for Port Pin 3.
          boolean PortPinDirectionChangeable: set at post-build, origin=Renesas_v1.0.0, default-value=false  # Parameter to indicate if the direction is changeable on a port pin during runtime. true: Port Pin direction changeable enabled. false: Port Pin direction changeable disabled.
          boolean PortPinDioAltModeChangeable: set at post-build, origin=Renesas_v1.0.0, default-value=false  # Parameter to indicate if the mode of a port pin is changeable between DIO and Alternate during runtime by API functions Port_SetToDioMode and Port_SetToAlternateMode. Including these APIs is controlled by PortSetToDioAltModeApi. true: Dio Alternate mode is changeable. false: Dio Alternate mode is not changeable.
          boolean PortPinModeChangeable: set at post-build, origin=Renesas_v1.0.0, default-value=false  # Parameter to indicate if the mode of a port pin is changeable during runtime by API function Port_SetPinMode. Including this API is controlled by PortSetPinModeApi. true: Port Pin mode is changeable. false: Port Pin mode is not changeable.
          enumeration PortPinLevelValue: {PORT_PIN_LEVEL_LOW, PORT_PIN_LEVEL_HIGH}, set at post-build, origin=Renesas_v1.0.0, default-value=PORT_PIN_LEVEL_LOW  # Parameter to indicate port pin level value for a port pin. PORT_PIN_LEVEL_LOW: Port pin Level is low. PORT_PIN_LEVEL_HIGH: Port pin Level is high.
          enumeration PortPinInitialMode: {SCI30TX_ALT1_OUT, TAUD1ODI8_ALT2_IN, TAUD1O8_ALT2_OUT, TAUD2I1_ALT3_IN, ADCD0CNV1_ALT3_OUT, TAUD2O1_ALT4_OUT, SENT5SPCO_ALT6_OUT, DIO}, set at post-build, origin=Renesas_v1.0.0, default-value=DIO  # Mode of the port pin for use with Port_Init() function. <Input name>_ALT<Alternative instance>_IN: Provides alternative instance for selected input. <Output name>_ALT<Alternative instance>_OUT: Provides alternative instance for selected output.
          enumeration PortPinDirection: {PORT_PIN_OUT, PORT_PIN_IN}, set at post-build, origin=Renesas_v1.0.0, default-value=PORT_PIN_IN  # The initial direction of the pin (IN or OUT). If the direction is not changeable, the value configured here is fixed. The direction must match the pin mode. PORT_PIN_IN: Port pin direction set as input. PORT_PIN_OUT: Port pin direction set as output.
          boolean PortInputBufferControl: set at post-build, origin=Renesas_v1.0.0, default-value=false  # This parameter is used as one of the factors to enable/disable port pins input buffer in DIO Mode (PMC=0). true: Port pin's input buffer is ready to be enabled in DIO Mode. false: Port pin's input buffer is disabled in DIO Mode.
          boolean PortBiDirectionControl: set at post-build, origin=Renesas_v1.0.0, default-value=false  # This parameter forces port pins input buffer and output buffer at the same time. If activated, the effect is valid independently from any other port settings. true: Activate forced Bi-directional IO buffer of the port pin. false: Deactivate forced Bi-directional IO buffer of the port pin.
          boolean PortPullUpOption: set at post-build, origin=Renesas_v1.0.0, default-value=false  # This register switches on or off the port pins pull-up resistor. true: Port pin's pull-up resistor is enabled. false: Port pin's pull-up resistor is disabled.
          boolean PortPullDownOption: set at post-build, origin=Renesas_v1.0.0, default-value=false  # This parameter switches on or off the port pins pull-down resistor. true: Port pin's pull-down resistor is enabled. false: Port pin's pull-down resistor is disabled.
          enumeration PortOpenDrainControl_Expansion: {OpenDrain_PushPull, OpenDrain_N_Channel, OpenDrain_P_Channel}, set at post-build, origin=Renesas_v1.0.0, default-value=OpenDrain_PushPull  # This parameter selects port pins output buffer function in combination of PODC and PODCE . | OpenDrain_PushPull Specifies the OpenDrain_PushPull open drain type output circuit characteristics and updates both PODC and PODCE registers as 0 0 respectively. OpenDrain_N_Channel specifies the N-ch open drain type output circuit characteristics and updates the PODC and PODCE registers as 1 0 respectively. OpenDrain_P_Channel specifies the P-ch open drain type output circuit characteristics and updates the PODC and PODCE registers as 1 1 respectively.
          boolean PortOutputLevelInversion: set at post-build, origin=Renesas_v1.0.0, default-value=false  # This parameter specifies whether the output level from a pin is inverted or not.. true: Pin output level is inverted. false: Pin output level is not inverted.
          enumeration PortDriveStrengthControl: {SLOW, FAST, MIDDLE_0, MIDDLE_1}, set at post-build, origin=Renesas_v1.0.0, default-value=SLOW  # This parameter selects the port pins output drive strength as high strength or low strength type. This functionality is also referred to fast (high strength) and slow (low strength) behavior of output buffer. SLOW: Lower drive strength (slow mode) is selected for port pin's output buffer. FAST: Higher drive strength (fast mode) is selected for port pin's output buffer. MIDDLE_0: Lower drive strength (middle mode) is selected for port pin's output buffer. MIDDLE_1: Lower drive strength (middle mode) is selected for port pin's output buffer.
          enumeration PortUnlimitedCurrentControl: {SLOW, FAST, MIDDLE}, set at post-build, origin=Renesas_v4.0.0, default-value=SLOW  # This parameter selects the port pins output drive strength as high or low type. This functionality is also referred to fast (high strength) and slow (low strength) behavior of output buffer. The PortDriveStrengthControl must be enabled for this feature. | SLOW: Lower drive strength (slow mode) is selected for port pin's output buffer. FAST: Higher drive strength (fast mode) is selected for port pin's output buffer. MIDDLE: Lower drive strength (middle mode) is selected for port pin's output buffer.
          enumeration PortInputSelection: {TYPE_1_SUPP_PISA, TYPE_2_SUPP_PISA}, set at post-build, origin=Renesas_v1.0.0, default-value=TYPE_1_SUPP_PISA  # This setting specifies the input buffer characteristics. TYPE_1_SUPP_PISA: TYPE 1 buffer is selected. TYPE_2_SUPP_PISA: TYPE 2 buffer is selected.
        container PortPin4  # This container contains the configuration (parameters) for Port Pin 4.
          boolean PortPinDirectionChangeable: set at post-build, origin=Renesas_v1.0.0, default-value=false  # Parameter to indicate if the direction is changeable on a port pin during runtime. true: Port Pin direction changeable enabled. false: Port Pin direction changeable disabled.
          boolean PortPinDioAltModeChangeable: set at post-build, origin=Renesas_v1.0.0, default-value=false  # Parameter to indicate if the mode of a port pin is changeable between DIO and Alternate during runtime by API functions Port_SetToDioMode and Port_SetToAlternateMode. Including these APIs is controlled by PortSetToDioAltModeApi. true: Dio Alternate mode is changeable. false: Dio Alternate mode is not changeable.
          boolean PortPinModeChangeable: set at post-build, origin=Renesas_v1.0.0, default-value=false  # Parameter to indicate if the mode of a port pin is changeable during runtime by API function Port_SetPinMode. Including this API is controlled by PortSetPinModeApi. true: Port Pin mode is changeable. false: Port Pin mode is not changeable.
          enumeration PortPinLevelValue: {PORT_PIN_LEVEL_LOW, PORT_PIN_LEVEL_HIGH}, set at post-build, origin=Renesas_v1.0.0, default-value=PORT_PIN_LEVEL_LOW  # Parameter to indicate port pin level value for a port pin. PORT_PIN_LEVEL_LOW: Port pin Level is low. PORT_PIN_LEVEL_HIGH: Port pin Level is high.
          enumeration PortPinInitialMode: {SCI30SCI_ALT1_IN, SCI30SCO_ALT1_OUT, TAUD1ODI9_ALT2_IN, TAUD1O9_ALT2_OUT, TAUD2I2_ALT3_IN, ADCD0CNV2_ALT3_OUT, TAUD2O2_ALT4_OUT, SENT4SPCO_ALT6_OUT, DIO}, set at post-build, origin=Renesas_v1.0.0, default-value=DIO  # Mode of the port pin for use with Port_Init() function. <Input name>_ALT<Alternative instance>_IN: Provides alternative instance for selected input. <Output name>_ALT<Alternative instance>_OUT: Provides alternative instance for selected output.
          enumeration PortPinDirection: {PORT_PIN_OUT, PORT_PIN_IN}, set at post-build, origin=Renesas_v1.0.0, default-value=PORT_PIN_IN  # The initial direction of the pin (IN or OUT). If the direction is not changeable, the value configured here is fixed. The direction must match the pin mode. PORT_PIN_IN: Port pin direction set as input. PORT_PIN_OUT: Port pin direction set as output.
          boolean PortInputBufferControl: set at post-build, origin=Renesas_v1.0.0, default-value=false  # This parameter is used as one of the factors to enable/disable port pins input buffer in DIO Mode (PMC=0). true: Port pin's input buffer is ready to be enabled in DIO Mode. false: Port pin's input buffer is disabled in DIO Mode.
          boolean PortBiDirectionControl: set at post-build, origin=Renesas_v1.0.0, default-value=false  # This parameter forces port pins input buffer and output buffer at the same time. If activated, the effect is valid independently from any other port settings. true: Activate forced Bi-directional IO buffer of the port pin. false: Deactivate forced Bi-directional IO buffer of the port pin.
          boolean PortPullUpOption: set at post-build, origin=Renesas_v1.0.0, default-value=false  # This register switches on or off the port pins pull-up resistor. true: Port pin's pull-up resistor is enabled. false: Port pin's pull-up resistor is disabled.
          boolean PortPullDownOption: set at post-build, origin=Renesas_v1.0.0, default-value=false  # This parameter switches on or off the port pins pull-down resistor. true: Port pin's pull-down resistor is enabled. false: Port pin's pull-down resistor is disabled.
          enumeration PortOpenDrainControl_Expansion: {OpenDrain_PushPull, OpenDrain_N_Channel, OpenDrain_P_Channel}, set at post-build, origin=Renesas_v1.0.0, default-value=OpenDrain_PushPull  # This parameter selects port pins output buffer function in combination of PODC and PODCE . | OpenDrain_PushPull Specifies the OpenDrain_PushPull open drain type output circuit characteristics and updates both PODC and PODCE registers as 0 0 respectively. OpenDrain_N_Channel specifies the N-ch open drain type output circuit characteristics and updates the PODC and PODCE registers as 1 0 respectively. OpenDrain_P_Channel specifies the P-ch open drain type output circuit characteristics and updates the PODC and PODCE registers as 1 1 respectively.
          boolean PortOutputLevelInversion: set at post-build, origin=Renesas_v1.0.0, default-value=false  # This parameter specifies whether the output level from a pin is inverted or not.. true: Pin output level is inverted. false: Pin output level is not inverted.
          enumeration PortDriveStrengthControl: {SLOW, FAST, MIDDLE_0, MIDDLE_1}, set at post-build, origin=Renesas_v1.0.0, default-value=SLOW  # This parameter selects the port pins output drive strength as high strength or low strength type. This functionality is also referred to fast (high strength) and slow (low strength) behavior of output buffer. SLOW: Lower drive strength (slow mode) is selected for port pin's output buffer. FAST: Higher drive strength (fast mode) is selected for port pin's output buffer. MIDDLE_0: Lower drive strength (middle mode) is selected for port pin's output buffer. MIDDLE_1: Lower drive strength (middle mode) is selected for port pin's output buffer.
          enumeration PortUnlimitedCurrentControl: {SLOW, FAST, MIDDLE}, set at post-build, origin=Renesas_v4.0.0, default-value=SLOW  # This parameter selects the port pins output drive strength as high or low type. This functionality is also referred to fast (high strength) and slow (low strength) behavior of output buffer. The PortDriveStrengthControl must be enabled for this feature. | SLOW: Lower drive strength (slow mode) is selected for port pin's output buffer. FAST: Higher drive strength (fast mode) is selected for port pin's output buffer. MIDDLE: Lower drive strength (middle mode) is selected for port pin's output buffer.
          enumeration PortInputSelection: {TYPE_1_SUPP_PISA, TYPE_2_SUPP_PISA}, set at post-build, origin=Renesas_v1.0.0, default-value=TYPE_1_SUPP_PISA  # This setting specifies the input buffer characteristics. TYPE_1_SUPP_PISA: TYPE 1 buffer is selected. TYPE_2_SUPP_PISA: TYPE 2 buffer is selected.
        container PortPin5  # This container contains the configuration (parameters) for Port Pin 5.
          boolean PortPinDirectionChangeable: set at post-build, origin=Renesas_v1.0.0, default-value=false  # Parameter to indicate if the direction is changeable on a port pin during runtime. true: Port Pin direction changeable enabled. false: Port Pin direction changeable disabled.
          boolean PortPinDioAltModeChangeable: set at post-build, origin=Renesas_v1.0.0, default-value=false  # Parameter to indicate if the mode of a port pin is changeable between DIO and Alternate during runtime by API functions Port_SetToDioMode and Port_SetToAlternateMode. Including these APIs is controlled by PortSetToDioAltModeApi. true: Dio Alternate mode is changeable. false: Dio Alternate mode is not changeable.
          boolean PortPinModeChangeable: set at post-build, origin=Renesas_v1.0.0, default-value=false  # Parameter to indicate if the mode of a port pin is changeable during runtime by API function Port_SetPinMode. Including this API is controlled by PortSetPinModeApi. true: Port Pin mode is changeable. false: Port Pin mode is not changeable.
          enumeration PortPinLevelValue: {PORT_PIN_LEVEL_LOW, PORT_PIN_LEVEL_HIGH}, set at post-build, origin=Renesas_v1.0.0, default-value=PORT_PIN_LEVEL_LOW  # Parameter to indicate port pin level value for a port pin. PORT_PIN_LEVEL_LOW: Port pin Level is low. PORT_PIN_LEVEL_HIGH: Port pin Level is high.
          enumeration PortPinInitialMode: {TAUJ1I0_ALT1_IN, TAUJ1O0_ALT1_OUT, TAUD1ODI10_ALT2_IN, TAUD1O10_ALT2_OUT, TAUD2I3_ALT3_IN, ADCD0CNV3_ALT3_OUT, TAUD2O3_ALT4_OUT, SENT3SPCO_ALT6_OUT, DIO}, set at post-build, origin=Renesas_v1.0.0, default-value=DIO  # Mode of the port pin for use with Port_Init() function. <Input name>_ALT<Alternative instance>_IN: Provides alternative instance for selected input. <Output name>_ALT<Alternative instance>_OUT: Provides alternative instance for selected output.
          enumeration PortPinDirection: {PORT_PIN_OUT, PORT_PIN_IN}, set at post-build, origin=Renesas_v1.0.0, default-value=PORT_PIN_IN  # The initial direction of the pin (IN or OUT). If the direction is not changeable, the value configured here is fixed. The direction must match the pin mode. PORT_PIN_IN: Port pin direction set as input. PORT_PIN_OUT: Port pin direction set as output.
          boolean PortInputBufferControl: set at post-build, origin=Renesas_v1.0.0, default-value=false  # This parameter is used as one of the factors to enable/disable port pins input buffer in DIO Mode (PMC=0). true: Port pin's input buffer is ready to be enabled in DIO Mode. false: Port pin's input buffer is disabled in DIO Mode.
          boolean PortBiDirectionControl: set at post-build, origin=Renesas_v1.0.0, default-value=false  # This parameter forces port pins input buffer and output buffer at the same time. If activated, the effect is valid independently from any other port settings. true: Activate forced Bi-directional IO buffer of the port pin. false: Deactivate forced Bi-directional IO buffer of the port pin.
          boolean PortPullUpOption: set at post-build, origin=Renesas_v1.0.0, default-value=false  # This register switches on or off the port pins pull-up resistor. true: Port pin's pull-up resistor is enabled. false: Port pin's pull-up resistor is disabled.
          boolean PortPullDownOption: set at post-build, origin=Renesas_v1.0.0, default-value=false  # This parameter switches on or off the port pins pull-down resistor. true: Port pin's pull-down resistor is enabled. false: Port pin's pull-down resistor is disabled.
          enumeration PortOpenDrainControl_Expansion: {OpenDrain_PushPull, OpenDrain_N_Channel, OpenDrain_P_Channel}, set at post-build, origin=Renesas_v1.0.0, default-value=OpenDrain_PushPull  # This parameter selects port pins output buffer function in combination of PODC and PODCE . | OpenDrain_PushPull Specifies the OpenDrain_PushPull open drain type output circuit characteristics and updates both PODC and PODCE registers as 0 0 respectively. OpenDrain_N_Channel specifies the N-ch open drain type output circuit characteristics and updates the PODC and PODCE registers as 1 0 respectively. OpenDrain_P_Channel specifies the P-ch open drain type output circuit characteristics and updates the PODC and PODCE registers as 1 1 respectively.
          boolean PortOutputLevelInversion: set at post-build, origin=Renesas_v1.0.0, default-value=false  # This parameter specifies whether the output level from a pin is inverted or not.. true: Pin output level is inverted. false: Pin output level is not inverted.
          enumeration PortDriveStrengthControl: {SLOW, FAST, MIDDLE_0, MIDDLE_1}, set at post-build, origin=Renesas_v1.0.0, default-value=SLOW  # This parameter selects the port pins output drive strength as high strength or low strength type. This functionality is also referred to fast (high strength) and slow (low strength) behavior of output buffer. SLOW: Lower drive strength (slow mode) is selected for port pin's output buffer. FAST: Higher drive strength (fast mode) is selected for port pin's output buffer. MIDDLE_0: Lower drive strength (middle mode) is selected for port pin's output buffer. MIDDLE_1: Lower drive strength (middle mode) is selected for port pin's output buffer.
          enumeration PortUnlimitedCurrentControl: {SLOW, FAST, MIDDLE}, set at post-build, origin=Renesas_v4.0.0, default-value=SLOW  # This parameter selects the port pins output drive strength as high or low type. This functionality is also referred to fast (high strength) and slow (low strength) behavior of output buffer. The PortDriveStrengthControl must be enabled for this feature. | SLOW: Lower drive strength (slow mode) is selected for port pin's output buffer. FAST: Higher drive strength (fast mode) is selected for port pin's output buffer. MIDDLE: Lower drive strength (middle mode) is selected for port pin's output buffer.
          enumeration PortInputSelection: {TYPE_1_SUPP_PISA, TYPE_2_SUPP_PISA}, set at post-build, origin=Renesas_v1.0.0, default-value=TYPE_1_SUPP_PISA  # This setting specifies the input buffer characteristics. TYPE_1_SUPP_PISA: TYPE 1 buffer is selected. TYPE_2_SUPP_PISA: TYPE 2 buffer is selected.
        container PortPin6  # This container contains the configuration (parameters) for Port Pin 6.
          boolean PortPinDirectionChangeable: set at post-build, origin=Renesas_v1.0.0, default-value=false  # Parameter to indicate if the direction is changeable on a port pin during runtime. true: Port Pin direction changeable enabled. false: Port Pin direction changeable disabled.
          boolean PortPinDioAltModeChangeable: set at post-build, origin=Renesas_v1.0.0, default-value=false  # Parameter to indicate if the mode of a port pin is changeable between DIO and Alternate during runtime by API functions Port_SetToDioMode and Port_SetToAlternateMode. Including these APIs is controlled by PortSetToDioAltModeApi. true: Dio Alternate mode is changeable. false: Dio Alternate mode is not changeable.
          boolean PortPinModeChangeable: set at post-build, origin=Renesas_v1.0.0, default-value=false  # Parameter to indicate if the mode of a port pin is changeable during runtime by API function Port_SetPinMode. Including this API is controlled by PortSetPinModeApi. true: Port Pin mode is changeable. false: Port Pin mode is not changeable.
          enumeration PortPinLevelValue: {PORT_PIN_LEVEL_LOW, PORT_PIN_LEVEL_HIGH}, set at post-build, origin=Renesas_v1.0.0, default-value=PORT_PIN_LEVEL_LOW  # Parameter to indicate port pin level value for a port pin. PORT_PIN_LEVEL_LOW: Port pin Level is low. PORT_PIN_LEVEL_HIGH: Port pin Level is high.
          enumeration PortPinInitialMode: {TAUJ1I1_ALT1_IN, TAUJ1O1_ALT1_OUT, TAUD1ODI11_ALT2_IN, TAUD1O11_ALT2_OUT, TAUD2I4_ALT3_IN, TAUD2O4_ALT4_OUT, SENT2SPCO_ALT6_OUT, DIO}, set at post-build, origin=Renesas_v1.0.0, default-value=DIO  # Mode of the port pin for use with Port_Init() function. <Input name>_ALT<Alternative instance>_IN: Provides alternative instance for selected input. <Output name>_ALT<Alternative instance>_OUT: Provides alternative instance for selected output.
          enumeration PortPinDirection: {PORT_PIN_OUT, PORT_PIN_IN}, set at post-build, origin=Renesas_v1.0.0, default-value=PORT_PIN_IN  # The initial direction of the pin (IN or OUT). If the direction is not changeable, the value configured here is fixed. The direction must match the pin mode. PORT_PIN_IN: Port pin direction set as input. PORT_PIN_OUT: Port pin direction set as output.
          boolean PortInputBufferControl: set at post-build, origin=Renesas_v1.0.0, default-value=false  # This parameter is used as one of the factors to enable/disable port pins input buffer in DIO Mode (PMC=0). true: Port pin's input buffer is ready to be enabled in DIO Mode. false: Port pin's input buffer is disabled in DIO Mode.
          boolean PortBiDirectionControl: set at post-build, origin=Renesas_v1.0.0, default-value=false  # This parameter forces port pins input buffer and output buffer at the same time. If activated, the effect is valid independently from any other port settings. true: Activate forced Bi-directional IO buffer of the port pin. false: Deactivate forced Bi-directional IO buffer of the port pin.
          boolean PortPullUpOption: set at post-build, origin=Renesas_v1.0.0, default-value=false  # This register switches on or off the port pins pull-up resistor. true: Port pin's pull-up resistor is enabled. false: Port pin's pull-up resistor is disabled.
          boolean PortPullDownOption: set at post-build, origin=Renesas_v1.0.0, default-value=false  # This parameter switches on or off the port pins pull-down resistor. true: Port pin's pull-down resistor is enabled. false: Port pin's pull-down resistor is disabled.
          enumeration PortOpenDrainControl_Expansion: {OpenDrain_PushPull, OpenDrain_N_Channel, OpenDrain_P_Channel}, set at post-build, origin=Renesas_v1.0.0, default-value=OpenDrain_PushPull  # This parameter selects port pins output buffer function in combination of PODC and PODCE . | OpenDrain_PushPull Specifies the OpenDrain_PushPull open drain type output circuit characteristics and updates both PODC and PODCE registers as 0 0 respectively. OpenDrain_N_Channel specifies the N-ch open drain type output circuit characteristics and updates the PODC and PODCE registers as 1 0 respectively. OpenDrain_P_Channel specifies the P-ch open drain type output circuit characteristics and updates the PODC and PODCE registers as 1 1 respectively.
          boolean PortOutputLevelInversion: set at post-build, origin=Renesas_v1.0.0, default-value=false  # This parameter specifies whether the output level from a pin is inverted or not.. true: Pin output level is inverted. false: Pin output level is not inverted.
          enumeration PortDriveStrengthControl: {SLOW, FAST, MIDDLE_0, MIDDLE_1}, set at post-build, origin=Renesas_v1.0.0, default-value=SLOW  # This parameter selects the port pins output drive strength as high strength or low strength type. This functionality is also referred to fast (high strength) and slow (low strength) behavior of output buffer. SLOW: Lower drive strength (slow mode) is selected for port pin's output buffer. FAST: Higher drive strength (fast mode) is selected for port pin's output buffer. MIDDLE_0: Lower drive strength (middle mode) is selected for port pin's output buffer. MIDDLE_1: Lower drive strength (middle mode) is selected for port pin's output buffer.
          enumeration PortUnlimitedCurrentControl: {SLOW, FAST, MIDDLE}, set at post-build, origin=Renesas_v4.0.0, default-value=SLOW  # This parameter selects the port pins output drive strength as high or low type. This functionality is also referred to fast (high strength) and slow (low strength) behavior of output buffer. The PortDriveStrengthControl must be enabled for this feature. | SLOW: Lower drive strength (slow mode) is selected for port pin's output buffer. FAST: Higher drive strength (fast mode) is selected for port pin's output buffer. MIDDLE: Lower drive strength (middle mode) is selected for port pin's output buffer.
          enumeration PortInputSelection: {TYPE_1_SUPP_PISA, TYPE_2_SUPP_PISA}, set at post-build, origin=Renesas_v1.0.0, default-value=TYPE_1_SUPP_PISA  # This setting specifies the input buffer characteristics. TYPE_1_SUPP_PISA: TYPE 1 buffer is selected. TYPE_2_SUPP_PISA: TYPE 2 buffer is selected.
        container PortPin7  # This container contains the configuration (parameters) for Port Pin 7.
          boolean PortPinDirectionChangeable: set at post-build, origin=Renesas_v1.0.0, default-value=false  # Parameter to indicate if the direction is changeable on a port pin during runtime. true: Port Pin direction changeable enabled. false: Port Pin direction changeable disabled.
          boolean PortPinDioAltModeChangeable: set at post-build, origin=Renesas_v1.0.0, default-value=false  # Parameter to indicate if the mode of a port pin is changeable between DIO and Alternate during runtime by API functions Port_SetToDioMode and Port_SetToAlternateMode. Including these APIs is controlled by PortSetToDioAltModeApi. true: Dio Alternate mode is changeable. false: Dio Alternate mode is not changeable.
          boolean PortPinModeChangeable: set at post-build, origin=Renesas_v1.0.0, default-value=false  # Parameter to indicate if the mode of a port pin is changeable during runtime by API function Port_SetPinMode. Including this API is controlled by PortSetPinModeApi. true: Port Pin mode is changeable. false: Port Pin mode is not changeable.
          enumeration PortPinLevelValue: {PORT_PIN_LEVEL_LOW, PORT_PIN_LEVEL_HIGH}, set at post-build, origin=Renesas_v1.0.0, default-value=PORT_PIN_LEVEL_LOW  # Parameter to indicate port pin level value for a port pin. PORT_PIN_LEVEL_LOW: Port pin Level is low. PORT_PIN_LEVEL_HIGH: Port pin Level is high.
          enumeration PortPinInitialMode: {TAUJ1I2_ALT1_IN, TAUJ1O2_ALT1_OUT, TAUD1ODI12_ALT2_IN, TAUD1O12_ALT2_OUT, TAUD2I5_ALT3_IN, ADCATRG0_ALT4_IN, TAUD2O5_ALT4_OUT, SENT1SPCO_ALT6_IN, DIO}, set at post-build, origin=Renesas_v1.0.0, default-value=DIO  # Mode of the port pin for use with Port_Init() function. <Input name>_ALT<Alternative instance>_IN: Provides alternative instance for selected input. <Output name>_ALT<Alternative instance>_OUT: Provides alternative instance for selected output.
          enumeration PortPinDirection: {PORT_PIN_OUT, PORT_PIN_IN}, set at post-build, origin=Renesas_v1.0.0, default-value=PORT_PIN_IN  # The initial direction of the pin (IN or OUT). If the direction is not changeable, the value configured here is fixed. The direction must match the pin mode. PORT_PIN_IN: Port pin direction set as input. PORT_PIN_OUT: Port pin direction set as output.
          boolean PortInputBufferControl: set at post-build, origin=Renesas_v1.0.0, default-value=false  # This parameter is used as one of the factors to enable/disable port pins input buffer in DIO Mode (PMC=0). true: Port pin's input buffer is ready to be enabled in DIO Mode. false: Port pin's input buffer is disabled in DIO Mode.
          boolean PortBiDirectionControl: set at post-build, origin=Renesas_v1.0.0, default-value=false  # This parameter forces port pins input buffer and output buffer at the same time. If activated, the effect is valid independently from any other port settings. true: Activate forced Bi-directional IO buffer of the port pin. false: Deactivate forced Bi-directional IO buffer of the port pin.
          boolean PortPullUpOption: set at post-build, origin=Renesas_v1.0.0, default-value=false  # This register switches on or off the port pins pull-up resistor. true: Port pin's pull-up resistor is enabled. false: Port pin's pull-up resistor is disabled.
          boolean PortPullDownOption: set at post-build, origin=Renesas_v1.0.0, default-value=false  # This parameter switches on or off the port pins pull-down resistor. true: Port pin's pull-down resistor is enabled. false: Port pin's pull-down resistor is disabled.
          enumeration PortOpenDrainControl_Expansion: {OpenDrain_PushPull, OpenDrain_N_Channel, OpenDrain_P_Channel}, set at post-build, origin=Renesas_v1.0.0, default-value=OpenDrain_PushPull  # This parameter selects port pins output buffer function in combination of PODC and PODCE . | OpenDrain_PushPull Specifies the OpenDrain_PushPull open drain type output circuit characteristics and updates both PODC and PODCE registers as 0 0 respectively. OpenDrain_N_Channel specifies the N-ch open drain type output circuit characteristics and updates the PODC and PODCE registers as 1 0 respectively. OpenDrain_P_Channel specifies the P-ch open drain type output circuit characteristics and updates the PODC and PODCE registers as 1 1 respectively.
          boolean PortOutputLevelInversion: set at post-build, origin=Renesas_v1.0.0, default-value=false  # This parameter specifies whether the output level from a pin is inverted or not.. true: Pin output level is inverted. false: Pin output level is not inverted.
          enumeration PortDriveStrengthControl: {SLOW, FAST, MIDDLE_0, MIDDLE_1}, set at post-build, origin=Renesas_v1.0.0, default-value=SLOW  # This parameter selects the port pins output drive strength as high strength or low strength type. This functionality is also referred to fast (high strength) and slow (low strength) behavior of output buffer. SLOW: Lower drive strength (slow mode) is selected for port pin's output buffer. FAST: Higher drive strength (fast mode) is selected for port pin's output buffer. MIDDLE_0: Lower drive strength (middle mode) is selected for port pin's output buffer. MIDDLE_1: Lower drive strength (middle mode) is selected for port pin's output buffer.
          enumeration PortUnlimitedCurrentControl: {SLOW, FAST, MIDDLE}, set at post-build, origin=Renesas_v4.0.0, default-value=SLOW  # This parameter selects the port pins output drive strength as high or low type. This functionality is also referred to fast (high strength) and slow (low strength) behavior of output buffer. The PortDriveStrengthControl must be enabled for this feature. | SLOW: Lower drive strength (slow mode) is selected for port pin's output buffer. FAST: Higher drive strength (fast mode) is selected for port pin's output buffer. MIDDLE: Lower drive strength (middle mode) is selected for port pin's output buffer.
          enumeration PortInputSelection: {TYPE_1_SUPP_PISA, TYPE_2_SUPP_PISA}, set at post-build, origin=Renesas_v1.0.0, default-value=TYPE_1_SUPP_PISA  # This setting specifies the input buffer characteristics. TYPE_1_SUPP_PISA: TYPE 1 buffer is selected. TYPE_2_SUPP_PISA: TYPE 2 buffer is selected.
        container PortPin8  # This container contains the configuration (parameters) for Port Pin 8.
          boolean PortPinDirectionChangeable: set at post-build, origin=Renesas_v1.0.0, default-value=false  # Parameter to indicate if the direction is changeable on a port pin during runtime. true: Port Pin direction changeable enabled. false: Port Pin direction changeable disabled.
          boolean PortPinDioAltModeChangeable: set at post-build, origin=Renesas_v1.0.0, default-value=false  # Parameter to indicate if the mode of a port pin is changeable between DIO and Alternate during runtime by API functions Port_SetToDioMode and Port_SetToAlternateMode. Including these APIs is controlled by PortSetToDioAltModeApi. true: Dio Alternate mode is changeable. false: Dio Alternate mode is not changeable.
          boolean PortPinModeChangeable: set at post-build, origin=Renesas_v1.0.0, default-value=false  # Parameter to indicate if the mode of a port pin is changeable during runtime by API function Port_SetPinMode. Including this API is controlled by PortSetPinModeApi. true: Port Pin mode is changeable. false: Port Pin mode is not changeable.
          enumeration PortPinLevelValue: {PORT_PIN_LEVEL_LOW, PORT_PIN_LEVEL_HIGH}, set at post-build, origin=Renesas_v1.0.0, default-value=PORT_PIN_LEVEL_LOW  # Parameter to indicate port pin level value for a port pin. PORT_PIN_LEVEL_LOW: Port pin Level is low. PORT_PIN_LEVEL_HIGH: Port pin Level is high.
          enumeration PortPinInitialMode: {TAUJ1I3_ALT1_IN, TAUJ1O3_ALT1_OUT, TAUD1ODI13_ALT2_IN, TAUD1O13_ALT2_OUT, TAUD2I6_ALT3_IN, ADCATRG1_ALT4_IN, TAUD2O6_ALT4_OUT, SENT0SPCO_ALT6_OUT, DIO}, set at post-build, origin=Renesas_v1.0.0, default-value=DIO  # Mode of the port pin for use with Port_Init() function. <Input name>_ALT<Alternative instance>_IN: Provides alternative instance for selected input. <Output name>_ALT<Alternative instance>_OUT: Provides alternative instance for selected output.
          enumeration PortPinDirection: {PORT_PIN_OUT, PORT_PIN_IN}, set at post-build, origin=Renesas_v1.0.0, default-value=PORT_PIN_IN  # The initial direction of the pin (IN or OUT). If the direction is not changeable, the value configured here is fixed. The direction must match the pin mode. PORT_PIN_IN: Port pin direction set as input. PORT_PIN_OUT: Port pin direction set as output.
          boolean PortInputBufferControl: set at post-build, origin=Renesas_v1.0.0, default-value=false  # This parameter is used as one of the factors to enable/disable port pins input buffer in DIO Mode (PMC=0). true: Port pin's input buffer is ready to be enabled in DIO Mode. false: Port pin's input buffer is disabled in DIO Mode.
          boolean PortBiDirectionControl: set at post-build, origin=Renesas_v1.0.0, default-value=false  # This parameter forces port pins input buffer and output buffer at the same time. If activated, the effect is valid independently from any other port settings. true: Activate forced Bi-directional IO buffer of the port pin. false: Deactivate forced Bi-directional IO buffer of the port pin.
          boolean PortPullUpOption: set at post-build, origin=Renesas_v1.0.0, default-value=false  # This register switches on or off the port pins pull-up resistor. true: Port pin's pull-up resistor is enabled. false: Port pin's pull-up resistor is disabled.
          boolean PortPullDownOption: set at post-build, origin=Renesas_v1.0.0, default-value=false  # This parameter switches on or off the port pins pull-down resistor. true: Port pin's pull-down resistor is enabled. false: Port pin's pull-down resistor is disabled.
          enumeration PortOpenDrainControl_Expansion: {OpenDrain_PushPull, OpenDrain_N_Channel, OpenDrain_P_Channel}, set at post-build, origin=Renesas_v1.0.0, default-value=OpenDrain_PushPull  # This parameter selects port pins output buffer function in combination of PODC and PODCE . | OpenDrain_PushPull Specifies the OpenDrain_PushPull open drain type output circuit characteristics and updates both PODC and PODCE registers as 0 0 respectively. OpenDrain_N_Channel specifies the N-ch open drain type output circuit characteristics and updates the PODC and PODCE registers as 1 0 respectively. OpenDrain_P_Channel specifies the P-ch open drain type output circuit characteristics and updates the PODC and PODCE registers as 1 1 respectively.
          boolean PortOutputLevelInversion: set at post-build, origin=Renesas_v1.0.0, default-value=false  # This parameter specifies whether the output level from a pin is inverted or not.. true: Pin output level is inverted. false: Pin output level is not inverted.
          enumeration PortDriveStrengthControl: {SLOW, FAST, MIDDLE_0, MIDDLE_1}, set at post-build, origin=Renesas_v1.0.0, default-value=SLOW  # This parameter selects the port pins output drive strength as high strength or low strength type. This functionality is also referred to fast (high strength) and slow (low strength) behavior of output buffer. SLOW: Lower drive strength (slow mode) is selected for port pin's output buffer. FAST: Higher drive strength (fast mode) is selected for port pin's output buffer. MIDDLE_0: Lower drive strength (middle mode) is selected for port pin's output buffer. MIDDLE_1: Lower drive strength (middle mode) is selected for port pin's output buffer.
          enumeration PortUnlimitedCurrentControl: {SLOW, FAST, MIDDLE}, set at post-build, origin=Renesas_v4.0.0, default-value=SLOW  # This parameter selects the port pins output drive strength as high or low type. This functionality is also referred to fast (high strength) and slow (low strength) behavior of output buffer. The PortDriveStrengthControl must be enabled for this feature. | SLOW: Lower drive strength (slow mode) is selected for port pin's output buffer. FAST: Higher drive strength (fast mode) is selected for port pin's output buffer. MIDDLE: Lower drive strength (middle mode) is selected for port pin's output buffer.
          enumeration PortInputSelection: {TYPE_1_SUPP_PISA, TYPE_2_SUPP_PISA}, set at post-build, origin=Renesas_v1.0.0, default-value=TYPE_1_SUPP_PISA  # This setting specifies the input buffer characteristics. TYPE_1_SUPP_PISA: TYPE 1 buffer is selected. TYPE_2_SUPP_PISA: TYPE 2 buffer is selected.
        container PortPin9  # This container contains the configuration (parameters) for Port Pin 9.
          boolean PortPinDirectionChangeable: set at post-build, origin=Renesas_v1.0.0, default-value=false  # Parameter to indicate if the direction is changeable on a port pin during runtime. true: Port Pin direction changeable enabled. false: Port Pin direction changeable disabled.
          boolean PortPinDioAltModeChangeable: set at post-build, origin=Renesas_v1.0.0, default-value=false  # Parameter to indicate if the mode of a port pin is changeable between DIO and Alternate during runtime by API functions Port_SetToDioMode and Port_SetToAlternateMode. Including these APIs is controlled by PortSetToDioAltModeApi. true: Dio Alternate mode is changeable. false: Dio Alternate mode is not changeable.
          boolean PortPinModeChangeable: set at post-build, origin=Renesas_v1.0.0, default-value=false  # Parameter to indicate if the mode of a port pin is changeable during runtime by API function Port_SetPinMode. Including this API is controlled by PortSetPinModeApi. true: Port Pin mode is changeable. false: Port Pin mode is not changeable.
          enumeration PortPinLevelValue: {PORT_PIN_LEVEL_LOW, PORT_PIN_LEVEL_HIGH}, set at post-build, origin=Renesas_v1.0.0, default-value=PORT_PIN_LEVEL_LOW  # Parameter to indicate port pin level value for a port pin. PORT_PIN_LEVEL_LOW: Port pin Level is low. PORT_PIN_LEVEL_HIGH: Port pin Level is high.
          enumeration PortPinInitialMode: {ADCD1CNV1_ALT1_OUT, TAUD1ODI14_ALT2_IN, TAUD1O14_ALT2_OUT, TAUD2I7_ALT3_IN, ADCA0CNV4_ALT3_OUT, TAUD2O7_ALT4_OUT, DIO}, set at post-build, origin=Renesas_v1.0.0, default-value=DIO  # Mode of the port pin for use with Port_Init() function. <Input name>_ALT<Alternative instance>_IN: Provides alternative instance for selected input. <Output name>_ALT<Alternative instance>_OUT: Provides alternative instance for selected output.
          enumeration PortPinDirection: {PORT_PIN_OUT, PORT_PIN_IN}, set at post-build, origin=Renesas_v1.0.0, default-value=PORT_PIN_IN  # The initial direction of the pin (IN or OUT). If the direction is not changeable, the value configured here is fixed. The direction must match the pin mode. PORT_PIN_IN: Port pin direction set as input. PORT_PIN_OUT: Port pin direction set as output.
          boolean PortInputBufferControl: set at post-build, origin=Renesas_v1.0.0, default-value=false  # This parameter is used as one of the factors to enable/disable port pins input buffer in DIO Mode (PMC=0). true: Port pin's input buffer is ready to be enabled in DIO Mode. false: Port pin's input buffer is disabled in DIO Mode.
          boolean PortBiDirectionControl: set at post-build, origin=Renesas_v1.0.0, default-value=false  # This parameter forces port pins input buffer and output buffer at the same time. If activated, the effect is valid independently from any other port settings. true: Activate forced Bi-directional IO buffer of the port pin. false: Deactivate forced Bi-directional IO buffer of the port pin.
          boolean PortPullUpOption: set at post-build, origin=Renesas_v1.0.0, default-value=false  # This register switches on or off the port pins pull-up resistor. true: Port pin's pull-up resistor is enabled. false: Port pin's pull-up resistor is disabled.
          boolean PortPullDownOption: set at post-build, origin=Renesas_v1.0.0, default-value=false  # This parameter switches on or off the port pins pull-down resistor. true: Port pin's pull-down resistor is enabled. false: Port pin's pull-down resistor is disabled.
          enumeration PortOpenDrainControl_Expansion: {OpenDrain_PushPull, OpenDrain_N_Channel, OpenDrain_P_Channel}, set at post-build, origin=Renesas_v1.0.0, default-value=OpenDrain_PushPull  # This parameter selects port pins output buffer function in combination of PODC and PODCE . | OpenDrain_PushPull Specifies the OpenDrain_PushPull open drain type output circuit characteristics and updates both PODC and PODCE registers as 0 0 respectively. OpenDrain_N_Channel specifies the N-ch open drain type output circuit characteristics and updates the PODC and PODCE registers as 1 0 respectively. OpenDrain_P_Channel specifies the P-ch open drain type output circuit characteristics and updates the PODC and PODCE registers as 1 1 respectively.
          boolean PortOutputLevelInversion: set at post-build, origin=Renesas_v1.0.0, default-value=false  # This parameter specifies whether the output level from a pin is inverted or not.. true: Pin output level is inverted. false: Pin output level is not inverted.
          enumeration PortDriveStrengthControl: {SLOW, FAST, MIDDLE_0, MIDDLE_1}, set at post-build, origin=Renesas_v1.0.0, default-value=SLOW  # This parameter selects the port pins output drive strength as high strength or low strength type. This functionality is also referred to fast (high strength) and slow (low strength) behavior of output buffer. SLOW: Lower drive strength (slow mode) is selected for port pin's output buffer. FAST: Higher drive strength (fast mode) is selected for port pin's output buffer. MIDDLE_0: Lower drive strength (middle mode) is selected for port pin's output buffer. MIDDLE_1: Lower drive strength (middle mode) is selected for port pin's output buffer.
          enumeration PortUnlimitedCurrentControl: {SLOW, FAST, MIDDLE}, set at post-build, origin=Renesas_v4.0.0, default-value=SLOW  # This parameter selects the port pins output drive strength as high or low type. This functionality is also referred to fast (high strength) and slow (low strength) behavior of output buffer. The PortDriveStrengthControl must be enabled for this feature. | SLOW: Lower drive strength (slow mode) is selected for port pin's output buffer. FAST: Higher drive strength (fast mode) is selected for port pin's output buffer. MIDDLE: Lower drive strength (middle mode) is selected for port pin's output buffer.
          enumeration PortInputSelection: {TYPE_1_SUPP_PISA, TYPE_2_SUPP_PISA}, set at post-build, origin=Renesas_v1.0.0, default-value=TYPE_1_SUPP_PISA  # This setting specifies the input buffer characteristics. TYPE_1_SUPP_PISA: TYPE 1 buffer is selected. TYPE_2_SUPP_PISA: TYPE 2 buffer is selected.
        container PortPin10  # This container contains the configuration (parameters) for Port Pin 10.
          boolean PortPinDirectionChangeable: set at post-build, origin=Renesas_v1.0.0, default-value=false  # Parameter to indicate if the direction is changeable on a port pin during runtime. true: Port Pin direction changeable enabled. false: Port Pin direction changeable disabled.
          boolean PortPinDioAltModeChangeable: set at post-build, origin=Renesas_v1.0.0, default-value=false  # Parameter to indicate if the mode of a port pin is changeable between DIO and Alternate during runtime by API functions Port_SetToDioMode and Port_SetToAlternateMode. Including these APIs is controlled by PortSetToDioAltModeApi. true: Dio Alternate mode is changeable. false: Dio Alternate mode is not changeable.
          boolean PortPinModeChangeable: set at post-build, origin=Renesas_v1.0.0, default-value=false  # Parameter to indicate if the mode of a port pin is changeable during runtime by API function Port_SetPinMode. Including this API is controlled by PortSetPinModeApi. true: Port Pin mode is changeable. false: Port Pin mode is not changeable.
          enumeration PortPinLevelValue: {PORT_PIN_LEVEL_LOW, PORT_PIN_LEVEL_HIGH}, set at post-build, origin=Renesas_v1.0.0, default-value=PORT_PIN_LEVEL_LOW  # Parameter to indicate port pin level value for a port pin. PORT_PIN_LEVEL_LOW: Port pin Level is low. PORT_PIN_LEVEL_HIGH: Port pin Level is high.
          enumeration PortPinInitialMode: {ADCD1CNV0_ALT2_OUT, DIO}, set at post-build, origin=Renesas_v1.0.0, default-value=DIO  # Mode of the port pin for use with Port_Init() function. <Input name>_ALT<Alternative instance>_IN: Provides alternative instance for selected input. <Output name>_ALT<Alternative instance>_OUT: Provides alternative instance for selected output.
          enumeration PortPinDirection: {PORT_PIN_OUT, PORT_PIN_IN}, set at post-build, origin=Renesas_v1.0.0, default-value=PORT_PIN_IN  # The initial direction of the pin (IN or OUT). If the direction is not changeable, the value configured here is fixed. The direction must match the pin mode. PORT_PIN_IN: Port pin direction set as input. PORT_PIN_OUT: Port pin direction set as output.
          boolean PortInputBufferControl: set at post-build, origin=Renesas_v1.0.0, default-value=false  # This parameter is used as one of the factors to enable/disable port pins input buffer in DIO Mode (PMC=0). true: Port pin's input buffer is ready to be enabled in DIO Mode. false: Port pin's input buffer is disabled in DIO Mode.
          boolean PortBiDirectionControl: set at post-build, origin=Renesas_v1.0.0, default-value=false  # This parameter forces port pins input buffer and output buffer at the same time. If activated, the effect is valid independently from any other port settings. true: Activate forced Bi-directional IO buffer of the port pin. false: Deactivate forced Bi-directional IO buffer of the port pin.
          boolean PortPullUpOption: set at post-build, origin=Renesas_v1.0.0, default-value=false  # This register switches on or off the port pins pull-up resistor. true: Port pin's pull-up resistor is enabled. false: Port pin's pull-up resistor is disabled.
          boolean PortPullDownOption: set at post-build, origin=Renesas_v1.0.0, default-value=false  # This parameter switches on or off the port pins pull-down resistor. true: Port pin's pull-down resistor is enabled. false: Port pin's pull-down resistor is disabled.
          enumeration PortOpenDrainControl_Expansion: {OpenDrain_PushPull, OpenDrain_N_Channel, OpenDrain_P_Channel}, set at post-build, origin=Renesas_v1.0.0, default-value=OpenDrain_PushPull  # This parameter selects port pins output buffer function in combination of PODC and PODCE . | OpenDrain_PushPull Specifies the OpenDrain_PushPull open drain type output circuit characteristics and updates both PODC and PODCE registers as 0 0 respectively. OpenDrain_N_Channel specifies the N-ch open drain type output circuit characteristics and updates the PODC and PODCE registers as 1 0 respectively. OpenDrain_P_Channel specifies the P-ch open drain type output circuit characteristics and updates the PODC and PODCE registers as 1 1 respectively.
          boolean PortOutputLevelInversion: set at post-build, origin=Renesas_v1.0.0, default-value=false  # This parameter specifies whether the output level from a pin is inverted or not.. true: Pin output level is inverted. false: Pin output level is not inverted.
          enumeration PortDriveStrengthControl: {SLOW, FAST, MIDDLE_0, MIDDLE_1}, set at post-build, origin=Renesas_v1.0.0, default-value=SLOW  # This parameter selects the port pins output drive strength as high strength or low strength type. This functionality is also referred to fast (high strength) and slow (low strength) behavior of output buffer. SLOW: Lower drive strength (slow mode) is selected for port pin's output buffer. FAST: Higher drive strength (fast mode) is selected for port pin's output buffer. MIDDLE_0: Lower drive strength (middle mode) is selected for port pin's output buffer. MIDDLE_1: Lower drive strength (middle mode) is selected for port pin's output buffer.
          enumeration PortUnlimitedCurrentControl: {SLOW, FAST, MIDDLE}, set at post-build, origin=Renesas_v4.0.0, default-value=SLOW  # This parameter selects the port pins output drive strength as high or low type. This functionality is also referred to fast (high strength) and slow (low strength) behavior of output buffer. The PortDriveStrengthControl must be enabled for this feature. | SLOW: Lower drive strength (slow mode) is selected for port pin's output buffer. FAST: Higher drive strength (fast mode) is selected for port pin's output buffer. MIDDLE: Lower drive strength (middle mode) is selected for port pin's output buffer.
        container PortPin11  # This container contains the configuration (parameters) for Port Pin 11.
          boolean PortPinDirectionChangeable: set at post-build, origin=Renesas_v1.0.0, default-value=false  # Parameter to indicate if the direction is changeable on a port pin during runtime. true: Port Pin direction changeable enabled. false: Port Pin direction changeable disabled.
          boolean PortPinDioAltModeChangeable: set at post-build, origin=Renesas_v1.0.0, default-value=false  # Parameter to indicate if the mode of a port pin is changeable between DIO and Alternate during runtime by API functions Port_SetToDioMode and Port_SetToAlternateMode. Including these APIs is controlled by PortSetToDioAltModeApi. true: Dio Alternate mode is changeable. false: Dio Alternate mode is not changeable.
          boolean PortPinModeChangeable: set at post-build, origin=Renesas_v1.0.0, default-value=false  # Parameter to indicate if the mode of a port pin is changeable during runtime by API function Port_SetPinMode. Including this API is controlled by PortSetPinModeApi. true: Port Pin mode is changeable. false: Port Pin mode is not changeable.
          enumeration PortPinLevelValue: {PORT_PIN_LEVEL_LOW, PORT_PIN_LEVEL_HIGH}, set at post-build, origin=Renesas_v1.0.0, default-value=PORT_PIN_LEVEL_LOW  # Parameter to indicate port pin level value for a port pin. PORT_PIN_LEVEL_LOW: Port pin Level is low. PORT_PIN_LEVEL_HIGH: Port pin Level is high.
          enumeration PortPinInitialMode: {ADCD1CNV2_ALT2_OUT, DIO}, set at post-build, origin=Renesas_v1.0.0, default-value=DIO  # Mode of the port pin for use with Port_Init() function. <Input name>_ALT<Alternative instance>_IN: Provides alternative instance for selected input. <Output name>_ALT<Alternative instance>_OUT: Provides alternative instance for selected output.
          enumeration PortPinDirection: {PORT_PIN_OUT, PORT_PIN_IN}, set at post-build, origin=Renesas_v1.0.0, default-value=PORT_PIN_IN  # The initial direction of the pin (IN or OUT). If the direction is not changeable, the value configured here is fixed. The direction must match the pin mode. PORT_PIN_IN: Port pin direction set as input. PORT_PIN_OUT: Port pin direction set as output.
          boolean PortInputBufferControl: set at post-build, origin=Renesas_v1.0.0, default-value=false  # This parameter is used as one of the factors to enable/disable port pins input buffer in DIO Mode (PMC=0). true: Port pin's input buffer is ready to be enabled in DIO Mode. false: Port pin's input buffer is disabled in DIO Mode.
          boolean PortBiDirectionControl: set at post-build, origin=Renesas_v1.0.0, default-value=false  # This parameter forces port pins input buffer and output buffer at the same time. If activated, the effect is valid independently from any other port settings. true: Activate forced Bi-directional IO buffer of the port pin. false: Deactivate forced Bi-directional IO buffer of the port pin.
          boolean PortPullUpOption: set at post-build, origin=Renesas_v1.0.0, default-value=false  # This register switches on or off the port pins pull-up resistor. true: Port pin's pull-up resistor is enabled. false: Port pin's pull-up resistor is disabled.
          boolean PortPullDownOption: set at post-build, origin=Renesas_v1.0.0, default-value=false  # This parameter switches on or off the port pins pull-down resistor. true: Port pin's pull-down resistor is enabled. false: Port pin's pull-down resistor is disabled.
          enumeration PortOpenDrainControl_Expansion: {OpenDrain_PushPull, OpenDrain_N_Channel, OpenDrain_P_Channel}, set at post-build, origin=Renesas_v1.0.0, default-value=OpenDrain_PushPull  # This parameter selects port pins output buffer function in combination of PODC and PODCE . | OpenDrain_PushPull Specifies the OpenDrain_PushPull open drain type output circuit characteristics and updates both PODC and PODCE registers as 0 0 respectively. OpenDrain_N_Channel specifies the N-ch open drain type output circuit characteristics and updates the PODC and PODCE registers as 1 0 respectively. OpenDrain_P_Channel specifies the P-ch open drain type output circuit characteristics and updates the PODC and PODCE registers as 1 1 respectively.
          boolean PortOutputLevelInversion: set at post-build, origin=Renesas_v1.0.0, default-value=false  # This parameter specifies whether the output level from a pin is inverted or not.. true: Pin output level is inverted. false: Pin output level is not inverted.
          enumeration PortDriveStrengthControl: {SLOW, FAST, MIDDLE_0, MIDDLE_1}, set at post-build, origin=Renesas_v1.0.0, default-value=SLOW  # This parameter selects the port pins output drive strength as high strength or low strength type. This functionality is also referred to fast (high strength) and slow (low strength) behavior of output buffer. SLOW: Lower drive strength (slow mode) is selected for port pin's output buffer. FAST: Higher drive strength (fast mode) is selected for port pin's output buffer. MIDDLE_0: Lower drive strength (middle mode) is selected for port pin's output buffer. MIDDLE_1: Lower drive strength (middle mode) is selected for port pin's output buffer.
          enumeration PortUnlimitedCurrentControl: {SLOW, FAST, MIDDLE}, set at post-build, origin=Renesas_v4.0.0, default-value=SLOW  # This parameter selects the port pins output drive strength as high or low type. This functionality is also referred to fast (high strength) and slow (low strength) behavior of output buffer. The PortDriveStrengthControl must be enabled for this feature. | SLOW: Lower drive strength (slow mode) is selected for port pin's output buffer. FAST: Higher drive strength (fast mode) is selected for port pin's output buffer. MIDDLE: Lower drive strength (middle mode) is selected for port pin's output buffer.
        container PortPin12  # This container contains the configuration (parameters) for Port Pin 12.
          boolean PortPinDirectionChangeable: set at post-build, origin=Renesas_v1.0.0, default-value=false  # Parameter to indicate if the direction is changeable on a port pin during runtime. true: Port Pin direction changeable enabled. false: Port Pin direction changeable disabled.
          boolean PortPinDioAltModeChangeable: set at post-build, origin=Renesas_v1.0.0, default-value=false  # Parameter to indicate if the mode of a port pin is changeable between DIO and Alternate during runtime by API functions Port_SetToDioMode and Port_SetToAlternateMode. Including these APIs is controlled by PortSetToDioAltModeApi. true: Dio Alternate mode is changeable. false: Dio Alternate mode is not changeable.
          boolean PortPinModeChangeable: set at post-build, origin=Renesas_v1.0.0, default-value=false  # Parameter to indicate if the mode of a port pin is changeable during runtime by API function Port_SetPinMode. Including this API is controlled by PortSetPinModeApi. true: Port Pin mode is changeable. false: Port Pin mode is not changeable.
          enumeration PortPinLevelValue: {PORT_PIN_LEVEL_LOW, PORT_PIN_LEVEL_HIGH}, set at post-build, origin=Renesas_v1.0.0, default-value=PORT_PIN_LEVEL_LOW  # Parameter to indicate port pin level value for a port pin. PORT_PIN_LEVEL_LOW: Port pin Level is low. PORT_PIN_LEVEL_HIGH: Port pin Level is high.
          enumeration PortPinInitialMode: {ADCD1CNV3_ALT2_OUT, DIO}, set at post-build, origin=Renesas_v1.0.0, default-value=DIO  # Mode of the port pin for use with Port_Init() function. <Input name>_ALT<Alternative instance>_IN: Provides alternative instance for selected input. <Output name>_ALT<Alternative instance>_OUT: Provides alternative instance for selected output.
          enumeration PortPinDirection: {PORT_PIN_OUT, PORT_PIN_IN}, set at post-build, origin=Renesas_v1.0.0, default-value=PORT_PIN_IN  # The initial direction of the pin (IN or OUT). If the direction is not changeable, the value configured here is fixed. The direction must match the pin mode. PORT_PIN_IN: Port pin direction set as input. PORT_PIN_OUT: Port pin direction set as output.
          boolean PortInputBufferControl: set at post-build, origin=Renesas_v1.0.0, default-value=false  # This parameter is used as one of the factors to enable/disable port pins input buffer in DIO Mode (PMC=0). true: Port pin's input buffer is ready to be enabled in DIO Mode. false: Port pin's input buffer is disabled in DIO Mode.
          boolean PortBiDirectionControl: set at post-build, origin=Renesas_v1.0.0, default-value=false  # This parameter forces port pins input buffer and output buffer at the same time. If activated, the effect is valid independently from any other port settings. true: Activate forced Bi-directional IO buffer of the port pin. false: Deactivate forced Bi-directional IO buffer of the port pin.
          boolean PortPullUpOption: set at post-build, origin=Renesas_v1.0.0, default-value=false  # This register switches on or off the port pins pull-up resistor. true: Port pin's pull-up resistor is enabled. false: Port pin's pull-up resistor is disabled.
          boolean PortPullDownOption: set at post-build, origin=Renesas_v1.0.0, default-value=false  # This parameter switches on or off the port pins pull-down resistor. true: Port pin's pull-down resistor is enabled. false: Port pin's pull-down resistor is disabled.
          enumeration PortOpenDrainControl_Expansion: {OpenDrain_PushPull, OpenDrain_N_Channel, OpenDrain_P_Channel}, set at post-build, origin=Renesas_v1.0.0, default-value=OpenDrain_PushPull  # This parameter selects port pins output buffer function in combination of PODC and PODCE . | OpenDrain_PushPull Specifies the OpenDrain_PushPull open drain type output circuit characteristics and updates both PODC and PODCE registers as 0 0 respectively. OpenDrain_N_Channel specifies the N-ch open drain type output circuit characteristics and updates the PODC and PODCE registers as 1 0 respectively. OpenDrain_P_Channel specifies the P-ch open drain type output circuit characteristics and updates the PODC and PODCE registers as 1 1 respectively.
          boolean PortOutputLevelInversion: set at post-build, origin=Renesas_v1.0.0, default-value=false  # This parameter specifies whether the output level from a pin is inverted or not.. true: Pin output level is inverted. false: Pin output level is not inverted.
          enumeration PortDriveStrengthControl: {SLOW, FAST, MIDDLE_0, MIDDLE_1}, set at post-build, origin=Renesas_v1.0.0, default-value=SLOW  # This parameter selects the port pins output drive strength as high strength or low strength type. This functionality is also referred to fast (high strength) and slow (low strength) behavior of output buffer. SLOW: Lower drive strength (slow mode) is selected for port pin's output buffer. FAST: Higher drive strength (fast mode) is selected for port pin's output buffer. MIDDLE_0: Lower drive strength (middle mode) is selected for port pin's output buffer. MIDDLE_1: Lower drive strength (middle mode) is selected for port pin's output buffer.
          enumeration PortUnlimitedCurrentControl: {SLOW, FAST, MIDDLE}, set at post-build, origin=Renesas_v4.0.0, default-value=SLOW  # This parameter selects the port pins output drive strength as high or low type. This functionality is also referred to fast (high strength) and slow (low strength) behavior of output buffer. The PortDriveStrengthControl must be enabled for this feature. | SLOW: Lower drive strength (slow mode) is selected for port pin's output buffer. FAST: Higher drive strength (fast mode) is selected for port pin's output buffer. MIDDLE: Lower drive strength (middle mode) is selected for port pin's output buffer.
        container PortPin13  # This container contains the configuration (parameters) for Port Pin 13.
          boolean PortPinDirectionChangeable: set at post-build, origin=Renesas_v1.0.0, default-value=false  # Parameter to indicate if the direction is changeable on a port pin during runtime. true: Port Pin direction changeable enabled. false: Port Pin direction changeable disabled.
          boolean PortPinDioAltModeChangeable: set at post-build, origin=Renesas_v1.0.0, default-value=false  # Parameter to indicate if the mode of a port pin is changeable between DIO and Alternate during runtime by API functions Port_SetToDioMode and Port_SetToAlternateMode. Including these APIs is controlled by PortSetToDioAltModeApi. true: Dio Alternate mode is changeable. false: Dio Alternate mode is not changeable.
          boolean PortPinModeChangeable: set at post-build, origin=Renesas_v1.0.0, default-value=false  # Parameter to indicate if the mode of a port pin is changeable during runtime by API function Port_SetPinMode. Including this API is controlled by PortSetPinModeApi. true: Port Pin mode is changeable. false: Port Pin mode is not changeable.
          enumeration PortPinLevelValue: {PORT_PIN_LEVEL_LOW, PORT_PIN_LEVEL_HIGH}, set at post-build, origin=Renesas_v1.0.0, default-value=PORT_PIN_LEVEL_LOW  # Parameter to indicate port pin level value for a port pin. PORT_PIN_LEVEL_LOW: Port pin Level is low. PORT_PIN_LEVEL_HIGH: Port pin Level is high.
          enumeration PortPinInitialMode: {OSTM0ODI_ALT1_IN, OSTM0O_ALT1_OUT, TAUD1ODI15_ALT2_IN, TAUD1O15_ALT2_OUT, TAUD2I7_ALT3_IN, INTP9_ALT4_IN, TAUD2O7_ALT4_OUT, DIO}, set at post-build, origin=Renesas_v1.0.0, default-value=DIO  # Mode of the port pin for use with Port_Init() function. <Input name>_ALT<Alternative instance>_IN: Provides alternative instance for selected input. <Output name>_ALT<Alternative instance>_OUT: Provides alternative instance for selected output.
          enumeration PortPinDirection: {PORT_PIN_OUT, PORT_PIN_IN}, set at post-build, origin=Renesas_v1.0.0, default-value=PORT_PIN_IN  # The initial direction of the pin (IN or OUT). If the direction is not changeable, the value configured here is fixed. The direction must match the pin mode. PORT_PIN_IN: Port pin direction set as input. PORT_PIN_OUT: Port pin direction set as output.
          boolean PortInputBufferControl: set at post-build, origin=Renesas_v1.0.0, default-value=false  # This parameter is used as one of the factors to enable/disable port pins input buffer in DIO Mode (PMC=0). true: Port pin's input buffer is ready to be enabled in DIO Mode. false: Port pin's input buffer is disabled in DIO Mode.
          boolean PortBiDirectionControl: set at post-build, origin=Renesas_v1.0.0, default-value=false  # This parameter forces port pins input buffer and output buffer at the same time. If activated, the effect is valid independently from any other port settings. true: Activate forced Bi-directional IO buffer of the port pin. false: Deactivate forced Bi-directional IO buffer of the port pin.
          boolean PortPullUpOption: set at post-build, origin=Renesas_v1.0.0, default-value=false  # This register switches on or off the port pins pull-up resistor. true: Port pin's pull-up resistor is enabled. false: Port pin's pull-up resistor is disabled.
          boolean PortPullDownOption: set at post-build, origin=Renesas_v1.0.0, default-value=false  # This parameter switches on or off the port pins pull-down resistor. true: Port pin's pull-down resistor is enabled. false: Port pin's pull-down resistor is disabled.
          enumeration PortOpenDrainControl_Expansion: {OpenDrain_PushPull, OpenDrain_N_Channel, OpenDrain_P_Channel}, set at post-build, origin=Renesas_v1.0.0, default-value=OpenDrain_PushPull  # This parameter selects port pins output buffer function in combination of PODC and PODCE . | OpenDrain_PushPull Specifies the OpenDrain_PushPull open drain type output circuit characteristics and updates both PODC and PODCE registers as 0 0 respectively. OpenDrain_N_Channel specifies the N-ch open drain type output circuit characteristics and updates the PODC and PODCE registers as 1 0 respectively. OpenDrain_P_Channel specifies the P-ch open drain type output circuit characteristics and updates the PODC and PODCE registers as 1 1 respectively.
          boolean PortOutputLevelInversion: set at post-build, origin=Renesas_v1.0.0, default-value=false  # This parameter specifies whether the output level from a pin is inverted or not.. true: Pin output level is inverted. false: Pin output level is not inverted.
          enumeration PortDriveStrengthControl: {SLOW, FAST, MIDDLE_0, MIDDLE_1}, set at post-build, origin=Renesas_v1.0.0, default-value=SLOW  # This parameter selects the port pins output drive strength as high strength or low strength type. This functionality is also referred to fast (high strength) and slow (low strength) behavior of output buffer. SLOW: Lower drive strength (slow mode) is selected for port pin's output buffer. FAST: Higher drive strength (fast mode) is selected for port pin's output buffer. MIDDLE_0: Lower drive strength (middle mode) is selected for port pin's output buffer. MIDDLE_1: Lower drive strength (middle mode) is selected for port pin's output buffer.
          enumeration PortUnlimitedCurrentControl: {SLOW, FAST, MIDDLE}, set at post-build, origin=Renesas_v4.0.0, default-value=SLOW  # This parameter selects the port pins output drive strength as high or low type. This functionality is also referred to fast (high strength) and slow (low strength) behavior of output buffer. The PortDriveStrengthControl must be enabled for this feature. | SLOW: Lower drive strength (slow mode) is selected for port pin's output buffer. FAST: Higher drive strength (fast mode) is selected for port pin's output buffer. MIDDLE: Lower drive strength (middle mode) is selected for port pin's output buffer.
          enumeration PortInputSelection: {TYPE_1_SUPP_PISA, TYPE_2_SUPP_PISA}, set at post-build, origin=Renesas_v1.0.0, default-value=TYPE_1_SUPP_PISA  # This setting specifies the input buffer characteristics. TYPE_1_SUPP_PISA: TYPE 1 buffer is selected. TYPE_2_SUPP_PISA: TYPE 2 buffer is selected.
        container PortPin14  # This container contains the configuration (parameters) for Port Pin 14.
          boolean PortPinDirectionChangeable: set at post-build, origin=Renesas_v1.0.0, default-value=false  # Parameter to indicate if the direction is changeable on a port pin during runtime. true: Port Pin direction changeable enabled. false: Port Pin direction changeable disabled.
          boolean PortPinDioAltModeChangeable: set at post-build, origin=Renesas_v1.0.0, default-value=false  # Parameter to indicate if the mode of a port pin is changeable between DIO and Alternate during runtime by API functions Port_SetToDioMode and Port_SetToAlternateMode. Including these APIs is controlled by PortSetToDioAltModeApi. true: Dio Alternate mode is changeable. false: Dio Alternate mode is not changeable.
          boolean PortPinModeChangeable: set at post-build, origin=Renesas_v1.0.0, default-value=false  # Parameter to indicate if the mode of a port pin is changeable during runtime by API function Port_SetPinMode. Including this API is controlled by PortSetPinModeApi. true: Port Pin mode is changeable. false: Port Pin mode is not changeable.
          enumeration PortPinLevelValue: {PORT_PIN_LEVEL_LOW, PORT_PIN_LEVEL_HIGH}, set at post-build, origin=Renesas_v1.0.0, default-value=PORT_PIN_LEVEL_LOW  # Parameter to indicate port pin level value for a port pin. PORT_PIN_LEVEL_LOW: Port pin Level is low. PORT_PIN_LEVEL_HIGH: Port pin Level is high.
          enumeration PortPinInitialMode: {ADCD1CNV4_ALT2_OUT, DIO}, set at post-build, origin=Renesas_v1.0.0, default-value=DIO  # Mode of the port pin for use with Port_Init() function. <Input name>_ALT<Alternative instance>_IN: Provides alternative instance for selected input. <Output name>_ALT<Alternative instance>_OUT: Provides alternative instance for selected output.
          enumeration PortPinDirection: {PORT_PIN_OUT, PORT_PIN_IN}, set at post-build, origin=Renesas_v1.0.0, default-value=PORT_PIN_IN  # The initial direction of the pin (IN or OUT). If the direction is not changeable, the value configured here is fixed. The direction must match the pin mode. PORT_PIN_IN: Port pin direction set as input. PORT_PIN_OUT: Port pin direction set as output.
          boolean PortInputBufferControl: set at post-build, origin=Renesas_v1.0.0, default-value=false  # This parameter is used as one of the factors to enable/disable port pins input buffer in DIO Mode (PMC=0). true: Port pin's input buffer is ready to be enabled in DIO Mode. false: Port pin's input buffer is disabled in DIO Mode.
          boolean PortBiDirectionControl: set at post-build, origin=Renesas_v1.0.0, default-value=false  # This parameter forces port pins input buffer and output buffer at the same time. If activated, the effect is valid independently from any other port settings. true: Activate forced Bi-directional IO buffer of the port pin. false: Deactivate forced Bi-directional IO buffer of the port pin.
          boolean PortPullUpOption: set at post-build, origin=Renesas_v1.0.0, default-value=false  # This register switches on or off the port pins pull-up resistor. true: Port pin's pull-up resistor is enabled. false: Port pin's pull-up resistor is disabled.
          boolean PortPullDownOption: set at post-build, origin=Renesas_v1.0.0, default-value=false  # This parameter switches on or off the port pins pull-down resistor. true: Port pin's pull-down resistor is enabled. false: Port pin's pull-down resistor is disabled.
          enumeration PortOpenDrainControl_Expansion: {OpenDrain_PushPull, OpenDrain_N_Channel, OpenDrain_P_Channel}, set at post-build, origin=Renesas_v1.0.0, default-value=OpenDrain_PushPull  # This parameter selects port pins output buffer function in combination of PODC and PODCE . | OpenDrain_PushPull Specifies the OpenDrain_PushPull open drain type output circuit characteristics and updates both PODC and PODCE registers as 0 0 respectively. OpenDrain_N_Channel specifies the N-ch open drain type output circuit characteristics and updates the PODC and PODCE registers as 1 0 respectively. OpenDrain_P_Channel specifies the P-ch open drain type output circuit characteristics and updates the PODC and PODCE registers as 1 1 respectively.
          boolean PortOutputLevelInversion: set at post-build, origin=Renesas_v1.0.0, default-value=false  # This parameter specifies whether the output level from a pin is inverted or not.. true: Pin output level is inverted. false: Pin output level is not inverted.
          enumeration PortDriveStrengthControl: {SLOW, FAST, MIDDLE_0, MIDDLE_1}, set at post-build, origin=Renesas_v1.0.0, default-value=SLOW  # This parameter selects the port pins output drive strength as high strength or low strength type. This functionality is also referred to fast (high strength) and slow (low strength) behavior of output buffer. SLOW: Lower drive strength (slow mode) is selected for port pin's output buffer. FAST: Higher drive strength (fast mode) is selected for port pin's output buffer. MIDDLE_0: Lower drive strength (middle mode) is selected for port pin's output buffer. MIDDLE_1: Lower drive strength (middle mode) is selected for port pin's output buffer.
          enumeration PortUnlimitedCurrentControl: {SLOW, FAST, MIDDLE}, set at post-build, origin=Renesas_v4.0.0, default-value=SLOW  # This parameter selects the port pins output drive strength as high or low type. This functionality is also referred to fast (high strength) and slow (low strength) behavior of output buffer. The PortDriveStrengthControl must be enabled for this feature. | SLOW: Lower drive strength (slow mode) is selected for port pin's output buffer. FAST: Higher drive strength (fast mode) is selected for port pin's output buffer. MIDDLE: Lower drive strength (middle mode) is selected for port pin's output buffer.
