AUTOSAR XML (schema 4-0-3)
package /MICROSAR
  module definition Fee [0..1]: category=VENDOR_SPECIFIC_MODULE_DEFINITION, refined-module-def=Fee, variants pre-compile  # Configuration of the Fee (Flash EEPROM Emulation) module.
    container FeeBlockConfiguration [1..*]  # Block Configuration | This container includes the configuration of block specific parameters for the FEE module.
      integer FeeBlockNumber: 1..65534, set at pre-compile, symbolic-name-value=true, default-value=2  # Block Number | This value specifies the block identifier (handle). | 0x0000 and 0xFFFF shall not be used for block numbers (see FEE006). Range: min = 2^NVM_DATASET_SELECTION_BITS max = 0xFFFF -2^NVM_DATASET_SELECTION_BITS Note: Depending on the number of bits set aside for dataset selection several other block numbers shall also be left out to ease implementation.
      integer FeeBlockSize: 1..65535, set at pre-compile, default-value=1  # Block Size | This value specifies the size of a logical block.
      boolean FeeImmediateData: set at pre-compile, default-value=false  # Immediate Data | This parameter defines if this block has high priority data. | true: Block contains immediate data. false: Block does not contain immediate data.
      integer FeeNumberOfWriteCycles: 0..10000000, set at pre-compile, default-value=10000  # Number Of Write Cycles | This value specifies the number of write cycles required for this block.
      integer FeeNumberOfChunkInstances: 1..32767, set at pre-compile, origin=Vector Informatik, default-value=1  # Number Of Instances In Chunk | This value specifies the number of instances in one chunk of a certain block. Hint: The number of chunks must be a value of (2^n) - 1.
      integer FeeNumberOfDatasets: 1..255, set at pre-compile, origin=Vector Informatik, default-value=1  # Number Of Datasets | This value specifies the number of datasets/clones. This is the value how often an individual block exists.
      boolean FeeBlockIdFixed: set at pre-compile, origin=Vector Informatik, default-value=false  # Block Id Fixed | This parameters defines that the BlockId is fixed. The value will then not be updated during calculation.
      integer FeeBlockId: 0..65534, set at pre-compile, origin=Vector Informatik, default-value=0  # Block Id | This value specifies the BlockID which indicates the base (aka: "tag") of a Block within its associated partition. The Block can be uniquely identified using partition, FeeBlockId and block's DataIndex. Being able to uniquely identify each Block accross different configurations, is a prerequisite for supporting confiuration updates, especially: - which blocks were changed, which were not (ant thus should remain readable) - which block(s) is/are used to share information between FBL and Application FeeBlockNumber cannot serve for this purpose, because its interpretation changes, if deataset selection bit (thus the maximum number of Datasets used in NVM) changes. The ID must be unique within block's partition; blocks within different partitions may share the same value.
      boolean FeeBlockIsCritical: set at pre-compile, origin=Vector Informatik, default-value=false  # Critical Data | This parameter defines the criticality of Data, regarding data losses in exceptional situations (especially Sector Overflow). TRUE: Most recent data must never be lost FALSE: Most recent data may be lost in order to keep FEE writable Usually the criticality depends on the write frequency: The more often a block is being written, the lower its criticality. It is not recommended to check this option while "immediate data" is also set!
      symbolic name reference FeeDeviceIndex [0..1]: set at pre-compile, destination=FlsGeneral  # Device Index | Not used! Reference to Fls driver. | Range: 0 .. 254 (0xFF reserved for broadcast call to GetStatus function).
      reference FeePartition: set at pre-compile, origin=Vector Informatik, destination=FeePartitionConfiguration  # Partition | Reference to the partition within the FEE configuration.
    container FeeGeneral  # General | General configuration parameters of the FEE.
      boolean FeeDevErrorDetect: set at pre-compile, default-value=true  # Development Error Detection | This parameter switches the Development Error Detection and Notification ON or OFF. true: Development error detection is enabled. false: Development error detection is disabled. Note: In general, the development error detection is recommended during pre-test phase. It is not recommended to enable the development error detection in production code due to increased runtime and ROM needs. | true: Development error detection enabled. false: Development error detection disabled.
      integer FeeIndex: 0..254, set at pre-compile, default-value=0  # Instance Id | This value specifies the InstanceId of this module instance. If only one instance is present it shall have the Id 0.
      function name FeeNvmJobEndNotification: set at pre-compile, default-value=NvM_JobEndNotification, max-length=64, min-length=1  # NvM Job End Notification | This parameter defines the job end notification routine provided by the upper layer module (normally NvM_JobEndNotification).
      function name FeeNvmJobErrorNotification: set at pre-compile, default-value=NvM_JobErrorNotification, max-length=64, min-length=1  # NvM Job Error Notification | This parameter defines the job error notification routine provided by the upper layer module (normally NvM_JobErrorNotification).
      boolean FeePollingMode: set at pre-compile, default-value=true  # Polling Mode | This parameter defines if the polling mode for this module is enabled. | true: Polling mode enabled, callback functions (provided to FLS module) disabled. false: Polling mode disabled, callback functions (provided to FLS module) enabled.
      boolean FeeSetModeSupported [0..1]: set at pre-compile, default-value=true  # Povide Fee_SetMode API | Not used! This parameter defines if the 'SetMode' functionality of the FEE module is available. Fee always provides SetMode API, it is an important control feature. | TRUE: SetMode functionality supported / code present, FALSE: SetMode functionality not supported / code not present. Note: This configuration setting has to be consistent with that of all underlying flash device drivers (configuration parameter FlsSetModeApi).
      boolean FeeVersionInfoApi: set at pre-compile, default-value=false  # Version Information Api | This parameter enables/disables the function Fee_GetVersionInfo() to get major, minor and patch version information. | true: Version info API enabled. false: Version info API disabled.
      integer FeeVirtualPageSize [0..1]: 0..1024, set at pre-compile, default-value=8  # Virtual Page Size | Not used! This value specifies the size to which logical blocks shall be aligned.
      integer FeeInternalBufferSize: 64..1024, set at pre-compile, origin=Vector Informatik, default-value=64  # Internal Buffer Size | This value specifies the size of the internal buffer. The internal buffer is used to assemble management information, to merge these management information with user data (to reduce alignment gaps), and as read buffer when copying data during sector switch processing. Note: The buffer must always be larger than write page size. It may be smaller than largest block, because FEE adapts its copy process to internal buffer size. However, the larger the buffer, the fewer read-write sequences (from Fls, to Fls) the FEE has to perform in order to copy data.
      boolean FeeCfgChkParamBlockNumber: set at pre-compile, origin=Vector Informatik, default-value=true  # Block Number Check | This parameter defines if the block parameter in API calls is checked for development error detection. Hint: This parameter is only relevant if (FeeDevErrorDetect == true).
      string FeeNvmCbkIncludeFile [0..1]: set at pre-compile, origin=Vector Informatik, default-value=NvM_Cbk.h, max-length=32, min-length=1  # NvM Callback Include File | This parameter defines the name of the include file for callback functions declaration of the NvM.
      float FeeMainFunctionPeriod: 0.0001..1, set at published-information, origin=Vector Informatik, default-value=0.005  # Call Cycle of NvM_MainFunction | Specify fixed call cycle for Fee_MainFunction. This information affects RTE's (SchM's) settings. Fee itself does not depend on a fixed cycle time; in can be triggered at arbitrary rates. In general, Fee_MainFunction should be called as fast as possible, because it has to perform search operations in Flash, which may result in many read requests issued to FLS, at most one per MainFunction cycle. Increasing trigger rates also helps to decrease write times themselves, which results in less time the flash is intermediately in inconsistent state, vulnerable to aborts (resets). It is not necessary to trigger FEE faster than FLS Also note that large values in FeeInternalBufferSize influence maximum duration of a Fee_MainFunction call. The faster you want Fee_MainFunction being triggered, the smaller this value should be and vice versa. Also note, that notification functions may arbitrarily extend Fee_MainFunction's maximum duration.
      enumeration FeeMainFunctionTriggering: set at published-information, origin=Vector Informatik, default-value=FixedCycleTime  # The MainFunction can be scheduled in different ways, which allows adapting the runtime behavior - FixedCycleTime: All activities are executed in the MainFunction with the defined cycle time. - BackgroundTask: Activities that do not require a fixed cycle time run in the background task. The response time of such activities will depend on the current CPU load. Note If the system is overloaded, it may happen that the background task is no longer called.
        FixedCycleTime  # Task for Fixed Cycle Time
        BackgroundTask  # Background Task
      container FeeFlsApi [0..*]  # Fls Api | This container includes Flash API parameters. The parameters can be used to announce Flash API's for non AUTOSAR compliant Flash drivers.
        string FeeFlsIncludeFile: set at pre-compile, origin=Vector Informatik, default-value=Fls.h  # Fls Include File | This parameter defines the name of the header File of the Flash Driver.
        function name FeeFlsSetMode: set at pre-compile, origin=Vector Informatik, default-value=Fls_SetMode  # Fls SetMode API | This parameter defines the name of the Flash SetMode API.
        function name FeeFlsRead: set at pre-compile, origin=Vector Informatik, default-value=Fls_Read  # Fls Read API | This parameter defines the name of the Flash Read API.
        function name FeeFlsWrite: set at pre-compile, origin=Vector Informatik, default-value=Fls_Write  # Fls Write API | This parameter defines the name of the Flash Write API.
        function name FeeFlsCancel: set at pre-compile, origin=Vector Informatik, default-value=Fls_Cancel  # Fls Cancel API | This parameter defines the name of the Flash Cancel API.
        function name FeeFlsGetStatus: set at pre-compile, origin=Vector Informatik, default-value=Fls_GetStatus  # Fls GetStatus API | This parameter defines the name of the Flash GetStatus API.
        function name FeeFlsGetJobResult: set at pre-compile, origin=Vector Informatik, default-value=Fls_GetJobResult  # Fls GetJobResult API | This parameter defines the name of the Flash GetJobResult API.
        function name FeeFlsErase: set at pre-compile, origin=Vector Informatik, default-value=Fls_Erase  # Fls Erase API | This parameter defines the name of the Flash Erase API.
        function name FeeFlsCompare: set at pre-compile, origin=Vector Informatik, default-value=Fls_Compare  # Fls Compare API | This parameter defines the name of the Flash Compare API.
        symbolic name reference FeeFlsDeviceIndex: set at pre-compile, origin=Vector Informatik, destination=FlsGeneral  # Device Index | Reference to a Flash driver.
      container FeeDevErrorChecks  # Development Error Checks | This container includes additional configuration items for the development error detection.
        boolean FeeCfgChkStatusUninit: set at pre-compile, origin=Vector Informatik, default-value=true  # Uinitialization Check | This parameter defines if checks of uninit status are enabled.
        boolean FeeCfgChkBusy: set at pre-compile, origin=Vector Informatik, default-value=true  # Busy Check | This parameter defines it is checked that an asynchronous job is currently running and another one shall be started.
        boolean FeeCfgChkImmediateData: set at pre-compile, origin=Vector Informatik, default-value=true  # Immediate Data Check | This parameter defines that a block, configured to hold high priority data, shall not be erased via the service Fee_EraseImmediateBlock.
        boolean FeeCfgChkParamLengthOffset: set at pre-compile, origin=Vector Informatik, default-value=true  # Length Offset Check | This parameter defines if it is checked that the Fee_Read() API has been called with a valid length or offset value.
        boolean FeeCfgChkParamMode: set at pre-compile, origin=Vector Informatik, default-value=true  # Mode Check | This parameter defines if the check of mode parameter is enabled.
        boolean FeeCfgChkParamNullPointer: set at pre-compile, origin=Vector Informatik, default-value=true  # Null Pointer Check | This parameter defines pointer passed to an API service are not NULL_PTR.
        boolean FeeCfgChkParamSectorNumber: set at pre-compile, origin=Vector Informatik, default-value=true  # Sector Number Check | This parameter defines if it is checked that sector parameter have a correct value.
        boolean FeeCfgDoParamChk: set at pre-compile, origin=Vector Informatik, default-value=true  # Parameter Checks | This parameter defines if parameter checks are done.
        boolean FeeDebugReporting: set at pre-compile, origin=Vector Informatik, default-value=true  # Development Error Reporting | This parameter defines if Development Error Reporting is enabled.
        function name FeeDetErrorhook: set at pre-compile, origin=Vector Informatik, default-value=Det_ReportError  # Det Error Hook | This parameter defines the Errorhook function for development error reporting.
        string FeeDetIncludeFile: set at pre-compile, origin=Vector Informatik, default-value=Det.h  # Det Include File | This parameter defines the include file of the Errorhook function for development error reporting.
    container FeePublishedInformation  # Published Information | This container includes additional published parameters. | Note that these parameters do not have any configuration class setting, since they are published information.
      integer FeeBlockOverhead: 0..2, set at published-information, default-value=2  # Block Overhead | This value specifies the management overhead per logical block. | Note: If the management overhead depends on the block size or block location a formula has to be provided that allows the configurator to calculate the management overhead correctly.
      float FeeMaximumBlockingTime: 0..1, set at published-information, default-value=1  # Maximum Blocking Time | This value specifies the maximum time the FEE module's API routines shall be blocked (delayed) by internal operations. Note: Internal operations in that case means operations that are not explicitly invoked from the upper layer module but need to be handled for proper operation of this module or the underlying memory driver. | Note: Internal operations in that case means operations that are not explicitly invoked from the upper layer module but need to be handled for proper operation of this module or the underlying memory driver.
      integer FeePageOverhead: 0..0, set at published-information, default-value=0  # Page Overhead | This value specifies the management overhead per page. Note: If the management overhead depends on the block size or block location a formula has to be provided that allows the configurator to calculate the management overhead correctly. | Note: If the management overhead depends on the block size or block location a formula has to be provided that allows the configurator to calculate the management overhead correctly.
      integer FeeChunkHeader: 16..16, set at pre-compile, origin=Vector Informatik, default-value=16  # Chunk Header | This value specifies the chunk header size. This parameter is constant and can not be configured by the user.
      integer FeeChunkLink: 8..8, set at pre-compile, origin=Vector Informatik, default-value=8  # Chunk Link | This value specifies the chunk link size. This parameter is constant and can not be configured by the user.
      integer FeeSectorHeader: 8..8, set at pre-compile, origin=Vector Informatik, default-value=8  # Sector Header | This value specifies the sector header size. This parameter is constant and can not be configured by the user.
    container VectorCommonData [0..1]  # Common Data | Not used! This container is obsolete and will be deleted in a future version.
      string BswmdVersion [0..1]: set at pre-compile, origin=Vector Informatik, default-value=8.04.00  # Bswmd Version | Not used! This container is obsolete and will be deleted in a future version. Current Version of Module Description.
    container FeePartitionConfiguration [1..4]  # Partition Configuration | Configuration of partition specific parameters for the Flash EEPROM Emulation module.
      integer FeeBssThresholdReserved: 0..2147483648, set at pre-compile, origin=Vector Informatik  # BSS Threshold Reserved | BSS = Background Sector Switch; Copying data has less priority than serving user requests (including write). SectorSwitch becomes effictive, only if Fee was set to SLOW mode (via Fee_SetMode) This values affects the threshold the FEE starts a sector switch in Background Mode. It specifies the EXTRA amount of flash that shall be remaining when BSS starts. FEE automatically reserves the whole space all blocks in a partition will occupy. This is equal to at least one copy attempt per block. The extra reserve specified here makes room for additional attempts (in case of aborts).
      integer FeeFssThresholdReserved: 0..2147483648, set at pre-compile, origin=Vector Informatik  # FSS Threshold Reserved | FSS = Foreground Sector Switch; this is "last" chance handling of FFE - Sector Switch becomes urgent in order to keep Flash area writeable without using data. "Flash is almost full; clean-up is ugently necessary." Therefore it has higher priority than write jobs (directed to same partition). This values affects the threshold the FEE starts a sector switch in Background Mode. It specifies the EXTRA amount of flash that shall be remaining when BSS starts. FEE automatically reserves the whole space all blocks in a partition will occupy. This is equal to at least one copy attempt per block. The extra reserve specified here makes room for additional attempts (in case of aborts). Note: Once the FSS Threshold was exceeded, Fee_DisableFss() (see "Enable API to allow/prohibit FSS"), would become effective - FEE inhibits any write access. Stopping write accesses this way is the only way to prevent FEE from performing Sector Switches at all.
      integer FeeLowerSectorAddress: 0..2147483648, set at pre-compile, origin=Vector Informatik, default-value=0  # Lower Sector Address | Logical start address of the lower sector.
      integer FeeLowerSectorSize: 1..2147483648, set at pre-compile, origin=Vector Informatik, default-value=1024  # Lower Sector Size | The size of the lower sector in bytes.
      integer FeeUpperSectorAddress: 1..2147483648, set at pre-compile, origin=Vector Informatik, default-value=1024  # Upper Sector Address | Logical start address of the upper sector.
      integer FeeUpperSectorSize: 1..2147483648, set at pre-compile, origin=Vector Informatik, default-value=1024  # Upper Sector Size | The size of the upper sector in bytes.
      integer FeeAddressAlignment: 8..1024, set at pre-compile, origin=Vector Informatik, default-value=16  # Address Alignment | Address Alignment influences the way FEE stores data entities in Flash memory. (Most, but not all) single Entities will start at addresses being an integral multiple of FeeAdressAlignment. This alignment itself must be equal to or greater than this partition's FeeAddress alignment. It needs to be set in a way that distinct data entities cannot influence other entities already stored in flash memory, especially if programming accesses get aborted, e.g. due to a reset. If this value is too small, a reset, aborting a programm access (e.g. writing some data related to a Block A) might cause structures related to another block B becoming unreadable. Unfortunately this is very hardware dependent; some platforms require an even stricter alignment for reading than for writing data.
      integer FeeWriteAlignment: 8..1024, set at pre-compile, origin=Vector Informatik, default-value=8  # Write Alignment | Page Size of Flash Device for write jobs in bytes. This is the alignment of Fls_Write requests the FEE issues to the FLS: As well FlsAddresses as lengths are always multiples of this value. This affects the way FEE manages the flash memory. User data buffers are _not_ affected, i.e. RAM buffers, containing actuall data do not need to obey any specific alignment. This value shall be at least the maximum page size of all fls sectors being used by this partition. Using this value, an even stricter write alignment may be chosen, if it becomes necessary, for some HW specific reason. Such reasons could be consistency limitations caused by error detecting/error correcting codes implemented in HW. E.g.: Some devices support page sizes of 4bytes (which is the smallest writeable entity), but ECC is calculated and stored for 8byte entities. Please read the Fls driver and HW manuals carefully. Note that FEE does not suppport write alignments smaller than 8bytes, even if a Fls driver allows it.
      reference FeePartitionDevice: set at pre-compile, origin=Vector Informatik, destination=FlsConfigSet  # Partition Device | Reference to the device containing the partition. In general pertitions must not refer to different ConfigSets of one device. Currently all partitions must be located in same device.
    container FeeSpecificFeatures  # Specific Features | Container for specific features. These parameters are not specific to a block.
      function name FeeApplErrorCallbackFunction: set at pre-compile, origin=Vector Informatik, default-value=Appl_CriticalErrorCallback  # Application Error Callback Function | Name of user-defined error callback. Prototype: Fee_ErrorCallbackReturnType Fee_ErrorCallbackNotification(uint8 partitionId, Fee_SectorErrorType err)
      string FeeApplErrorCallbackIncludeFile: set at pre-compile, origin=Vector Informatik, default-value=Appl_Include.h  # Application Error Callback Include File | Include file, declaring the "Application Error Callback Function"
      boolean FeeGetEraseCycleApi: set at pre-compile, origin=Vector Informatik, default-value=false  # GetEraseCycle Api | Pre-processor switch to enable and disable the API to read out the erase cycles of a specific sector.
      boolean FeeGetWriteCycleApi: set at pre-compile, origin=Vector Informatik, default-value=false  # GetWriteCycleApi | Pre-processor switch to enable and disable the API to read out the write cycles of a specific block.
      boolean FeeUseApplErrorCallback: set at pre-compile, origin=Vector Informatik, default-value=false  # Application Error Callback | Switch to enable and disable the usage of user-defined Error Callback (named as specified in "Application Error Callback Function") It is called by FEE in case of serious error detected within a partition, such as: - no valid sector header found - formatting sector failed (erase or write sector header) - sector overflow Calback's return value decides, how to coninue: - resolve automatically (accepting the risk of losing data) - force FEE into read only mode - force FEE into reject all mode (even all subsequent reads will fail)
      boolean FeeUseJobCache: set at pre-compile, origin=Vector Informatik, default-value=false  # Use Job Cache | Not used! Switch to enable and disable the usage of the job cache functionality. This feature is currently not implemented; this switch will be ignored.
      boolean FeeForceSectorSwitchApi: set at pre-compile, origin=Vector Informatik, default-value=false  # Force Sector Switch Api | Pre-processor switch to enable and disable the API to force two sector switches.
      boolean FeeDataConversionApi: set at pre-compile, origin=Vector Informatik, default-value=false  # Data Conversion Api | Enable/Disable DataConversion API. Availability of this API is an optional feature that must be explicitly orderd. If it is not available, this parameter's setting is without any effect.
      boolean FeeFblConfig: set at pre-compile, origin=Vector Informatik, default-value=false  # Flash Bootloader Configuration | This parameter indicates, if this configuration is a block configuration for the FBL or the application. It is important to set this value correct, because with this parameter the Fee detects an incomplete configuration.
      integer FeeMaxLinkTableSize: 0..4095, configuration-class-affection=affection-kind=NO-AFFECT, set at pre-compile, origin=Vector Informatik, default-value=4095  # Maximum Number of LinkTable Entries | Limit the maximum number of LinkTable entries. The LinkTable size that will be actually used is the smaller one out of this value and the maximum Id used in Block Configuration. Any Block with a BlockId exceeding maximum Table Size will always be searched using ChunkHopping. A size-limited LinkTable saves flash, at the cost of increased search efforts (for all blocks whose IDs exceed LinkTable size). Limiting the size is only recommended when using rather small flashes (partitions) with large "Write Alignment" (>> 8Bytes), i.e. if Link-Table requires comparably much flash space.
      string FeeDbgCallbackIncludeFile [0..1]: set at pre-compile, origin=Vector Informatik  # Include File for Debug Callbacks | To aid debugging and testing FEE may be configured to invoke callbacks at certain points of operation. For more details please refer to the TechRef.
      boolean FeeFssControlApi: set at pre-compile, origin=Vector Informatik, default-value=false  # Enable API to allow/prohibit FSS | - Fee_EnableFss - Fee_DisableFss Note that if this API is used, Fee_Write requests do not affect FSS enbabling.
  bsw implementation Fee_Impl: programming-language=C, sw-version=8.00.10, used-code-generator=DaVinci Configurator, vendor-id=30, ar-release-version=4.00.03, behavior=FeeBehavior, preconfigured-configuration=Fee_Pre, recommended-configuration=Fee_Rec, vendor-specific-module-def=Fee
  module config Fee_Pre: definition=Fee
  module config Fee_Rec: definition=Fee
