AUTOSAR XML (schema 4-0-3)
standard types defined: uint16_DataConstr, uint32_DataConstr, uint8_DataConstr, boolean, uint16, uint32, uint8
package /DataTypes
  impl type Ary1D_u8_12: category=ARRAY, sw-calibration-access=READ-ONLY, type-emitter=RTE
    element Element: array-size=12, array-size-semantics=FIXED-SIZE, implementation-data-type=uint8
package /Nexteer/DataTypes
  impl type Ary1D_u8_8: category=ARRAY, sw-calibration-access=READ-ONLY, type-emitter=RTE
    element Element: array-size=8, array-size-semantics=FIXED-SIZE, implementation-data-type=uint8
  impl type ImcArbnRxDataSrc1: implementation-data-type=ImcArbnRxDataSrc2, type-emitter=RTE
  impl type ImcArbnRxDataSrc2: implementation-data-type=uint8, type-emitter=ImcArbn
package /Nexteer/Units
  unit FixdPt: factor-si-to-unit=1, offset-si-to-unit=0
