AUTOSAR XML (schema 4-0-3)
# COPYRIGHT
# Copyright(c) 2013-2015 Renesas Electronics Corporation
package /Renesas/EcucDefs_Mcu
  bsw implementation Mcu_Impl: programming-language=C, sw-version=1.0.3, vendor-id=59, ar-release-version=4.0.3, behavior=BswInternalBehavior_0, vendor-api-infix=Renesas, vendor-specific-module-def=Mcu
  bsw module description Mcu: module-id=101
    bsw internal behavior BswInternalBehavior_0
      exclusive area REG_DATA_PROTECTION
      4 x bsw interrupt entity, all with interrupt-source=INTECM:
        BswInterruptEntity_1: implemented-entry=MCU_FEINT_ISR, interrupt-category=CAT-1
        BswInterruptEntity_2: implemented-entry=MCU_FEINT_CAT2_ISR, interrupt-category=CAT-2
        BswInterruptEntity_3: implemented-entry=MCU_ECM_EIC_ISR, interrupt-category=CAT-1
        BswInterruptEntity_4: implemented-entry=MCU_ECM_EIC_CAT2_ISR, interrupt-category=CAT-2
  4 x bsw module entry, all with is-reentrant=true, is-synchronous=true, call-type=INTERRUPT, sw-service-impl-policy=STANDARD:
    MCU_FEINT_ISR: execution-context=INTERRUPT-CAT-1
    MCU_FEINT_CAT2_ISR: execution-context=INTERRUPT-CAT-2
    MCU_ECM_EIC_ISR: execution-context=INTERRUPT-CAT-1
    MCU_ECM_EIC_CAT2_ISR: execution-context=INTERRUPT-CAT-2
