AUTOSAR XML (schema 4-0-3)
package /Nexteer/NvMProxy_swc/Interfaces
  client server interface NvMService_AC3_SRBS: is-service=true
    6 x operation, all with possible-error=E_NOT_OK:
      EraseBlock
      GetErrorStatus
        arg ErrorStatus: type=NvM_RequestResultType, direction=OUT
      InvalidateNvBlock
      ReadBlock
        arg DstPtr: type=dtRef_VOID, direction=IN
      SetRamBlockStatus
        arg RamBlockStatus: type=Boolean, direction=IN
      WriteBlock
        arg SrcPtr: type=dtRef_const_VOID, direction=IN
    error E_NOT_OK: error-code=1
package /PortInterfaces
  client server interface CmnMfgSrvCmnMfgSrvMaiFct
    operation Oper
      7 x arg:
        CmnMfgSrvCmnMfgSrvSrvId: type=uint8, direction=IN
        CmnMfgSrvCmnMfgSrvSubFct: type=uint8, direction=IN
        CmnMfgSrvCmnMfgSrvPrmId: type=uint16, direction=IN
        CmnMfgSrvCmnMfgSrvDataBufferPtr: type=uint8, direction=INOUT
        CmnMfgSrvCmnMfgSrvReqLen: type=uint16, direction=IN
        CmnMfgSrvCmnMfgSrvRespLen: type=uint16, direction=OUT
        CmnMfgSrvCmnMfgSrvRespCod: type=uint8, direction=OUT
  client server interface CmnMfgSrvIfCmnMfgSrvIfImdtTx
    operation Oper
      arg CmnMfgSrvCmnMfgSrvDataBufferPtr: type=uint8, direction=INOUT
      arg CmnMfgSrvCmnMfgSrvDataLen: type=uint16, direction=IN
