AUTOSAR XML (schema 4-0-3)
# COPYRIGHT
# Copyright(c) 2013-2015 Renesas Electronics Corporation
package /Renesas/EcucDefs_Port
  bsw implementation Port_Impl: programming-language=C, sw-version=1.5.0, vendor-id=59, ar-release-version=4.0.3, behavior=BswInternalBehavior_0, vendor-api-infix=Renesas, vendor-specific-module-def=Port
  bsw module description Port: module-id=124
    bsw internal behavior BswInternalBehavior_0
      7 x exclusive area:
        SET_PIN_MODE_PROTECTION
        SET_PIN_DIR_PROTECTION
        SET_TO_DIO_ALT_PROTECTION
        INIT_CONFIG_PROTECTION
        REFRESH_PORT_INTERNAL_PROTECTION
        SET_PIN_DEFAULT_MODE_PROTECTION
        SET_PIN_DEFAULT_DIR_PROTECTION
