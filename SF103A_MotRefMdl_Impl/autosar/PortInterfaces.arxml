AUTOSAR XML (schema 4-0-3)
package /Nexteer/Calibrations
  16 x parameter interface:
    Ag4
      parameter data prototype Val: sw-calibration-access=READ-WRITE, type=Ag13
    AgAry1D2
      parameter data prototype Ary1D: sw-calibration-access=READ-WRITE, type=AgAry1D4
    Cnt6
      parameter data prototype Val: sw-calibration-access=READ-WRITE, type=Cnt14
    Cnt7
      parameter data prototype Val: sw-calibration-access=READ-WRITE, type=Cnt28
    Cnt8
      parameter data prototype Val: sw-calibration-access=READ-WRITE, type=Cnt29
    Curr3
      parameter data prototype Val: sw-calibration-access=READ-WRITE, type=Curr9
    Frq2
      parameter data prototype Val: sw-calibration-access=READ-WRITE, type=Frq2
    Logl1
      parameter data prototype Logl: sw-calibration-access=READ-WRITE, type=Logl1
    Ti9
      parameter data prototype Val: sw-calibration-access=READ-WRITE, type=Ti12
    TqAry1D1
      parameter data prototype Ary1D: sw-calibration-access=READ-WRITE, type=TqAry1D6
    Uls3
      parameter data prototype Val: sw-calibration-access=READ-WRITE, type=Uls9
    Uls4
      parameter data prototype Val: sw-calibration-access=READ-WRITE, type=Uls2
    Uls6
      parameter data prototype Val: sw-calibration-access=READ-WRITE, type=Uls14
    UlsAry1D3
      parameter data prototype Ary1D: sw-calibration-access=READ-WRITE, type=UlsAry1D5
    VelAry1D3
      parameter data prototype Ary1D: sw-calibration-access=READ-WRITE, type=VelAry1D3
    VoltAry1D1
      parameter data prototype Ary1D: sw-calibration-access=READ-WRITE, type=VoltAry1D1
package /Nexteer/PortInterfaces
  14 x sender receiver interface:
    Ag6: invalidation-policy{data-element=Ag6/Val, handle-invalid=DONT-INVALIDATE}
      data Val: sw-calibration-access=READ-ONLY, type=Ag10
    boolean_PortIf1: invalidation-policy{data-element=boolean_PortIf1/Logl, handle-invalid=DONT-INVALIDATE}
      data Logl: sw-calibration-access=READ-ONLY, type=boolean
    Curr2: invalidation-policy{data-element=Curr2/Val, handle-invalid=DONT-INVALIDATE}
      data Val: sw-calibration-access=READ-ONLY, type=Curr6
    Curr3: invalidation-policy{data-element=Curr3/Val, handle-invalid=DONT-INVALIDATE}
      data Val: sw-calibration-access=READ-ONLY, type=Curr7
    float32_PortIf1: invalidation-policy{data-element=float32_PortIf1/Val, handle-invalid=DONT-INVALIDATE}
      data Val: sw-calibration-access=READ-ONLY, type=float32
    Indu2: invalidation-policy{data-element=Indu2/Val, handle-invalid=DONT-INVALIDATE}
      data Val: sw-calibration-access=READ-ONLY, type=Indu1
    Logl2: invalidation-policy{data-element=Logl2/Logl, handle-invalid=DONT-INVALIDATE}
      data Logl: sw-calibration-access=READ-ONLY, type=Logl1
    MotCon1: invalidation-policy{data-element=MotCon1/Val, handle-invalid=DONT-INVALIDATE}
      data Val: sw-calibration-access=READ-ONLY, type=MotCon1
    MotQuad1: invalidation-policy{data-element=MotQuad1/Val, handle-invalid=DONT-INVALIDATE}
      data Val: sw-calibration-access=READ-ONLY, type=MotQuad1
    R4: invalidation-policy{data-element=R4/Val, handle-invalid=DONT-INVALIDATE}
      data Val: sw-calibration-access=READ-ONLY, type=R5
    Tq1: invalidation-policy{data-element=Tq1/Val, handle-invalid=DONT-INVALIDATE}
      data Val: sw-calibration-access=READ-ONLY, type=Tq1
    Vel1: invalidation-policy{data-element=Vel1/Val, handle-invalid=DONT-INVALIDATE}
      data Val: sw-calibration-access=READ-ONLY, type=Vel1
    Volt1: invalidation-policy{data-element=Volt1/Val, handle-invalid=DONT-INVALIDATE}
      data Val: sw-calibration-access=READ-ONLY, type=Volt1
    Volt6: invalidation-policy{data-element=Volt6/Val, handle-invalid=DONT-INVALIDATE}
      data Val: sw-calibration-access=READ-ONLY, type=Volt17
