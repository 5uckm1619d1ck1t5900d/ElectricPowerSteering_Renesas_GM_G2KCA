AUTOSAR XML (schema 4-0-3)
# COPYRIGHT
# Copyright(c) 2013-2014 Renesas Electronics Corporation
package /Renesas/EcucDefs_Wdg0
  bsw implementation Wdg_Impl: programming-language=C, sw-version=1.0.9, vendor-id=59, ar-release-version=4.0.3, behavior=BswInternalBehavior_0, vendor-api-infix=DriverA, vendor-specific-module-def=Wdg
  bsw module description Wdg: module-id=102
    bsw internal behavior BswInternalBehavior_0
      exclusive area TRIGG_PROTECTION
      exclusive area MODE_SWITCH_PROTECTION
      bsw interrupt entity BswInterruptEntity_0: implemented-entry=WDG_59_DRIVERA_TRIGGERFUNCTION_ISR, interrupt-category=CAT-1, interrupt-source=INTWDTA0
      bsw interrupt entity BswInterruptEntity_2: implemented-entry=WDG_59_DRIVERA_TRIGGERFUNCTION_CAT2_ISR, interrupt-category=CAT-2, interrupt-source=INTWDTA0
  bsw module entry WDG_59_DRIVERA_TRIGGERFUNCTION_ISR: is-reentrant=true, is-synchronous=true, call-type=INTERRUPT, execution-context=INTERRUPT-CAT-1, sw-service-impl-policy=STANDARD
  bsw module entry WDG_59_DRIVERA_TRIGGERFUNCTION_CAT2_ISR: is-reentrant=true, is-synchronous=true, call-type=INTERRUPT, execution-context=INTERRUPT-CAT-2, sw-service-impl-policy=STANDARD
